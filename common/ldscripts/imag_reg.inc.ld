/**
 * Imaginary register default definitions.
 *
 * By default, define each imaginary zero page register to be immediately
 * following the previous. Via this convention, contiguous regions of zero page
 * registers can be allocated by overriding only one of these values. Since the
 * linker evaluates lazily, all later values will automatically be updated with
 * the new offset.
 *
 * For example, setting __rc10 = 50 would automatically make __rc11 = 51,
 * __rc12 = 52, and so forth. Earlier imaginary registers would be unaffected;
 * e.g., __rc7 would still be 7.
 */

PROVIDE(__rc0 = 0);
PROVIDE(__rc1 = __rc0 + 1);
PROVIDE(__rc2 = __rc1 + 1);
PROVIDE(__rc3 = __rc2 + 1);
PROVIDE(__rc4 = __rc3 + 1);
PROVIDE(__rc5 = __rc4 + 1);
PROVIDE(__rc6 = __rc5 + 1);
PROVIDE(__rc7 = __rc6 + 1);
PROVIDE(__rc8 = __rc7 + 1);
PROVIDE(__rc9 = __rc8 + 1);
PROVIDE(__rc10 = __rc9 + 1);
PROVIDE(__rc11 = __rc10 + 1);
PROVIDE(__rc12 = __rc11 + 1);
PROVIDE(__rc13 = __rc12 + 1);
PROVIDE(__rc14 = __rc13 + 1);
PROVIDE(__rc15 = __rc14 + 1);
PROVIDE(__rc16 = __rc15 + 1);
PROVIDE(__rc17 = __rc16 + 1);
PROVIDE(__rc18 = __rc17 + 1);
PROVIDE(__rc19 = __rc18 + 1);
PROVIDE(__rc20 = __rc19 + 1);
PROVIDE(__rc21 = __rc20 + 1);
PROVIDE(__rc22 = __rc21 + 1);
PROVIDE(__rc23 = __rc22 + 1);
PROVIDE(__rc24 = __rc23 + 1);
PROVIDE(__rc25 = __rc24 + 1);
PROVIDE(__rc26 = __rc25 + 1);
PROVIDE(__rc27 = __rc26 + 1);
PROVIDE(__rc28 = __rc27 + 1);
PROVIDE(__rc29 = __rc28 + 1);
PROVIDE(__rc30 = __rc29 + 1);
PROVIDE(__rc31 = __rc30 + 1);
PROVIDE(__rc32 = __rc31 + 1);
PROVIDE(__rc33 = __rc32 + 1);
PROVIDE(__rc34 = __rc33 + 1);
PROVIDE(__rc35 = __rc34 + 1);
PROVIDE(__rc36 = __rc35 + 1);
PROVIDE(__rc37 = __rc36 + 1);
PROVIDE(__rc38 = __rc37 + 1);
PROVIDE(__rc39 = __rc38 + 1);
PROVIDE(__rc40 = __rc39 + 1);
PROVIDE(__rc41 = __rc40 + 1);
PROVIDE(__rc42 = __rc41 + 1);
PROVIDE(__rc43 = __rc42 + 1);
PROVIDE(__rc44 = __rc43 + 1);
PROVIDE(__rc45 = __rc44 + 1);
PROVIDE(__rc46 = __rc45 + 1);
PROVIDE(__rc47 = __rc46 + 1);
PROVIDE(__rc48 = __rc47 + 1);
PROVIDE(__rc49 = __rc48 + 1);
PROVIDE(__rc50 = __rc49 + 1);
PROVIDE(__rc51 = __rc50 + 1);
PROVIDE(__rc52 = __rc51 + 1);
PROVIDE(__rc53 = __rc52 + 1);
PROVIDE(__rc54 = __rc53 + 1);
PROVIDE(__rc55 = __rc54 + 1);
PROVIDE(__rc56 = __rc55 + 1);
PROVIDE(__rc57 = __rc56 + 1);
PROVIDE(__rc58 = __rc57 + 1);
PROVIDE(__rc59 = __rc58 + 1);
PROVIDE(__rc60 = __rc59 + 1);
PROVIDE(__rc61 = __rc60 + 1);
PROVIDE(__rc62 = __rc61 + 1);
PROVIDE(__rc63 = __rc62 + 1);
PROVIDE(__rc64 = __rc63 + 1);
PROVIDE(__rc65 = __rc64 + 1);
PROVIDE(__rc66 = __rc65 + 1);
PROVIDE(__rc67 = __rc66 + 1);
PROVIDE(__rc68 = __rc67 + 1);
PROVIDE(__rc69 = __rc68 + 1);
PROVIDE(__rc70 = __rc69 + 1);
PROVIDE(__rc71 = __rc70 + 1);
PROVIDE(__rc72 = __rc71 + 1);
PROVIDE(__rc73 = __rc72 + 1);
PROVIDE(__rc74 = __rc73 + 1);
PROVIDE(__rc75 = __rc74 + 1);
PROVIDE(__rc76 = __rc75 + 1);
PROVIDE(__rc77 = __rc76 + 1);
PROVIDE(__rc78 = __rc77 + 1);
PROVIDE(__rc79 = __rc78 + 1);
PROVIDE(__rc80 = __rc79 + 1);
PROVIDE(__rc81 = __rc80 + 1);
PROVIDE(__rc82 = __rc81 + 1);
PROVIDE(__rc83 = __rc82 + 1);
PROVIDE(__rc84 = __rc83 + 1);
PROVIDE(__rc85 = __rc84 + 1);
PROVIDE(__rc86 = __rc85 + 1);
PROVIDE(__rc87 = __rc86 + 1);
PROVIDE(__rc88 = __rc87 + 1);
PROVIDE(__rc89 = __rc88 + 1);
PROVIDE(__rc90 = __rc89 + 1);
PROVIDE(__rc91 = __rc90 + 1);
PROVIDE(__rc92 = __rc91 + 1);
PROVIDE(__rc93 = __rc92 + 1);
PROVIDE(__rc94 = __rc93 + 1);
PROVIDE(__rc95 = __rc94 + 1);
PROVIDE(__rc96 = __rc95 + 1);
PROVIDE(__rc97 = __rc96 + 1);
PROVIDE(__rc98 = __rc97 + 1);
PROVIDE(__rc99 = __rc98 + 1);
PROVIDE(__rc100 = __rc99 + 1);
PROVIDE(__rc101 = __rc100 + 1);
PROVIDE(__rc102 = __rc101 + 1);
PROVIDE(__rc103 = __rc102 + 1);
PROVIDE(__rc104 = __rc103 + 1);
PROVIDE(__rc105 = __rc104 + 1);
PROVIDE(__rc106 = __rc105 + 1);
PROVIDE(__rc107 = __rc106 + 1);
PROVIDE(__rc108 = __rc107 + 1);
PROVIDE(__rc109 = __rc108 + 1);
PROVIDE(__rc110 = __rc109 + 1);
PROVIDE(__rc111 = __rc110 + 1);
PROVIDE(__rc112 = __rc111 + 1);
PROVIDE(__rc113 = __rc112 + 1);
PROVIDE(__rc114 = __rc113 + 1);
PROVIDE(__rc115 = __rc114 + 1);
PROVIDE(__rc116 = __rc115 + 1);
PROVIDE(__rc117 = __rc116 + 1);
PROVIDE(__rc118 = __rc117 + 1);
PROVIDE(__rc119 = __rc118 + 1);
PROVIDE(__rc120 = __rc119 + 1);
PROVIDE(__rc121 = __rc120 + 1);
PROVIDE(__rc122 = __rc121 + 1);
PROVIDE(__rc123 = __rc122 + 1);
PROVIDE(__rc124 = __rc123 + 1);
PROVIDE(__rc125 = __rc124 + 1);
PROVIDE(__rc126 = __rc125 + 1);
PROVIDE(__rc127 = __rc126 + 1);
PROVIDE(__rc128 = __rc127 + 1);
PROVIDE(__rc129 = __rc128 + 1);
PROVIDE(__rc130 = __rc129 + 1);
PROVIDE(__rc131 = __rc130 + 1);
PROVIDE(__rc132 = __rc131 + 1);
PROVIDE(__rc133 = __rc132 + 1);
PROVIDE(__rc134 = __rc133 + 1);
PROVIDE(__rc135 = __rc134 + 1);
PROVIDE(__rc136 = __rc135 + 1);
PROVIDE(__rc137 = __rc136 + 1);
PROVIDE(__rc138 = __rc137 + 1);
PROVIDE(__rc139 = __rc138 + 1);
PROVIDE(__rc140 = __rc139 + 1);
PROVIDE(__rc141 = __rc140 + 1);
PROVIDE(__rc142 = __rc141 + 1);
PROVIDE(__rc143 = __rc142 + 1);
PROVIDE(__rc144 = __rc143 + 1);
PROVIDE(__rc145 = __rc144 + 1);
PROVIDE(__rc146 = __rc145 + 1);
PROVIDE(__rc147 = __rc146 + 1);
PROVIDE(__rc148 = __rc147 + 1);
PROVIDE(__rc149 = __rc148 + 1);
PROVIDE(__rc150 = __rc149 + 1);
PROVIDE(__rc151 = __rc150 + 1);
PROVIDE(__rc152 = __rc151 + 1);
PROVIDE(__rc153 = __rc152 + 1);
PROVIDE(__rc154 = __rc153 + 1);
PROVIDE(__rc155 = __rc154 + 1);
PROVIDE(__rc156 = __rc155 + 1);
PROVIDE(__rc157 = __rc156 + 1);
PROVIDE(__rc158 = __rc157 + 1);
PROVIDE(__rc159 = __rc158 + 1);
PROVIDE(__rc160 = __rc159 + 1);
PROVIDE(__rc161 = __rc160 + 1);
PROVIDE(__rc162 = __rc161 + 1);
PROVIDE(__rc163 = __rc162 + 1);
PROVIDE(__rc164 = __rc163 + 1);
PROVIDE(__rc165 = __rc164 + 1);
PROVIDE(__rc166 = __rc165 + 1);
PROVIDE(__rc167 = __rc166 + 1);
PROVIDE(__rc168 = __rc167 + 1);
PROVIDE(__rc169 = __rc168 + 1);
PROVIDE(__rc170 = __rc169 + 1);
PROVIDE(__rc171 = __rc170 + 1);
PROVIDE(__rc172 = __rc171 + 1);
PROVIDE(__rc173 = __rc172 + 1);
PROVIDE(__rc174 = __rc173 + 1);
PROVIDE(__rc175 = __rc174 + 1);
PROVIDE(__rc176 = __rc175 + 1);
PROVIDE(__rc177 = __rc176 + 1);
PROVIDE(__rc178 = __rc177 + 1);
PROVIDE(__rc179 = __rc178 + 1);
PROVIDE(__rc180 = __rc179 + 1);
PROVIDE(__rc181 = __rc180 + 1);
PROVIDE(__rc182 = __rc181 + 1);
PROVIDE(__rc183 = __rc182 + 1);
PROVIDE(__rc184 = __rc183 + 1);
PROVIDE(__rc185 = __rc184 + 1);
PROVIDE(__rc186 = __rc185 + 1);
PROVIDE(__rc187 = __rc186 + 1);
PROVIDE(__rc188 = __rc187 + 1);
PROVIDE(__rc189 = __rc188 + 1);
PROVIDE(__rc190 = __rc189 + 1);
PROVIDE(__rc191 = __rc190 + 1);
PROVIDE(__rc192 = __rc191 + 1);
PROVIDE(__rc193 = __rc192 + 1);
PROVIDE(__rc194 = __rc193 + 1);
PROVIDE(__rc195 = __rc194 + 1);
PROVIDE(__rc196 = __rc195 + 1);
PROVIDE(__rc197 = __rc196 + 1);
PROVIDE(__rc198 = __rc197 + 1);
PROVIDE(__rc199 = __rc198 + 1);
PROVIDE(__rc200 = __rc199 + 1);
PROVIDE(__rc201 = __rc200 + 1);
PROVIDE(__rc202 = __rc201 + 1);
PROVIDE(__rc203 = __rc202 + 1);
PROVIDE(__rc204 = __rc203 + 1);
PROVIDE(__rc205 = __rc204 + 1);
PROVIDE(__rc206 = __rc205 + 1);
PROVIDE(__rc207 = __rc206 + 1);
PROVIDE(__rc208 = __rc207 + 1);
PROVIDE(__rc209 = __rc208 + 1);
PROVIDE(__rc210 = __rc209 + 1);
PROVIDE(__rc211 = __rc210 + 1);
PROVIDE(__rc212 = __rc211 + 1);
PROVIDE(__rc213 = __rc212 + 1);
PROVIDE(__rc214 = __rc213 + 1);
PROVIDE(__rc215 = __rc214 + 1);
PROVIDE(__rc216 = __rc215 + 1);
PROVIDE(__rc217 = __rc216 + 1);
PROVIDE(__rc218 = __rc217 + 1);
PROVIDE(__rc219 = __rc218 + 1);
PROVIDE(__rc220 = __rc219 + 1);
PROVIDE(__rc221 = __rc220 + 1);
PROVIDE(__rc222 = __rc221 + 1);
PROVIDE(__rc223 = __rc222 + 1);
PROVIDE(__rc224 = __rc223 + 1);
PROVIDE(__rc225 = __rc224 + 1);
PROVIDE(__rc226 = __rc225 + 1);
PROVIDE(__rc227 = __rc226 + 1);
PROVIDE(__rc228 = __rc227 + 1);
PROVIDE(__rc229 = __rc228 + 1);
PROVIDE(__rc230 = __rc229 + 1);
PROVIDE(__rc231 = __rc230 + 1);
PROVIDE(__rc232 = __rc231 + 1);
PROVIDE(__rc233 = __rc232 + 1);
PROVIDE(__rc234 = __rc233 + 1);
PROVIDE(__rc235 = __rc234 + 1);
PROVIDE(__rc236 = __rc235 + 1);
PROVIDE(__rc237 = __rc236 + 1);
PROVIDE(__rc238 = __rc237 + 1);
PROVIDE(__rc239 = __rc238 + 1);
PROVIDE(__rc240 = __rc239 + 1);
PROVIDE(__rc241 = __rc240 + 1);
PROVIDE(__rc242 = __rc241 + 1);
PROVIDE(__rc243 = __rc242 + 1);
PROVIDE(__rc244 = __rc243 + 1);
PROVIDE(__rc245 = __rc244 + 1);
PROVIDE(__rc246 = __rc245 + 1);
PROVIDE(__rc247 = __rc246 + 1);
PROVIDE(__rc248 = __rc247 + 1);
PROVIDE(__rc249 = __rc248 + 1);
PROVIDE(__rc250 = __rc249 + 1);
PROVIDE(__rc251 = __rc250 + 1);
PROVIDE(__rc252 = __rc251 + 1);
PROVIDE(__rc253 = __rc252 + 1);
PROVIDE(__rc254 = __rc253 + 1);
PROVIDE(__rc255 = __rc254 + 1);