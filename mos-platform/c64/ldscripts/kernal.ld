PROVIDE(CINT   = 0XFF81);
PROVIDE(IOINIT = 0XFF84);
PROVIDE(RAMTAS = 0XFF87);
PROVIDE(RESTOR = 0XFF8A);
PROVIDE(VECTOR = 0XFF8D);
PROVIDE(SETMSG = 0xFF90);
PROVIDE(SECOND = 0XFF93);
PROVIDE(TKSA   = 0XFF96);
PROVIDE(MEMTOP = 0XFF99);
PROVIDE(MEMBOT = 0XFF9C);
PROVIDE(SCNKEY = 0XFF9F);
PROVIDE(SETTMO = 0XFFA2);
PROVIDE(ACPTR  = 0XFFA5);
PROVIDE(CIOUT  = 0XFFA8);
PROVIDE(UNTLK  = 0XFFAB);
PROVIDE(UNLSN  = 0XFFAE);
PROVIDE(LISTEN = 0XFFB1);
PROVIDE(TALK   = 0XFFB4);
PROVIDE(READST = 0XFFB7);
PROVIDE(SETLFS = 0XFFBA);
PROVIDE(SETNAM = 0XFFBD);
PROVIDE(OPEN   = 0XFFC0);
PROVIDE(CLOSE  = 0XFFC3);
PROVIDE(CHKIN  = 0XFFC6);
PROVIDE(CHKOUT = 0XFFC9);
PROVIDE(CLRCHN = 0XFFCC);
PROVIDE(CHRIN  = 0XFFCF);
PROVIDE(CHROUT = 0XFFD2);
PROVIDE(LOAD   = 0XFFD5);
PROVIDE(SAVE   = 0XFFD8);
PROVIDE(SETTIM = 0XFFDB);
PROVIDE(RDTIM  = 0XFFDE);
PROVIDE(STOP   = 0XFFE1);
PROVIDE(GETIN  = 0XFFE4);
PROVIDE(CLALL  = 0XFFE7);
PROVIDE(UDTIM  = 0XFFEA);
PROVIDE(SCREEN = 0XFFED);
PROVIDE(PLOT   = 0XFFF0);
PROVIDE(IOBASE = 0XFFF3);
