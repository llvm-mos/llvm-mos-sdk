/* Automatically generated by generate-rom-banked-sections.lua. */

INPUT(reset.o)
__prg_rom_0_lma = 0x008000;
__prg_rom_1_lma = 0x018000;
__prg_rom_2_lma = 0x028000;
__prg_rom_3_lma = 0x038000;
__prg_rom_4_lma = 0x048000;
__prg_rom_5_lma = 0x058000;
__prg_rom_6_lma = 0x068000;
__prg_rom_7_lma = 0x078000;
__prg_rom_8_lma = 0x088000;
__prg_rom_9_lma = 0x098000;
__prg_rom_10_lma = 0x0a8000;
__prg_rom_11_lma = 0x0b8000;
__prg_rom_12_lma = 0x0c8000;
__prg_rom_13_lma = 0x0d8000;
__prg_rom_14_lma = 0x0e8000;
__prg_rom_15_lma = 0x0f8000;
__prg_rom_16_lma = 0x108000;
__prg_rom_17_lma = 0x118000;
__prg_rom_18_lma = 0x128000;
__prg_rom_19_lma = 0x138000;
__prg_rom_20_lma = 0x148000;
__prg_rom_21_lma = 0x158000;
__prg_rom_22_lma = 0x168000;
__prg_rom_23_lma = 0x178000;
__prg_rom_24_lma = 0x188000;
__prg_rom_25_lma = 0x198000;
__prg_rom_26_lma = 0x1a8000;
__prg_rom_27_lma = 0x1b8000;
__prg_rom_28_lma = 0x1c8000;
__prg_rom_29_lma = 0x1d8000;
__prg_rom_30_lma = 0x1e8000;
__prg_rom_fixed_lma = 0xc000;

__prg_rom_0_offset = 0x000000;
__prg_rom_1_offset = 0x004000;
__prg_rom_2_offset = 0x008000;
__prg_rom_3_offset = 0x00c000;
__prg_rom_4_offset = 0x010000;
__prg_rom_5_offset = 0x014000;
__prg_rom_6_offset = 0x018000;
__prg_rom_7_offset = 0x01c000;
__prg_rom_8_offset = 0x020000;
__prg_rom_9_offset = 0x024000;
__prg_rom_10_offset = 0x028000;
__prg_rom_11_offset = 0x02c000;
__prg_rom_12_offset = 0x030000;
__prg_rom_13_offset = 0x034000;
__prg_rom_14_offset = 0x038000;
__prg_rom_15_offset = 0x03c000;
__prg_rom_16_offset = 0x040000;
__prg_rom_17_offset = 0x044000;
__prg_rom_18_offset = 0x048000;
__prg_rom_19_offset = 0x04c000;
__prg_rom_20_offset = 0x050000;
__prg_rom_21_offset = 0x054000;
__prg_rom_22_offset = 0x058000;
__prg_rom_23_offset = 0x05c000;
__prg_rom_24_offset = 0x060000;
__prg_rom_25_offset = 0x064000;
__prg_rom_26_offset = 0x068000;
__prg_rom_27_offset = 0x06c000;
__prg_rom_28_offset = 0x070000;
__prg_rom_29_offset = 0x074000;
__prg_rom_30_offset = 0x078000;
__prg_rom_fixed_offset = __prg_rom_size * 1024 - 0x4000;

MEMORY {
  /* PRG-ROM LMAs. */
  prg_rom_0 : ORIGIN = __prg_rom_0_lma, LENGTH = __prg_rom_size >= 32 ? 0x4000 : 0
  prg_rom_1 : ORIGIN = __prg_rom_1_lma, LENGTH = __prg_rom_size >= 64 ? 0x4000 : 0
  prg_rom_2 : ORIGIN = __prg_rom_2_lma, LENGTH = __prg_rom_size >= 64 ? 0x4000 : 0
  prg_rom_3 : ORIGIN = __prg_rom_3_lma, LENGTH = __prg_rom_size >= 128 ? 0x4000 : 0
  prg_rom_4 : ORIGIN = __prg_rom_4_lma, LENGTH = __prg_rom_size >= 128 ? 0x4000 : 0
  prg_rom_5 : ORIGIN = __prg_rom_5_lma, LENGTH = __prg_rom_size >= 128 ? 0x4000 : 0
  prg_rom_6 : ORIGIN = __prg_rom_6_lma, LENGTH = __prg_rom_size >= 128 ? 0x4000 : 0
  prg_rom_7 : ORIGIN = __prg_rom_7_lma, LENGTH = __prg_rom_size >= 256 ? 0x4000 : 0
  prg_rom_8 : ORIGIN = __prg_rom_8_lma, LENGTH = __prg_rom_size >= 256 ? 0x4000 : 0
  prg_rom_9 : ORIGIN = __prg_rom_9_lma, LENGTH = __prg_rom_size >= 256 ? 0x4000 : 0
  prg_rom_10 : ORIGIN = __prg_rom_10_lma, LENGTH = __prg_rom_size >= 256 ? 0x4000 : 0
  prg_rom_11 : ORIGIN = __prg_rom_11_lma, LENGTH = __prg_rom_size >= 256 ? 0x4000 : 0
  prg_rom_12 : ORIGIN = __prg_rom_12_lma, LENGTH = __prg_rom_size >= 256 ? 0x4000 : 0
  prg_rom_13 : ORIGIN = __prg_rom_13_lma, LENGTH = __prg_rom_size >= 256 ? 0x4000 : 0
  prg_rom_14 : ORIGIN = __prg_rom_14_lma, LENGTH = __prg_rom_size >= 256 ? 0x4000 : 0
  prg_rom_15 : ORIGIN = __prg_rom_15_lma, LENGTH = __prg_rom_size >= 512 ? 0x4000 : 0
  prg_rom_16 : ORIGIN = __prg_rom_16_lma, LENGTH = __prg_rom_size >= 512 ? 0x4000 : 0
  prg_rom_17 : ORIGIN = __prg_rom_17_lma, LENGTH = __prg_rom_size >= 512 ? 0x4000 : 0
  prg_rom_18 : ORIGIN = __prg_rom_18_lma, LENGTH = __prg_rom_size >= 512 ? 0x4000 : 0
  prg_rom_19 : ORIGIN = __prg_rom_19_lma, LENGTH = __prg_rom_size >= 512 ? 0x4000 : 0
  prg_rom_20 : ORIGIN = __prg_rom_20_lma, LENGTH = __prg_rom_size >= 512 ? 0x4000 : 0
  prg_rom_21 : ORIGIN = __prg_rom_21_lma, LENGTH = __prg_rom_size >= 512 ? 0x4000 : 0
  prg_rom_22 : ORIGIN = __prg_rom_22_lma, LENGTH = __prg_rom_size >= 512 ? 0x4000 : 0
  prg_rom_23 : ORIGIN = __prg_rom_23_lma, LENGTH = __prg_rom_size >= 512 ? 0x4000 : 0
  prg_rom_24 : ORIGIN = __prg_rom_24_lma, LENGTH = __prg_rom_size >= 512 ? 0x4000 : 0
  prg_rom_25 : ORIGIN = __prg_rom_25_lma, LENGTH = __prg_rom_size >= 512 ? 0x4000 : 0
  prg_rom_26 : ORIGIN = __prg_rom_26_lma, LENGTH = __prg_rom_size >= 512 ? 0x4000 : 0
  prg_rom_27 : ORIGIN = __prg_rom_27_lma, LENGTH = __prg_rom_size >= 512 ? 0x4000 : 0
  prg_rom_28 : ORIGIN = __prg_rom_28_lma, LENGTH = __prg_rom_size >= 512 ? 0x4000 : 0
  prg_rom_29 : ORIGIN = __prg_rom_29_lma, LENGTH = __prg_rom_size >= 512 ? 0x4000 : 0
  prg_rom_30 : ORIGIN = __prg_rom_30_lma, LENGTH = __prg_rom_size >= 512 ? 0x4000 : 0
  prg_rom_fixed : ORIGIN = __prg_rom_fixed_lma, LENGTH = 0x4000 - 0x6
  vectors : ORIGIN = 0x10000 - 0x6, LENGTH = 6

  /* CHR-ROM LMAs. */
  chr_rom_0   : ORIGIN = 0x01000000, LENGTH = __chr_rom_size >= 8    ? 0x2000 : 0
  chr_rom_1   : ORIGIN = 0x01002000, LENGTH = __chr_rom_size >= 16   ? 0x2000 : 0
  chr_rom_2   : ORIGIN = 0x01004000, LENGTH = __chr_rom_size >= 32   ? 0x2000 : 0
  chr_rom_3   : ORIGIN = 0x01006000, LENGTH = __chr_rom_size >= 32   ? 0x2000 : 0
}

REGION_ALIAS("c_readonly", prg_rom_fixed)

SECTIONS {
  .prg_rom_0 : { *(.prg_rom_0 .prg_rom_0.*) } >prg_rom_0
  .prg_rom_1 : { *(.prg_rom_1 .prg_rom_1.*) } >prg_rom_1
  .prg_rom_2 : { *(.prg_rom_2 .prg_rom_2.*) } >prg_rom_2
  .prg_rom_3 : { *(.prg_rom_3 .prg_rom_3.*) } >prg_rom_3
  .prg_rom_4 : { *(.prg_rom_4 .prg_rom_4.*) } >prg_rom_4
  .prg_rom_5 : { *(.prg_rom_5 .prg_rom_5.*) } >prg_rom_5
  .prg_rom_6 : { *(.prg_rom_6 .prg_rom_6.*) } >prg_rom_6
  .prg_rom_7 : { *(.prg_rom_7 .prg_rom_7.*) } >prg_rom_7
  .prg_rom_8 : { *(.prg_rom_8 .prg_rom_8.*) } >prg_rom_8
  .prg_rom_9 : { *(.prg_rom_9 .prg_rom_9.*) } >prg_rom_9
  .prg_rom_10 : { *(.prg_rom_10 .prg_rom_10.*) } >prg_rom_10
  .prg_rom_11 : { *(.prg_rom_11 .prg_rom_11.*) } >prg_rom_11
  .prg_rom_12 : { *(.prg_rom_12 .prg_rom_12.*) } >prg_rom_12
  .prg_rom_13 : { *(.prg_rom_13 .prg_rom_13.*) } >prg_rom_13
  .prg_rom_14 : { *(.prg_rom_14 .prg_rom_14.*) } >prg_rom_14
  .prg_rom_15 : { *(.prg_rom_15 .prg_rom_15.*) } >prg_rom_15
  .prg_rom_16 : { *(.prg_rom_16 .prg_rom_16.*) } >prg_rom_16
  .prg_rom_17 : { *(.prg_rom_17 .prg_rom_17.*) } >prg_rom_17
  .prg_rom_18 : { *(.prg_rom_18 .prg_rom_18.*) } >prg_rom_18
  .prg_rom_19 : { *(.prg_rom_19 .prg_rom_19.*) } >prg_rom_19
  .prg_rom_20 : { *(.prg_rom_20 .prg_rom_20.*) } >prg_rom_20
  .prg_rom_21 : { *(.prg_rom_21 .prg_rom_21.*) } >prg_rom_21
  .prg_rom_22 : { *(.prg_rom_22 .prg_rom_22.*) } >prg_rom_22
  .prg_rom_23 : { *(.prg_rom_23 .prg_rom_23.*) } >prg_rom_23
  .prg_rom_24 : { *(.prg_rom_24 .prg_rom_24.*) } >prg_rom_24
  .prg_rom_25 : { *(.prg_rom_25 .prg_rom_25.*) } >prg_rom_25
  .prg_rom_26 : { *(.prg_rom_26 .prg_rom_26.*) } >prg_rom_26
  .prg_rom_27 : { *(.prg_rom_27 .prg_rom_27.*) } >prg_rom_27
  .prg_rom_28 : { *(.prg_rom_28 .prg_rom_28.*) } >prg_rom_28
  .prg_rom_29 : { *(.prg_rom_29 .prg_rom_29.*) } >prg_rom_29
  .prg_rom_30 : { *(.prg_rom_30 .prg_rom_30.*) } >prg_rom_30
  .prg_rom_fixed : { *(.prg_rom_fixed .prg_rom_fixed.*) } >prg_rom_fixed

  .chr_rom_0   : { KEEP(*(.chr_rom_0   .chr_rom_0.*)) }   >chr_rom_0
  .chr_rom_1   : { KEEP(*(.chr_rom_1   .chr_rom_1.*)) }   >chr_rom_1
  .chr_rom_2   : { KEEP(*(.chr_rom_2   .chr_rom_2.*)) }   >chr_rom_2
  .chr_rom_3   : { KEEP(*(.chr_rom_3   .chr_rom_3.*)) }   >chr_rom_3
}

INCLUDE dpcm.ld

SECTIONS {
  .vectors : { KEEP(*(.vectors)) } >vectors
}
