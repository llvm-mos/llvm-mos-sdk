/* Automatically generated by generate-rom-banked-sections.lua. */

INPUT(reset.o)
__prg_rom_0_lma = 0x008000;
__prg_rom_1_lma = 0x018000;
__prg_rom_2_lma = 0x028000;
__prg_rom_3_lma = 0x038000;
__prg_rom_4_lma = 0x048000;
__prg_rom_5_lma = 0x058000;
__prg_rom_6_lma = 0x068000;
__prg_rom_7_lma = 0x078000;
__prg_rom_8_lma = 0x088000;
__prg_rom_9_lma = 0x098000;
__prg_rom_10_lma = 0x0a8000;
__prg_rom_11_lma = 0x0b8000;
__prg_rom_12_lma = 0x0c8000;
__prg_rom_13_lma = 0x0d8000;
__prg_rom_14_lma = 0x0e8000;
__prg_rom_15_lma = 0x0f8000;
__prg_rom_16_lma = 0x108000;
__prg_rom_17_lma = 0x118000;
__prg_rom_18_lma = 0x128000;
__prg_rom_19_lma = 0x138000;
__prg_rom_20_lma = 0x148000;
__prg_rom_21_lma = 0x158000;
__prg_rom_22_lma = 0x168000;
__prg_rom_23_lma = 0x178000;
__prg_rom_24_lma = 0x188000;
__prg_rom_25_lma = 0x198000;
__prg_rom_26_lma = 0x1a8000;
__prg_rom_27_lma = 0x1b8000;
__prg_rom_28_lma = 0x1c8000;
__prg_rom_29_lma = 0x1d8000;
__prg_rom_30_lma = 0x1e8000;
__prg_rom_31_lma = 0x1f8000;
__prg_rom_32_lma = 0x208000;
__prg_rom_33_lma = 0x218000;
__prg_rom_34_lma = 0x228000;
__prg_rom_35_lma = 0x238000;
__prg_rom_36_lma = 0x248000;
__prg_rom_37_lma = 0x258000;
__prg_rom_38_lma = 0x268000;
__prg_rom_39_lma = 0x278000;
__prg_rom_40_lma = 0x288000;
__prg_rom_41_lma = 0x298000;
__prg_rom_42_lma = 0x2a8000;
__prg_rom_43_lma = 0x2b8000;
__prg_rom_44_lma = 0x2c8000;
__prg_rom_45_lma = 0x2d8000;
__prg_rom_46_lma = 0x2e8000;
__prg_rom_47_lma = 0x2f8000;
__prg_rom_48_lma = 0x308000;
__prg_rom_49_lma = 0x318000;
__prg_rom_50_lma = 0x328000;
__prg_rom_51_lma = 0x338000;
__prg_rom_52_lma = 0x348000;
__prg_rom_53_lma = 0x358000;
__prg_rom_54_lma = 0x368000;
__prg_rom_55_lma = 0x378000;
__prg_rom_56_lma = 0x388000;
__prg_rom_57_lma = 0x398000;
__prg_rom_58_lma = 0x3a8000;
__prg_rom_59_lma = 0x3b8000;
__prg_rom_60_lma = 0x3c8000;
__prg_rom_61_lma = 0x3d8000;
__prg_rom_62_lma = 0x3e8000;
__prg_rom_63_lma = 0x3f8000;
__prg_rom_64_lma = 0x408000;
__prg_rom_65_lma = 0x418000;
__prg_rom_66_lma = 0x428000;
__prg_rom_67_lma = 0x438000;
__prg_rom_68_lma = 0x448000;
__prg_rom_69_lma = 0x458000;
__prg_rom_70_lma = 0x468000;
__prg_rom_71_lma = 0x478000;
__prg_rom_72_lma = 0x488000;
__prg_rom_73_lma = 0x498000;
__prg_rom_74_lma = 0x4a8000;
__prg_rom_75_lma = 0x4b8000;
__prg_rom_76_lma = 0x4c8000;
__prg_rom_77_lma = 0x4d8000;
__prg_rom_78_lma = 0x4e8000;
__prg_rom_79_lma = 0x4f8000;
__prg_rom_80_lma = 0x508000;
__prg_rom_81_lma = 0x518000;
__prg_rom_82_lma = 0x528000;
__prg_rom_83_lma = 0x538000;
__prg_rom_84_lma = 0x548000;
__prg_rom_85_lma = 0x558000;
__prg_rom_86_lma = 0x568000;
__prg_rom_87_lma = 0x578000;
__prg_rom_88_lma = 0x588000;
__prg_rom_89_lma = 0x598000;
__prg_rom_90_lma = 0x5a8000;
__prg_rom_91_lma = 0x5b8000;
__prg_rom_92_lma = 0x5c8000;
__prg_rom_93_lma = 0x5d8000;
__prg_rom_94_lma = 0x5e8000;
__prg_rom_95_lma = 0x5f8000;
__prg_rom_96_lma = 0x608000;
__prg_rom_97_lma = 0x618000;
__prg_rom_98_lma = 0x628000;
__prg_rom_99_lma = 0x638000;
__prg_rom_100_lma = 0x648000;
__prg_rom_101_lma = 0x658000;
__prg_rom_102_lma = 0x668000;
__prg_rom_103_lma = 0x678000;
__prg_rom_104_lma = 0x688000;
__prg_rom_105_lma = 0x698000;
__prg_rom_106_lma = 0x6a8000;
__prg_rom_107_lma = 0x6b8000;
__prg_rom_108_lma = 0x6c8000;
__prg_rom_109_lma = 0x6d8000;
__prg_rom_110_lma = 0x6e8000;
__prg_rom_111_lma = 0x6f8000;
__prg_rom_112_lma = 0x708000;
__prg_rom_113_lma = 0x718000;
__prg_rom_114_lma = 0x728000;
__prg_rom_115_lma = 0x738000;
__prg_rom_116_lma = 0x748000;
__prg_rom_117_lma = 0x758000;
__prg_rom_118_lma = 0x768000;
__prg_rom_119_lma = 0x778000;
__prg_rom_120_lma = 0x788000;
__prg_rom_121_lma = 0x798000;
__prg_rom_122_lma = 0x7a8000;
__prg_rom_123_lma = 0x7b8000;
__prg_rom_124_lma = 0x7c8000;
__prg_rom_125_lma = 0x7d8000;
__prg_rom_126_lma = 0x7e8000;
__prg_rom_127_lma = 0x7f8000;
__prg_rom_128_lma = 0x808000;
__prg_rom_129_lma = 0x818000;
__prg_rom_130_lma = 0x828000;
__prg_rom_131_lma = 0x838000;
__prg_rom_132_lma = 0x848000;
__prg_rom_133_lma = 0x858000;
__prg_rom_134_lma = 0x868000;
__prg_rom_135_lma = 0x878000;
__prg_rom_136_lma = 0x888000;
__prg_rom_137_lma = 0x898000;
__prg_rom_138_lma = 0x8a8000;
__prg_rom_139_lma = 0x8b8000;
__prg_rom_140_lma = 0x8c8000;
__prg_rom_141_lma = 0x8d8000;
__prg_rom_142_lma = 0x8e8000;
__prg_rom_143_lma = 0x8f8000;
__prg_rom_144_lma = 0x908000;
__prg_rom_145_lma = 0x918000;
__prg_rom_146_lma = 0x928000;
__prg_rom_147_lma = 0x938000;
__prg_rom_148_lma = 0x948000;
__prg_rom_149_lma = 0x958000;
__prg_rom_150_lma = 0x968000;
__prg_rom_151_lma = 0x978000;
__prg_rom_152_lma = 0x988000;
__prg_rom_153_lma = 0x998000;
__prg_rom_154_lma = 0x9a8000;
__prg_rom_155_lma = 0x9b8000;
__prg_rom_156_lma = 0x9c8000;
__prg_rom_157_lma = 0x9d8000;
__prg_rom_158_lma = 0x9e8000;
__prg_rom_159_lma = 0x9f8000;
__prg_rom_160_lma = 0xa08000;
__prg_rom_161_lma = 0xa18000;
__prg_rom_162_lma = 0xa28000;
__prg_rom_163_lma = 0xa38000;
__prg_rom_164_lma = 0xa48000;
__prg_rom_165_lma = 0xa58000;
__prg_rom_166_lma = 0xa68000;
__prg_rom_167_lma = 0xa78000;
__prg_rom_168_lma = 0xa88000;
__prg_rom_169_lma = 0xa98000;
__prg_rom_170_lma = 0xaa8000;
__prg_rom_171_lma = 0xab8000;
__prg_rom_172_lma = 0xac8000;
__prg_rom_173_lma = 0xad8000;
__prg_rom_174_lma = 0xae8000;
__prg_rom_175_lma = 0xaf8000;
__prg_rom_176_lma = 0xb08000;
__prg_rom_177_lma = 0xb18000;
__prg_rom_178_lma = 0xb28000;
__prg_rom_179_lma = 0xb38000;
__prg_rom_180_lma = 0xb48000;
__prg_rom_181_lma = 0xb58000;
__prg_rom_182_lma = 0xb68000;
__prg_rom_183_lma = 0xb78000;
__prg_rom_184_lma = 0xb88000;
__prg_rom_185_lma = 0xb98000;
__prg_rom_186_lma = 0xba8000;
__prg_rom_187_lma = 0xbb8000;
__prg_rom_188_lma = 0xbc8000;
__prg_rom_189_lma = 0xbd8000;
__prg_rom_190_lma = 0xbe8000;
__prg_rom_191_lma = 0xbf8000;
__prg_rom_192_lma = 0xc08000;
__prg_rom_193_lma = 0xc18000;
__prg_rom_194_lma = 0xc28000;
__prg_rom_195_lma = 0xc38000;
__prg_rom_196_lma = 0xc48000;
__prg_rom_197_lma = 0xc58000;
__prg_rom_198_lma = 0xc68000;
__prg_rom_199_lma = 0xc78000;
__prg_rom_200_lma = 0xc88000;
__prg_rom_201_lma = 0xc98000;
__prg_rom_202_lma = 0xca8000;
__prg_rom_203_lma = 0xcb8000;
__prg_rom_204_lma = 0xcc8000;
__prg_rom_205_lma = 0xcd8000;
__prg_rom_206_lma = 0xce8000;
__prg_rom_207_lma = 0xcf8000;
__prg_rom_208_lma = 0xd08000;
__prg_rom_209_lma = 0xd18000;
__prg_rom_210_lma = 0xd28000;
__prg_rom_211_lma = 0xd38000;
__prg_rom_212_lma = 0xd48000;
__prg_rom_213_lma = 0xd58000;
__prg_rom_214_lma = 0xd68000;
__prg_rom_215_lma = 0xd78000;
__prg_rom_216_lma = 0xd88000;
__prg_rom_217_lma = 0xd98000;
__prg_rom_218_lma = 0xda8000;
__prg_rom_219_lma = 0xdb8000;
__prg_rom_220_lma = 0xdc8000;
__prg_rom_221_lma = 0xdd8000;
__prg_rom_222_lma = 0xde8000;
__prg_rom_223_lma = 0xdf8000;
__prg_rom_224_lma = 0xe08000;
__prg_rom_225_lma = 0xe18000;
__prg_rom_226_lma = 0xe28000;
__prg_rom_227_lma = 0xe38000;
__prg_rom_228_lma = 0xe48000;
__prg_rom_229_lma = 0xe58000;
__prg_rom_230_lma = 0xe68000;
__prg_rom_231_lma = 0xe78000;
__prg_rom_232_lma = 0xe88000;
__prg_rom_233_lma = 0xe98000;
__prg_rom_234_lma = 0xea8000;
__prg_rom_235_lma = 0xeb8000;
__prg_rom_236_lma = 0xec8000;
__prg_rom_237_lma = 0xed8000;
__prg_rom_238_lma = 0xee8000;
__prg_rom_239_lma = 0xef8000;
__prg_rom_240_lma = 0xf08000;
__prg_rom_241_lma = 0xf18000;
__prg_rom_242_lma = 0xf28000;
__prg_rom_243_lma = 0xf38000;
__prg_rom_244_lma = 0xf48000;
__prg_rom_245_lma = 0xf58000;
__prg_rom_246_lma = 0xf68000;
__prg_rom_247_lma = 0xf78000;
__prg_rom_248_lma = 0xf88000;
__prg_rom_249_lma = 0xf98000;
__prg_rom_250_lma = 0xfa8000;
__prg_rom_251_lma = 0xfb8000;
__prg_rom_252_lma = 0xfc8000;
__prg_rom_253_lma = 0xfd8000;
__prg_rom_254_lma = 0xfe8000;
__prg_rom_fixed_lma = 0xc000;

__prg_rom_0_offset = 0x000000;
__prg_rom_1_offset = 0x004000;
__prg_rom_2_offset = 0x008000;
__prg_rom_3_offset = 0x00c000;
__prg_rom_4_offset = 0x010000;
__prg_rom_5_offset = 0x014000;
__prg_rom_6_offset = 0x018000;
__prg_rom_7_offset = 0x01c000;
__prg_rom_8_offset = 0x020000;
__prg_rom_9_offset = 0x024000;
__prg_rom_10_offset = 0x028000;
__prg_rom_11_offset = 0x02c000;
__prg_rom_12_offset = 0x030000;
__prg_rom_13_offset = 0x034000;
__prg_rom_14_offset = 0x038000;
__prg_rom_15_offset = 0x03c000;
__prg_rom_16_offset = 0x040000;
__prg_rom_17_offset = 0x044000;
__prg_rom_18_offset = 0x048000;
__prg_rom_19_offset = 0x04c000;
__prg_rom_20_offset = 0x050000;
__prg_rom_21_offset = 0x054000;
__prg_rom_22_offset = 0x058000;
__prg_rom_23_offset = 0x05c000;
__prg_rom_24_offset = 0x060000;
__prg_rom_25_offset = 0x064000;
__prg_rom_26_offset = 0x068000;
__prg_rom_27_offset = 0x06c000;
__prg_rom_28_offset = 0x070000;
__prg_rom_29_offset = 0x074000;
__prg_rom_30_offset = 0x078000;
__prg_rom_31_offset = 0x07c000;
__prg_rom_32_offset = 0x080000;
__prg_rom_33_offset = 0x084000;
__prg_rom_34_offset = 0x088000;
__prg_rom_35_offset = 0x08c000;
__prg_rom_36_offset = 0x090000;
__prg_rom_37_offset = 0x094000;
__prg_rom_38_offset = 0x098000;
__prg_rom_39_offset = 0x09c000;
__prg_rom_40_offset = 0x0a0000;
__prg_rom_41_offset = 0x0a4000;
__prg_rom_42_offset = 0x0a8000;
__prg_rom_43_offset = 0x0ac000;
__prg_rom_44_offset = 0x0b0000;
__prg_rom_45_offset = 0x0b4000;
__prg_rom_46_offset = 0x0b8000;
__prg_rom_47_offset = 0x0bc000;
__prg_rom_48_offset = 0x0c0000;
__prg_rom_49_offset = 0x0c4000;
__prg_rom_50_offset = 0x0c8000;
__prg_rom_51_offset = 0x0cc000;
__prg_rom_52_offset = 0x0d0000;
__prg_rom_53_offset = 0x0d4000;
__prg_rom_54_offset = 0x0d8000;
__prg_rom_55_offset = 0x0dc000;
__prg_rom_56_offset = 0x0e0000;
__prg_rom_57_offset = 0x0e4000;
__prg_rom_58_offset = 0x0e8000;
__prg_rom_59_offset = 0x0ec000;
__prg_rom_60_offset = 0x0f0000;
__prg_rom_61_offset = 0x0f4000;
__prg_rom_62_offset = 0x0f8000;
__prg_rom_63_offset = 0x0fc000;
__prg_rom_64_offset = 0x100000;
__prg_rom_65_offset = 0x104000;
__prg_rom_66_offset = 0x108000;
__prg_rom_67_offset = 0x10c000;
__prg_rom_68_offset = 0x110000;
__prg_rom_69_offset = 0x114000;
__prg_rom_70_offset = 0x118000;
__prg_rom_71_offset = 0x11c000;
__prg_rom_72_offset = 0x120000;
__prg_rom_73_offset = 0x124000;
__prg_rom_74_offset = 0x128000;
__prg_rom_75_offset = 0x12c000;
__prg_rom_76_offset = 0x130000;
__prg_rom_77_offset = 0x134000;
__prg_rom_78_offset = 0x138000;
__prg_rom_79_offset = 0x13c000;
__prg_rom_80_offset = 0x140000;
__prg_rom_81_offset = 0x144000;
__prg_rom_82_offset = 0x148000;
__prg_rom_83_offset = 0x14c000;
__prg_rom_84_offset = 0x150000;
__prg_rom_85_offset = 0x154000;
__prg_rom_86_offset = 0x158000;
__prg_rom_87_offset = 0x15c000;
__prg_rom_88_offset = 0x160000;
__prg_rom_89_offset = 0x164000;
__prg_rom_90_offset = 0x168000;
__prg_rom_91_offset = 0x16c000;
__prg_rom_92_offset = 0x170000;
__prg_rom_93_offset = 0x174000;
__prg_rom_94_offset = 0x178000;
__prg_rom_95_offset = 0x17c000;
__prg_rom_96_offset = 0x180000;
__prg_rom_97_offset = 0x184000;
__prg_rom_98_offset = 0x188000;
__prg_rom_99_offset = 0x18c000;
__prg_rom_100_offset = 0x190000;
__prg_rom_101_offset = 0x194000;
__prg_rom_102_offset = 0x198000;
__prg_rom_103_offset = 0x19c000;
__prg_rom_104_offset = 0x1a0000;
__prg_rom_105_offset = 0x1a4000;
__prg_rom_106_offset = 0x1a8000;
__prg_rom_107_offset = 0x1ac000;
__prg_rom_108_offset = 0x1b0000;
__prg_rom_109_offset = 0x1b4000;
__prg_rom_110_offset = 0x1b8000;
__prg_rom_111_offset = 0x1bc000;
__prg_rom_112_offset = 0x1c0000;
__prg_rom_113_offset = 0x1c4000;
__prg_rom_114_offset = 0x1c8000;
__prg_rom_115_offset = 0x1cc000;
__prg_rom_116_offset = 0x1d0000;
__prg_rom_117_offset = 0x1d4000;
__prg_rom_118_offset = 0x1d8000;
__prg_rom_119_offset = 0x1dc000;
__prg_rom_120_offset = 0x1e0000;
__prg_rom_121_offset = 0x1e4000;
__prg_rom_122_offset = 0x1e8000;
__prg_rom_123_offset = 0x1ec000;
__prg_rom_124_offset = 0x1f0000;
__prg_rom_125_offset = 0x1f4000;
__prg_rom_126_offset = 0x1f8000;
__prg_rom_127_offset = 0x1fc000;
__prg_rom_128_offset = 0x200000;
__prg_rom_129_offset = 0x204000;
__prg_rom_130_offset = 0x208000;
__prg_rom_131_offset = 0x20c000;
__prg_rom_132_offset = 0x210000;
__prg_rom_133_offset = 0x214000;
__prg_rom_134_offset = 0x218000;
__prg_rom_135_offset = 0x21c000;
__prg_rom_136_offset = 0x220000;
__prg_rom_137_offset = 0x224000;
__prg_rom_138_offset = 0x228000;
__prg_rom_139_offset = 0x22c000;
__prg_rom_140_offset = 0x230000;
__prg_rom_141_offset = 0x234000;
__prg_rom_142_offset = 0x238000;
__prg_rom_143_offset = 0x23c000;
__prg_rom_144_offset = 0x240000;
__prg_rom_145_offset = 0x244000;
__prg_rom_146_offset = 0x248000;
__prg_rom_147_offset = 0x24c000;
__prg_rom_148_offset = 0x250000;
__prg_rom_149_offset = 0x254000;
__prg_rom_150_offset = 0x258000;
__prg_rom_151_offset = 0x25c000;
__prg_rom_152_offset = 0x260000;
__prg_rom_153_offset = 0x264000;
__prg_rom_154_offset = 0x268000;
__prg_rom_155_offset = 0x26c000;
__prg_rom_156_offset = 0x270000;
__prg_rom_157_offset = 0x274000;
__prg_rom_158_offset = 0x278000;
__prg_rom_159_offset = 0x27c000;
__prg_rom_160_offset = 0x280000;
__prg_rom_161_offset = 0x284000;
__prg_rom_162_offset = 0x288000;
__prg_rom_163_offset = 0x28c000;
__prg_rom_164_offset = 0x290000;
__prg_rom_165_offset = 0x294000;
__prg_rom_166_offset = 0x298000;
__prg_rom_167_offset = 0x29c000;
__prg_rom_168_offset = 0x2a0000;
__prg_rom_169_offset = 0x2a4000;
__prg_rom_170_offset = 0x2a8000;
__prg_rom_171_offset = 0x2ac000;
__prg_rom_172_offset = 0x2b0000;
__prg_rom_173_offset = 0x2b4000;
__prg_rom_174_offset = 0x2b8000;
__prg_rom_175_offset = 0x2bc000;
__prg_rom_176_offset = 0x2c0000;
__prg_rom_177_offset = 0x2c4000;
__prg_rom_178_offset = 0x2c8000;
__prg_rom_179_offset = 0x2cc000;
__prg_rom_180_offset = 0x2d0000;
__prg_rom_181_offset = 0x2d4000;
__prg_rom_182_offset = 0x2d8000;
__prg_rom_183_offset = 0x2dc000;
__prg_rom_184_offset = 0x2e0000;
__prg_rom_185_offset = 0x2e4000;
__prg_rom_186_offset = 0x2e8000;
__prg_rom_187_offset = 0x2ec000;
__prg_rom_188_offset = 0x2f0000;
__prg_rom_189_offset = 0x2f4000;
__prg_rom_190_offset = 0x2f8000;
__prg_rom_191_offset = 0x2fc000;
__prg_rom_192_offset = 0x300000;
__prg_rom_193_offset = 0x304000;
__prg_rom_194_offset = 0x308000;
__prg_rom_195_offset = 0x30c000;
__prg_rom_196_offset = 0x310000;
__prg_rom_197_offset = 0x314000;
__prg_rom_198_offset = 0x318000;
__prg_rom_199_offset = 0x31c000;
__prg_rom_200_offset = 0x320000;
__prg_rom_201_offset = 0x324000;
__prg_rom_202_offset = 0x328000;
__prg_rom_203_offset = 0x32c000;
__prg_rom_204_offset = 0x330000;
__prg_rom_205_offset = 0x334000;
__prg_rom_206_offset = 0x338000;
__prg_rom_207_offset = 0x33c000;
__prg_rom_208_offset = 0x340000;
__prg_rom_209_offset = 0x344000;
__prg_rom_210_offset = 0x348000;
__prg_rom_211_offset = 0x34c000;
__prg_rom_212_offset = 0x350000;
__prg_rom_213_offset = 0x354000;
__prg_rom_214_offset = 0x358000;
__prg_rom_215_offset = 0x35c000;
__prg_rom_216_offset = 0x360000;
__prg_rom_217_offset = 0x364000;
__prg_rom_218_offset = 0x368000;
__prg_rom_219_offset = 0x36c000;
__prg_rom_220_offset = 0x370000;
__prg_rom_221_offset = 0x374000;
__prg_rom_222_offset = 0x378000;
__prg_rom_223_offset = 0x37c000;
__prg_rom_224_offset = 0x380000;
__prg_rom_225_offset = 0x384000;
__prg_rom_226_offset = 0x388000;
__prg_rom_227_offset = 0x38c000;
__prg_rom_228_offset = 0x390000;
__prg_rom_229_offset = 0x394000;
__prg_rom_230_offset = 0x398000;
__prg_rom_231_offset = 0x39c000;
__prg_rom_232_offset = 0x3a0000;
__prg_rom_233_offset = 0x3a4000;
__prg_rom_234_offset = 0x3a8000;
__prg_rom_235_offset = 0x3ac000;
__prg_rom_236_offset = 0x3b0000;
__prg_rom_237_offset = 0x3b4000;
__prg_rom_238_offset = 0x3b8000;
__prg_rom_239_offset = 0x3bc000;
__prg_rom_240_offset = 0x3c0000;
__prg_rom_241_offset = 0x3c4000;
__prg_rom_242_offset = 0x3c8000;
__prg_rom_243_offset = 0x3cc000;
__prg_rom_244_offset = 0x3d0000;
__prg_rom_245_offset = 0x3d4000;
__prg_rom_246_offset = 0x3d8000;
__prg_rom_247_offset = 0x3dc000;
__prg_rom_248_offset = 0x3e0000;
__prg_rom_249_offset = 0x3e4000;
__prg_rom_250_offset = 0x3e8000;
__prg_rom_251_offset = 0x3ec000;
__prg_rom_252_offset = 0x3f0000;
__prg_rom_253_offset = 0x3f4000;
__prg_rom_254_offset = 0x3f8000;
__prg_rom_fixed_offset = __prg_rom_size * 1024 - 0x4000;

MEMORY {
  /* PRG-ROM LMAs. */
  prg_rom_0 : ORIGIN = __prg_rom_0_lma, LENGTH = __prg_rom_size >= 32 ? 0x4000 : 0
  prg_rom_1 : ORIGIN = __prg_rom_1_lma, LENGTH = __prg_rom_size >= 64 ? 0x4000 : 0
  prg_rom_2 : ORIGIN = __prg_rom_2_lma, LENGTH = __prg_rom_size >= 64 ? 0x4000 : 0
  prg_rom_3 : ORIGIN = __prg_rom_3_lma, LENGTH = __prg_rom_size >= 128 ? 0x4000 : 0
  prg_rom_4 : ORIGIN = __prg_rom_4_lma, LENGTH = __prg_rom_size >= 128 ? 0x4000 : 0
  prg_rom_5 : ORIGIN = __prg_rom_5_lma, LENGTH = __prg_rom_size >= 128 ? 0x4000 : 0
  prg_rom_6 : ORIGIN = __prg_rom_6_lma, LENGTH = __prg_rom_size >= 128 ? 0x4000 : 0
  prg_rom_7 : ORIGIN = __prg_rom_7_lma, LENGTH = __prg_rom_size >= 256 ? 0x4000 : 0
  prg_rom_8 : ORIGIN = __prg_rom_8_lma, LENGTH = __prg_rom_size >= 256 ? 0x4000 : 0
  prg_rom_9 : ORIGIN = __prg_rom_9_lma, LENGTH = __prg_rom_size >= 256 ? 0x4000 : 0
  prg_rom_10 : ORIGIN = __prg_rom_10_lma, LENGTH = __prg_rom_size >= 256 ? 0x4000 : 0
  prg_rom_11 : ORIGIN = __prg_rom_11_lma, LENGTH = __prg_rom_size >= 256 ? 0x4000 : 0
  prg_rom_12 : ORIGIN = __prg_rom_12_lma, LENGTH = __prg_rom_size >= 256 ? 0x4000 : 0
  prg_rom_13 : ORIGIN = __prg_rom_13_lma, LENGTH = __prg_rom_size >= 256 ? 0x4000 : 0
  prg_rom_14 : ORIGIN = __prg_rom_14_lma, LENGTH = __prg_rom_size >= 256 ? 0x4000 : 0
  prg_rom_15 : ORIGIN = __prg_rom_15_lma, LENGTH = __prg_rom_size >= 512 ? 0x4000 : 0
  prg_rom_16 : ORIGIN = __prg_rom_16_lma, LENGTH = __prg_rom_size >= 512 ? 0x4000 : 0
  prg_rom_17 : ORIGIN = __prg_rom_17_lma, LENGTH = __prg_rom_size >= 512 ? 0x4000 : 0
  prg_rom_18 : ORIGIN = __prg_rom_18_lma, LENGTH = __prg_rom_size >= 512 ? 0x4000 : 0
  prg_rom_19 : ORIGIN = __prg_rom_19_lma, LENGTH = __prg_rom_size >= 512 ? 0x4000 : 0
  prg_rom_20 : ORIGIN = __prg_rom_20_lma, LENGTH = __prg_rom_size >= 512 ? 0x4000 : 0
  prg_rom_21 : ORIGIN = __prg_rom_21_lma, LENGTH = __prg_rom_size >= 512 ? 0x4000 : 0
  prg_rom_22 : ORIGIN = __prg_rom_22_lma, LENGTH = __prg_rom_size >= 512 ? 0x4000 : 0
  prg_rom_23 : ORIGIN = __prg_rom_23_lma, LENGTH = __prg_rom_size >= 512 ? 0x4000 : 0
  prg_rom_24 : ORIGIN = __prg_rom_24_lma, LENGTH = __prg_rom_size >= 512 ? 0x4000 : 0
  prg_rom_25 : ORIGIN = __prg_rom_25_lma, LENGTH = __prg_rom_size >= 512 ? 0x4000 : 0
  prg_rom_26 : ORIGIN = __prg_rom_26_lma, LENGTH = __prg_rom_size >= 512 ? 0x4000 : 0
  prg_rom_27 : ORIGIN = __prg_rom_27_lma, LENGTH = __prg_rom_size >= 512 ? 0x4000 : 0
  prg_rom_28 : ORIGIN = __prg_rom_28_lma, LENGTH = __prg_rom_size >= 512 ? 0x4000 : 0
  prg_rom_29 : ORIGIN = __prg_rom_29_lma, LENGTH = __prg_rom_size >= 512 ? 0x4000 : 0
  prg_rom_30 : ORIGIN = __prg_rom_30_lma, LENGTH = __prg_rom_size >= 512 ? 0x4000 : 0
  prg_rom_31 : ORIGIN = __prg_rom_31_lma, LENGTH = __prg_rom_size >= 1024 ? 0x4000 : 0
  prg_rom_32 : ORIGIN = __prg_rom_32_lma, LENGTH = __prg_rom_size >= 1024 ? 0x4000 : 0
  prg_rom_33 : ORIGIN = __prg_rom_33_lma, LENGTH = __prg_rom_size >= 1024 ? 0x4000 : 0
  prg_rom_34 : ORIGIN = __prg_rom_34_lma, LENGTH = __prg_rom_size >= 1024 ? 0x4000 : 0
  prg_rom_35 : ORIGIN = __prg_rom_35_lma, LENGTH = __prg_rom_size >= 1024 ? 0x4000 : 0
  prg_rom_36 : ORIGIN = __prg_rom_36_lma, LENGTH = __prg_rom_size >= 1024 ? 0x4000 : 0
  prg_rom_37 : ORIGIN = __prg_rom_37_lma, LENGTH = __prg_rom_size >= 1024 ? 0x4000 : 0
  prg_rom_38 : ORIGIN = __prg_rom_38_lma, LENGTH = __prg_rom_size >= 1024 ? 0x4000 : 0
  prg_rom_39 : ORIGIN = __prg_rom_39_lma, LENGTH = __prg_rom_size >= 1024 ? 0x4000 : 0
  prg_rom_40 : ORIGIN = __prg_rom_40_lma, LENGTH = __prg_rom_size >= 1024 ? 0x4000 : 0
  prg_rom_41 : ORIGIN = __prg_rom_41_lma, LENGTH = __prg_rom_size >= 1024 ? 0x4000 : 0
  prg_rom_42 : ORIGIN = __prg_rom_42_lma, LENGTH = __prg_rom_size >= 1024 ? 0x4000 : 0
  prg_rom_43 : ORIGIN = __prg_rom_43_lma, LENGTH = __prg_rom_size >= 1024 ? 0x4000 : 0
  prg_rom_44 : ORIGIN = __prg_rom_44_lma, LENGTH = __prg_rom_size >= 1024 ? 0x4000 : 0
  prg_rom_45 : ORIGIN = __prg_rom_45_lma, LENGTH = __prg_rom_size >= 1024 ? 0x4000 : 0
  prg_rom_46 : ORIGIN = __prg_rom_46_lma, LENGTH = __prg_rom_size >= 1024 ? 0x4000 : 0
  prg_rom_47 : ORIGIN = __prg_rom_47_lma, LENGTH = __prg_rom_size >= 1024 ? 0x4000 : 0
  prg_rom_48 : ORIGIN = __prg_rom_48_lma, LENGTH = __prg_rom_size >= 1024 ? 0x4000 : 0
  prg_rom_49 : ORIGIN = __prg_rom_49_lma, LENGTH = __prg_rom_size >= 1024 ? 0x4000 : 0
  prg_rom_50 : ORIGIN = __prg_rom_50_lma, LENGTH = __prg_rom_size >= 1024 ? 0x4000 : 0
  prg_rom_51 : ORIGIN = __prg_rom_51_lma, LENGTH = __prg_rom_size >= 1024 ? 0x4000 : 0
  prg_rom_52 : ORIGIN = __prg_rom_52_lma, LENGTH = __prg_rom_size >= 1024 ? 0x4000 : 0
  prg_rom_53 : ORIGIN = __prg_rom_53_lma, LENGTH = __prg_rom_size >= 1024 ? 0x4000 : 0
  prg_rom_54 : ORIGIN = __prg_rom_54_lma, LENGTH = __prg_rom_size >= 1024 ? 0x4000 : 0
  prg_rom_55 : ORIGIN = __prg_rom_55_lma, LENGTH = __prg_rom_size >= 1024 ? 0x4000 : 0
  prg_rom_56 : ORIGIN = __prg_rom_56_lma, LENGTH = __prg_rom_size >= 1024 ? 0x4000 : 0
  prg_rom_57 : ORIGIN = __prg_rom_57_lma, LENGTH = __prg_rom_size >= 1024 ? 0x4000 : 0
  prg_rom_58 : ORIGIN = __prg_rom_58_lma, LENGTH = __prg_rom_size >= 1024 ? 0x4000 : 0
  prg_rom_59 : ORIGIN = __prg_rom_59_lma, LENGTH = __prg_rom_size >= 1024 ? 0x4000 : 0
  prg_rom_60 : ORIGIN = __prg_rom_60_lma, LENGTH = __prg_rom_size >= 1024 ? 0x4000 : 0
  prg_rom_61 : ORIGIN = __prg_rom_61_lma, LENGTH = __prg_rom_size >= 1024 ? 0x4000 : 0
  prg_rom_62 : ORIGIN = __prg_rom_62_lma, LENGTH = __prg_rom_size >= 1024 ? 0x4000 : 0
  prg_rom_63 : ORIGIN = __prg_rom_63_lma, LENGTH = __prg_rom_size >= 2048 ? 0x4000 : 0
  prg_rom_64 : ORIGIN = __prg_rom_64_lma, LENGTH = __prg_rom_size >= 2048 ? 0x4000 : 0
  prg_rom_65 : ORIGIN = __prg_rom_65_lma, LENGTH = __prg_rom_size >= 2048 ? 0x4000 : 0
  prg_rom_66 : ORIGIN = __prg_rom_66_lma, LENGTH = __prg_rom_size >= 2048 ? 0x4000 : 0
  prg_rom_67 : ORIGIN = __prg_rom_67_lma, LENGTH = __prg_rom_size >= 2048 ? 0x4000 : 0
  prg_rom_68 : ORIGIN = __prg_rom_68_lma, LENGTH = __prg_rom_size >= 2048 ? 0x4000 : 0
  prg_rom_69 : ORIGIN = __prg_rom_69_lma, LENGTH = __prg_rom_size >= 2048 ? 0x4000 : 0
  prg_rom_70 : ORIGIN = __prg_rom_70_lma, LENGTH = __prg_rom_size >= 2048 ? 0x4000 : 0
  prg_rom_71 : ORIGIN = __prg_rom_71_lma, LENGTH = __prg_rom_size >= 2048 ? 0x4000 : 0
  prg_rom_72 : ORIGIN = __prg_rom_72_lma, LENGTH = __prg_rom_size >= 2048 ? 0x4000 : 0
  prg_rom_73 : ORIGIN = __prg_rom_73_lma, LENGTH = __prg_rom_size >= 2048 ? 0x4000 : 0
  prg_rom_74 : ORIGIN = __prg_rom_74_lma, LENGTH = __prg_rom_size >= 2048 ? 0x4000 : 0
  prg_rom_75 : ORIGIN = __prg_rom_75_lma, LENGTH = __prg_rom_size >= 2048 ? 0x4000 : 0
  prg_rom_76 : ORIGIN = __prg_rom_76_lma, LENGTH = __prg_rom_size >= 2048 ? 0x4000 : 0
  prg_rom_77 : ORIGIN = __prg_rom_77_lma, LENGTH = __prg_rom_size >= 2048 ? 0x4000 : 0
  prg_rom_78 : ORIGIN = __prg_rom_78_lma, LENGTH = __prg_rom_size >= 2048 ? 0x4000 : 0
  prg_rom_79 : ORIGIN = __prg_rom_79_lma, LENGTH = __prg_rom_size >= 2048 ? 0x4000 : 0
  prg_rom_80 : ORIGIN = __prg_rom_80_lma, LENGTH = __prg_rom_size >= 2048 ? 0x4000 : 0
  prg_rom_81 : ORIGIN = __prg_rom_81_lma, LENGTH = __prg_rom_size >= 2048 ? 0x4000 : 0
  prg_rom_82 : ORIGIN = __prg_rom_82_lma, LENGTH = __prg_rom_size >= 2048 ? 0x4000 : 0
  prg_rom_83 : ORIGIN = __prg_rom_83_lma, LENGTH = __prg_rom_size >= 2048 ? 0x4000 : 0
  prg_rom_84 : ORIGIN = __prg_rom_84_lma, LENGTH = __prg_rom_size >= 2048 ? 0x4000 : 0
  prg_rom_85 : ORIGIN = __prg_rom_85_lma, LENGTH = __prg_rom_size >= 2048 ? 0x4000 : 0
  prg_rom_86 : ORIGIN = __prg_rom_86_lma, LENGTH = __prg_rom_size >= 2048 ? 0x4000 : 0
  prg_rom_87 : ORIGIN = __prg_rom_87_lma, LENGTH = __prg_rom_size >= 2048 ? 0x4000 : 0
  prg_rom_88 : ORIGIN = __prg_rom_88_lma, LENGTH = __prg_rom_size >= 2048 ? 0x4000 : 0
  prg_rom_89 : ORIGIN = __prg_rom_89_lma, LENGTH = __prg_rom_size >= 2048 ? 0x4000 : 0
  prg_rom_90 : ORIGIN = __prg_rom_90_lma, LENGTH = __prg_rom_size >= 2048 ? 0x4000 : 0
  prg_rom_91 : ORIGIN = __prg_rom_91_lma, LENGTH = __prg_rom_size >= 2048 ? 0x4000 : 0
  prg_rom_92 : ORIGIN = __prg_rom_92_lma, LENGTH = __prg_rom_size >= 2048 ? 0x4000 : 0
  prg_rom_93 : ORIGIN = __prg_rom_93_lma, LENGTH = __prg_rom_size >= 2048 ? 0x4000 : 0
  prg_rom_94 : ORIGIN = __prg_rom_94_lma, LENGTH = __prg_rom_size >= 2048 ? 0x4000 : 0
  prg_rom_95 : ORIGIN = __prg_rom_95_lma, LENGTH = __prg_rom_size >= 2048 ? 0x4000 : 0
  prg_rom_96 : ORIGIN = __prg_rom_96_lma, LENGTH = __prg_rom_size >= 2048 ? 0x4000 : 0
  prg_rom_97 : ORIGIN = __prg_rom_97_lma, LENGTH = __prg_rom_size >= 2048 ? 0x4000 : 0
  prg_rom_98 : ORIGIN = __prg_rom_98_lma, LENGTH = __prg_rom_size >= 2048 ? 0x4000 : 0
  prg_rom_99 : ORIGIN = __prg_rom_99_lma, LENGTH = __prg_rom_size >= 2048 ? 0x4000 : 0
  prg_rom_100 : ORIGIN = __prg_rom_100_lma, LENGTH = __prg_rom_size >= 2048 ? 0x4000 : 0
  prg_rom_101 : ORIGIN = __prg_rom_101_lma, LENGTH = __prg_rom_size >= 2048 ? 0x4000 : 0
  prg_rom_102 : ORIGIN = __prg_rom_102_lma, LENGTH = __prg_rom_size >= 2048 ? 0x4000 : 0
  prg_rom_103 : ORIGIN = __prg_rom_103_lma, LENGTH = __prg_rom_size >= 2048 ? 0x4000 : 0
  prg_rom_104 : ORIGIN = __prg_rom_104_lma, LENGTH = __prg_rom_size >= 2048 ? 0x4000 : 0
  prg_rom_105 : ORIGIN = __prg_rom_105_lma, LENGTH = __prg_rom_size >= 2048 ? 0x4000 : 0
  prg_rom_106 : ORIGIN = __prg_rom_106_lma, LENGTH = __prg_rom_size >= 2048 ? 0x4000 : 0
  prg_rom_107 : ORIGIN = __prg_rom_107_lma, LENGTH = __prg_rom_size >= 2048 ? 0x4000 : 0
  prg_rom_108 : ORIGIN = __prg_rom_108_lma, LENGTH = __prg_rom_size >= 2048 ? 0x4000 : 0
  prg_rom_109 : ORIGIN = __prg_rom_109_lma, LENGTH = __prg_rom_size >= 2048 ? 0x4000 : 0
  prg_rom_110 : ORIGIN = __prg_rom_110_lma, LENGTH = __prg_rom_size >= 2048 ? 0x4000 : 0
  prg_rom_111 : ORIGIN = __prg_rom_111_lma, LENGTH = __prg_rom_size >= 2048 ? 0x4000 : 0
  prg_rom_112 : ORIGIN = __prg_rom_112_lma, LENGTH = __prg_rom_size >= 2048 ? 0x4000 : 0
  prg_rom_113 : ORIGIN = __prg_rom_113_lma, LENGTH = __prg_rom_size >= 2048 ? 0x4000 : 0
  prg_rom_114 : ORIGIN = __prg_rom_114_lma, LENGTH = __prg_rom_size >= 2048 ? 0x4000 : 0
  prg_rom_115 : ORIGIN = __prg_rom_115_lma, LENGTH = __prg_rom_size >= 2048 ? 0x4000 : 0
  prg_rom_116 : ORIGIN = __prg_rom_116_lma, LENGTH = __prg_rom_size >= 2048 ? 0x4000 : 0
  prg_rom_117 : ORIGIN = __prg_rom_117_lma, LENGTH = __prg_rom_size >= 2048 ? 0x4000 : 0
  prg_rom_118 : ORIGIN = __prg_rom_118_lma, LENGTH = __prg_rom_size >= 2048 ? 0x4000 : 0
  prg_rom_119 : ORIGIN = __prg_rom_119_lma, LENGTH = __prg_rom_size >= 2048 ? 0x4000 : 0
  prg_rom_120 : ORIGIN = __prg_rom_120_lma, LENGTH = __prg_rom_size >= 2048 ? 0x4000 : 0
  prg_rom_121 : ORIGIN = __prg_rom_121_lma, LENGTH = __prg_rom_size >= 2048 ? 0x4000 : 0
  prg_rom_122 : ORIGIN = __prg_rom_122_lma, LENGTH = __prg_rom_size >= 2048 ? 0x4000 : 0
  prg_rom_123 : ORIGIN = __prg_rom_123_lma, LENGTH = __prg_rom_size >= 2048 ? 0x4000 : 0
  prg_rom_124 : ORIGIN = __prg_rom_124_lma, LENGTH = __prg_rom_size >= 2048 ? 0x4000 : 0
  prg_rom_125 : ORIGIN = __prg_rom_125_lma, LENGTH = __prg_rom_size >= 2048 ? 0x4000 : 0
  prg_rom_126 : ORIGIN = __prg_rom_126_lma, LENGTH = __prg_rom_size >= 2048 ? 0x4000 : 0
  prg_rom_127 : ORIGIN = __prg_rom_127_lma, LENGTH = __prg_rom_size >= 4096 ? 0x4000 : 0
  prg_rom_128 : ORIGIN = __prg_rom_128_lma, LENGTH = __prg_rom_size >= 4096 ? 0x4000 : 0
  prg_rom_129 : ORIGIN = __prg_rom_129_lma, LENGTH = __prg_rom_size >= 4096 ? 0x4000 : 0
  prg_rom_130 : ORIGIN = __prg_rom_130_lma, LENGTH = __prg_rom_size >= 4096 ? 0x4000 : 0
  prg_rom_131 : ORIGIN = __prg_rom_131_lma, LENGTH = __prg_rom_size >= 4096 ? 0x4000 : 0
  prg_rom_132 : ORIGIN = __prg_rom_132_lma, LENGTH = __prg_rom_size >= 4096 ? 0x4000 : 0
  prg_rom_133 : ORIGIN = __prg_rom_133_lma, LENGTH = __prg_rom_size >= 4096 ? 0x4000 : 0
  prg_rom_134 : ORIGIN = __prg_rom_134_lma, LENGTH = __prg_rom_size >= 4096 ? 0x4000 : 0
  prg_rom_135 : ORIGIN = __prg_rom_135_lma, LENGTH = __prg_rom_size >= 4096 ? 0x4000 : 0
  prg_rom_136 : ORIGIN = __prg_rom_136_lma, LENGTH = __prg_rom_size >= 4096 ? 0x4000 : 0
  prg_rom_137 : ORIGIN = __prg_rom_137_lma, LENGTH = __prg_rom_size >= 4096 ? 0x4000 : 0
  prg_rom_138 : ORIGIN = __prg_rom_138_lma, LENGTH = __prg_rom_size >= 4096 ? 0x4000 : 0
  prg_rom_139 : ORIGIN = __prg_rom_139_lma, LENGTH = __prg_rom_size >= 4096 ? 0x4000 : 0
  prg_rom_140 : ORIGIN = __prg_rom_140_lma, LENGTH = __prg_rom_size >= 4096 ? 0x4000 : 0
  prg_rom_141 : ORIGIN = __prg_rom_141_lma, LENGTH = __prg_rom_size >= 4096 ? 0x4000 : 0
  prg_rom_142 : ORIGIN = __prg_rom_142_lma, LENGTH = __prg_rom_size >= 4096 ? 0x4000 : 0
  prg_rom_143 : ORIGIN = __prg_rom_143_lma, LENGTH = __prg_rom_size >= 4096 ? 0x4000 : 0
  prg_rom_144 : ORIGIN = __prg_rom_144_lma, LENGTH = __prg_rom_size >= 4096 ? 0x4000 : 0
  prg_rom_145 : ORIGIN = __prg_rom_145_lma, LENGTH = __prg_rom_size >= 4096 ? 0x4000 : 0
  prg_rom_146 : ORIGIN = __prg_rom_146_lma, LENGTH = __prg_rom_size >= 4096 ? 0x4000 : 0
  prg_rom_147 : ORIGIN = __prg_rom_147_lma, LENGTH = __prg_rom_size >= 4096 ? 0x4000 : 0
  prg_rom_148 : ORIGIN = __prg_rom_148_lma, LENGTH = __prg_rom_size >= 4096 ? 0x4000 : 0
  prg_rom_149 : ORIGIN = __prg_rom_149_lma, LENGTH = __prg_rom_size >= 4096 ? 0x4000 : 0
  prg_rom_150 : ORIGIN = __prg_rom_150_lma, LENGTH = __prg_rom_size >= 4096 ? 0x4000 : 0
  prg_rom_151 : ORIGIN = __prg_rom_151_lma, LENGTH = __prg_rom_size >= 4096 ? 0x4000 : 0
  prg_rom_152 : ORIGIN = __prg_rom_152_lma, LENGTH = __prg_rom_size >= 4096 ? 0x4000 : 0
  prg_rom_153 : ORIGIN = __prg_rom_153_lma, LENGTH = __prg_rom_size >= 4096 ? 0x4000 : 0
  prg_rom_154 : ORIGIN = __prg_rom_154_lma, LENGTH = __prg_rom_size >= 4096 ? 0x4000 : 0
  prg_rom_155 : ORIGIN = __prg_rom_155_lma, LENGTH = __prg_rom_size >= 4096 ? 0x4000 : 0
  prg_rom_156 : ORIGIN = __prg_rom_156_lma, LENGTH = __prg_rom_size >= 4096 ? 0x4000 : 0
  prg_rom_157 : ORIGIN = __prg_rom_157_lma, LENGTH = __prg_rom_size >= 4096 ? 0x4000 : 0
  prg_rom_158 : ORIGIN = __prg_rom_158_lma, LENGTH = __prg_rom_size >= 4096 ? 0x4000 : 0
  prg_rom_159 : ORIGIN = __prg_rom_159_lma, LENGTH = __prg_rom_size >= 4096 ? 0x4000 : 0
  prg_rom_160 : ORIGIN = __prg_rom_160_lma, LENGTH = __prg_rom_size >= 4096 ? 0x4000 : 0
  prg_rom_161 : ORIGIN = __prg_rom_161_lma, LENGTH = __prg_rom_size >= 4096 ? 0x4000 : 0
  prg_rom_162 : ORIGIN = __prg_rom_162_lma, LENGTH = __prg_rom_size >= 4096 ? 0x4000 : 0
  prg_rom_163 : ORIGIN = __prg_rom_163_lma, LENGTH = __prg_rom_size >= 4096 ? 0x4000 : 0
  prg_rom_164 : ORIGIN = __prg_rom_164_lma, LENGTH = __prg_rom_size >= 4096 ? 0x4000 : 0
  prg_rom_165 : ORIGIN = __prg_rom_165_lma, LENGTH = __prg_rom_size >= 4096 ? 0x4000 : 0
  prg_rom_166 : ORIGIN = __prg_rom_166_lma, LENGTH = __prg_rom_size >= 4096 ? 0x4000 : 0
  prg_rom_167 : ORIGIN = __prg_rom_167_lma, LENGTH = __prg_rom_size >= 4096 ? 0x4000 : 0
  prg_rom_168 : ORIGIN = __prg_rom_168_lma, LENGTH = __prg_rom_size >= 4096 ? 0x4000 : 0
  prg_rom_169 : ORIGIN = __prg_rom_169_lma, LENGTH = __prg_rom_size >= 4096 ? 0x4000 : 0
  prg_rom_170 : ORIGIN = __prg_rom_170_lma, LENGTH = __prg_rom_size >= 4096 ? 0x4000 : 0
  prg_rom_171 : ORIGIN = __prg_rom_171_lma, LENGTH = __prg_rom_size >= 4096 ? 0x4000 : 0
  prg_rom_172 : ORIGIN = __prg_rom_172_lma, LENGTH = __prg_rom_size >= 4096 ? 0x4000 : 0
  prg_rom_173 : ORIGIN = __prg_rom_173_lma, LENGTH = __prg_rom_size >= 4096 ? 0x4000 : 0
  prg_rom_174 : ORIGIN = __prg_rom_174_lma, LENGTH = __prg_rom_size >= 4096 ? 0x4000 : 0
  prg_rom_175 : ORIGIN = __prg_rom_175_lma, LENGTH = __prg_rom_size >= 4096 ? 0x4000 : 0
  prg_rom_176 : ORIGIN = __prg_rom_176_lma, LENGTH = __prg_rom_size >= 4096 ? 0x4000 : 0
  prg_rom_177 : ORIGIN = __prg_rom_177_lma, LENGTH = __prg_rom_size >= 4096 ? 0x4000 : 0
  prg_rom_178 : ORIGIN = __prg_rom_178_lma, LENGTH = __prg_rom_size >= 4096 ? 0x4000 : 0
  prg_rom_179 : ORIGIN = __prg_rom_179_lma, LENGTH = __prg_rom_size >= 4096 ? 0x4000 : 0
  prg_rom_180 : ORIGIN = __prg_rom_180_lma, LENGTH = __prg_rom_size >= 4096 ? 0x4000 : 0
  prg_rom_181 : ORIGIN = __prg_rom_181_lma, LENGTH = __prg_rom_size >= 4096 ? 0x4000 : 0
  prg_rom_182 : ORIGIN = __prg_rom_182_lma, LENGTH = __prg_rom_size >= 4096 ? 0x4000 : 0
  prg_rom_183 : ORIGIN = __prg_rom_183_lma, LENGTH = __prg_rom_size >= 4096 ? 0x4000 : 0
  prg_rom_184 : ORIGIN = __prg_rom_184_lma, LENGTH = __prg_rom_size >= 4096 ? 0x4000 : 0
  prg_rom_185 : ORIGIN = __prg_rom_185_lma, LENGTH = __prg_rom_size >= 4096 ? 0x4000 : 0
  prg_rom_186 : ORIGIN = __prg_rom_186_lma, LENGTH = __prg_rom_size >= 4096 ? 0x4000 : 0
  prg_rom_187 : ORIGIN = __prg_rom_187_lma, LENGTH = __prg_rom_size >= 4096 ? 0x4000 : 0
  prg_rom_188 : ORIGIN = __prg_rom_188_lma, LENGTH = __prg_rom_size >= 4096 ? 0x4000 : 0
  prg_rom_189 : ORIGIN = __prg_rom_189_lma, LENGTH = __prg_rom_size >= 4096 ? 0x4000 : 0
  prg_rom_190 : ORIGIN = __prg_rom_190_lma, LENGTH = __prg_rom_size >= 4096 ? 0x4000 : 0
  prg_rom_191 : ORIGIN = __prg_rom_191_lma, LENGTH = __prg_rom_size >= 4096 ? 0x4000 : 0
  prg_rom_192 : ORIGIN = __prg_rom_192_lma, LENGTH = __prg_rom_size >= 4096 ? 0x4000 : 0
  prg_rom_193 : ORIGIN = __prg_rom_193_lma, LENGTH = __prg_rom_size >= 4096 ? 0x4000 : 0
  prg_rom_194 : ORIGIN = __prg_rom_194_lma, LENGTH = __prg_rom_size >= 4096 ? 0x4000 : 0
  prg_rom_195 : ORIGIN = __prg_rom_195_lma, LENGTH = __prg_rom_size >= 4096 ? 0x4000 : 0
  prg_rom_196 : ORIGIN = __prg_rom_196_lma, LENGTH = __prg_rom_size >= 4096 ? 0x4000 : 0
  prg_rom_197 : ORIGIN = __prg_rom_197_lma, LENGTH = __prg_rom_size >= 4096 ? 0x4000 : 0
  prg_rom_198 : ORIGIN = __prg_rom_198_lma, LENGTH = __prg_rom_size >= 4096 ? 0x4000 : 0
  prg_rom_199 : ORIGIN = __prg_rom_199_lma, LENGTH = __prg_rom_size >= 4096 ? 0x4000 : 0
  prg_rom_200 : ORIGIN = __prg_rom_200_lma, LENGTH = __prg_rom_size >= 4096 ? 0x4000 : 0
  prg_rom_201 : ORIGIN = __prg_rom_201_lma, LENGTH = __prg_rom_size >= 4096 ? 0x4000 : 0
  prg_rom_202 : ORIGIN = __prg_rom_202_lma, LENGTH = __prg_rom_size >= 4096 ? 0x4000 : 0
  prg_rom_203 : ORIGIN = __prg_rom_203_lma, LENGTH = __prg_rom_size >= 4096 ? 0x4000 : 0
  prg_rom_204 : ORIGIN = __prg_rom_204_lma, LENGTH = __prg_rom_size >= 4096 ? 0x4000 : 0
  prg_rom_205 : ORIGIN = __prg_rom_205_lma, LENGTH = __prg_rom_size >= 4096 ? 0x4000 : 0
  prg_rom_206 : ORIGIN = __prg_rom_206_lma, LENGTH = __prg_rom_size >= 4096 ? 0x4000 : 0
  prg_rom_207 : ORIGIN = __prg_rom_207_lma, LENGTH = __prg_rom_size >= 4096 ? 0x4000 : 0
  prg_rom_208 : ORIGIN = __prg_rom_208_lma, LENGTH = __prg_rom_size >= 4096 ? 0x4000 : 0
  prg_rom_209 : ORIGIN = __prg_rom_209_lma, LENGTH = __prg_rom_size >= 4096 ? 0x4000 : 0
  prg_rom_210 : ORIGIN = __prg_rom_210_lma, LENGTH = __prg_rom_size >= 4096 ? 0x4000 : 0
  prg_rom_211 : ORIGIN = __prg_rom_211_lma, LENGTH = __prg_rom_size >= 4096 ? 0x4000 : 0
  prg_rom_212 : ORIGIN = __prg_rom_212_lma, LENGTH = __prg_rom_size >= 4096 ? 0x4000 : 0
  prg_rom_213 : ORIGIN = __prg_rom_213_lma, LENGTH = __prg_rom_size >= 4096 ? 0x4000 : 0
  prg_rom_214 : ORIGIN = __prg_rom_214_lma, LENGTH = __prg_rom_size >= 4096 ? 0x4000 : 0
  prg_rom_215 : ORIGIN = __prg_rom_215_lma, LENGTH = __prg_rom_size >= 4096 ? 0x4000 : 0
  prg_rom_216 : ORIGIN = __prg_rom_216_lma, LENGTH = __prg_rom_size >= 4096 ? 0x4000 : 0
  prg_rom_217 : ORIGIN = __prg_rom_217_lma, LENGTH = __prg_rom_size >= 4096 ? 0x4000 : 0
  prg_rom_218 : ORIGIN = __prg_rom_218_lma, LENGTH = __prg_rom_size >= 4096 ? 0x4000 : 0
  prg_rom_219 : ORIGIN = __prg_rom_219_lma, LENGTH = __prg_rom_size >= 4096 ? 0x4000 : 0
  prg_rom_220 : ORIGIN = __prg_rom_220_lma, LENGTH = __prg_rom_size >= 4096 ? 0x4000 : 0
  prg_rom_221 : ORIGIN = __prg_rom_221_lma, LENGTH = __prg_rom_size >= 4096 ? 0x4000 : 0
  prg_rom_222 : ORIGIN = __prg_rom_222_lma, LENGTH = __prg_rom_size >= 4096 ? 0x4000 : 0
  prg_rom_223 : ORIGIN = __prg_rom_223_lma, LENGTH = __prg_rom_size >= 4096 ? 0x4000 : 0
  prg_rom_224 : ORIGIN = __prg_rom_224_lma, LENGTH = __prg_rom_size >= 4096 ? 0x4000 : 0
  prg_rom_225 : ORIGIN = __prg_rom_225_lma, LENGTH = __prg_rom_size >= 4096 ? 0x4000 : 0
  prg_rom_226 : ORIGIN = __prg_rom_226_lma, LENGTH = __prg_rom_size >= 4096 ? 0x4000 : 0
  prg_rom_227 : ORIGIN = __prg_rom_227_lma, LENGTH = __prg_rom_size >= 4096 ? 0x4000 : 0
  prg_rom_228 : ORIGIN = __prg_rom_228_lma, LENGTH = __prg_rom_size >= 4096 ? 0x4000 : 0
  prg_rom_229 : ORIGIN = __prg_rom_229_lma, LENGTH = __prg_rom_size >= 4096 ? 0x4000 : 0
  prg_rom_230 : ORIGIN = __prg_rom_230_lma, LENGTH = __prg_rom_size >= 4096 ? 0x4000 : 0
  prg_rom_231 : ORIGIN = __prg_rom_231_lma, LENGTH = __prg_rom_size >= 4096 ? 0x4000 : 0
  prg_rom_232 : ORIGIN = __prg_rom_232_lma, LENGTH = __prg_rom_size >= 4096 ? 0x4000 : 0
  prg_rom_233 : ORIGIN = __prg_rom_233_lma, LENGTH = __prg_rom_size >= 4096 ? 0x4000 : 0
  prg_rom_234 : ORIGIN = __prg_rom_234_lma, LENGTH = __prg_rom_size >= 4096 ? 0x4000 : 0
  prg_rom_235 : ORIGIN = __prg_rom_235_lma, LENGTH = __prg_rom_size >= 4096 ? 0x4000 : 0
  prg_rom_236 : ORIGIN = __prg_rom_236_lma, LENGTH = __prg_rom_size >= 4096 ? 0x4000 : 0
  prg_rom_237 : ORIGIN = __prg_rom_237_lma, LENGTH = __prg_rom_size >= 4096 ? 0x4000 : 0
  prg_rom_238 : ORIGIN = __prg_rom_238_lma, LENGTH = __prg_rom_size >= 4096 ? 0x4000 : 0
  prg_rom_239 : ORIGIN = __prg_rom_239_lma, LENGTH = __prg_rom_size >= 4096 ? 0x4000 : 0
  prg_rom_240 : ORIGIN = __prg_rom_240_lma, LENGTH = __prg_rom_size >= 4096 ? 0x4000 : 0
  prg_rom_241 : ORIGIN = __prg_rom_241_lma, LENGTH = __prg_rom_size >= 4096 ? 0x4000 : 0
  prg_rom_242 : ORIGIN = __prg_rom_242_lma, LENGTH = __prg_rom_size >= 4096 ? 0x4000 : 0
  prg_rom_243 : ORIGIN = __prg_rom_243_lma, LENGTH = __prg_rom_size >= 4096 ? 0x4000 : 0
  prg_rom_244 : ORIGIN = __prg_rom_244_lma, LENGTH = __prg_rom_size >= 4096 ? 0x4000 : 0
  prg_rom_245 : ORIGIN = __prg_rom_245_lma, LENGTH = __prg_rom_size >= 4096 ? 0x4000 : 0
  prg_rom_246 : ORIGIN = __prg_rom_246_lma, LENGTH = __prg_rom_size >= 4096 ? 0x4000 : 0
  prg_rom_247 : ORIGIN = __prg_rom_247_lma, LENGTH = __prg_rom_size >= 4096 ? 0x4000 : 0
  prg_rom_248 : ORIGIN = __prg_rom_248_lma, LENGTH = __prg_rom_size >= 4096 ? 0x4000 : 0
  prg_rom_249 : ORIGIN = __prg_rom_249_lma, LENGTH = __prg_rom_size >= 4096 ? 0x4000 : 0
  prg_rom_250 : ORIGIN = __prg_rom_250_lma, LENGTH = __prg_rom_size >= 4096 ? 0x4000 : 0
  prg_rom_251 : ORIGIN = __prg_rom_251_lma, LENGTH = __prg_rom_size >= 4096 ? 0x4000 : 0
  prg_rom_252 : ORIGIN = __prg_rom_252_lma, LENGTH = __prg_rom_size >= 4096 ? 0x4000 : 0
  prg_rom_253 : ORIGIN = __prg_rom_253_lma, LENGTH = __prg_rom_size >= 4096 ? 0x4000 : 0
  prg_rom_254 : ORIGIN = __prg_rom_254_lma, LENGTH = __prg_rom_size >= 4096 ? 0x4000 : 0
  prg_rom_fixed : ORIGIN = __prg_rom_fixed_lma, LENGTH = 0x4000 - 0x6
  vectors : ORIGIN = 0x10000 - 0x6, LENGTH = 6
}

REGION_ALIAS("c_readonly", prg_rom_fixed)

SECTIONS {
  .prg_rom_0 : { *(.prg_rom_0 .prg_rom_0.*) } >prg_rom_0
  .prg_rom_1 : { *(.prg_rom_1 .prg_rom_1.*) } >prg_rom_1
  .prg_rom_2 : { *(.prg_rom_2 .prg_rom_2.*) } >prg_rom_2
  .prg_rom_3 : { *(.prg_rom_3 .prg_rom_3.*) } >prg_rom_3
  .prg_rom_4 : { *(.prg_rom_4 .prg_rom_4.*) } >prg_rom_4
  .prg_rom_5 : { *(.prg_rom_5 .prg_rom_5.*) } >prg_rom_5
  .prg_rom_6 : { *(.prg_rom_6 .prg_rom_6.*) } >prg_rom_6
  .prg_rom_7 : { *(.prg_rom_7 .prg_rom_7.*) } >prg_rom_7
  .prg_rom_8 : { *(.prg_rom_8 .prg_rom_8.*) } >prg_rom_8
  .prg_rom_9 : { *(.prg_rom_9 .prg_rom_9.*) } >prg_rom_9
  .prg_rom_10 : { *(.prg_rom_10 .prg_rom_10.*) } >prg_rom_10
  .prg_rom_11 : { *(.prg_rom_11 .prg_rom_11.*) } >prg_rom_11
  .prg_rom_12 : { *(.prg_rom_12 .prg_rom_12.*) } >prg_rom_12
  .prg_rom_13 : { *(.prg_rom_13 .prg_rom_13.*) } >prg_rom_13
  .prg_rom_14 : { *(.prg_rom_14 .prg_rom_14.*) } >prg_rom_14
  .prg_rom_15 : { *(.prg_rom_15 .prg_rom_15.*) } >prg_rom_15
  .prg_rom_16 : { *(.prg_rom_16 .prg_rom_16.*) } >prg_rom_16
  .prg_rom_17 : { *(.prg_rom_17 .prg_rom_17.*) } >prg_rom_17
  .prg_rom_18 : { *(.prg_rom_18 .prg_rom_18.*) } >prg_rom_18
  .prg_rom_19 : { *(.prg_rom_19 .prg_rom_19.*) } >prg_rom_19
  .prg_rom_20 : { *(.prg_rom_20 .prg_rom_20.*) } >prg_rom_20
  .prg_rom_21 : { *(.prg_rom_21 .prg_rom_21.*) } >prg_rom_21
  .prg_rom_22 : { *(.prg_rom_22 .prg_rom_22.*) } >prg_rom_22
  .prg_rom_23 : { *(.prg_rom_23 .prg_rom_23.*) } >prg_rom_23
  .prg_rom_24 : { *(.prg_rom_24 .prg_rom_24.*) } >prg_rom_24
  .prg_rom_25 : { *(.prg_rom_25 .prg_rom_25.*) } >prg_rom_25
  .prg_rom_26 : { *(.prg_rom_26 .prg_rom_26.*) } >prg_rom_26
  .prg_rom_27 : { *(.prg_rom_27 .prg_rom_27.*) } >prg_rom_27
  .prg_rom_28 : { *(.prg_rom_28 .prg_rom_28.*) } >prg_rom_28
  .prg_rom_29 : { *(.prg_rom_29 .prg_rom_29.*) } >prg_rom_29
  .prg_rom_30 : { *(.prg_rom_30 .prg_rom_30.*) } >prg_rom_30
  .prg_rom_31 : { *(.prg_rom_31 .prg_rom_31.*) } >prg_rom_31
  .prg_rom_32 : { *(.prg_rom_32 .prg_rom_32.*) } >prg_rom_32
  .prg_rom_33 : { *(.prg_rom_33 .prg_rom_33.*) } >prg_rom_33
  .prg_rom_34 : { *(.prg_rom_34 .prg_rom_34.*) } >prg_rom_34
  .prg_rom_35 : { *(.prg_rom_35 .prg_rom_35.*) } >prg_rom_35
  .prg_rom_36 : { *(.prg_rom_36 .prg_rom_36.*) } >prg_rom_36
  .prg_rom_37 : { *(.prg_rom_37 .prg_rom_37.*) } >prg_rom_37
  .prg_rom_38 : { *(.prg_rom_38 .prg_rom_38.*) } >prg_rom_38
  .prg_rom_39 : { *(.prg_rom_39 .prg_rom_39.*) } >prg_rom_39
  .prg_rom_40 : { *(.prg_rom_40 .prg_rom_40.*) } >prg_rom_40
  .prg_rom_41 : { *(.prg_rom_41 .prg_rom_41.*) } >prg_rom_41
  .prg_rom_42 : { *(.prg_rom_42 .prg_rom_42.*) } >prg_rom_42
  .prg_rom_43 : { *(.prg_rom_43 .prg_rom_43.*) } >prg_rom_43
  .prg_rom_44 : { *(.prg_rom_44 .prg_rom_44.*) } >prg_rom_44
  .prg_rom_45 : { *(.prg_rom_45 .prg_rom_45.*) } >prg_rom_45
  .prg_rom_46 : { *(.prg_rom_46 .prg_rom_46.*) } >prg_rom_46
  .prg_rom_47 : { *(.prg_rom_47 .prg_rom_47.*) } >prg_rom_47
  .prg_rom_48 : { *(.prg_rom_48 .prg_rom_48.*) } >prg_rom_48
  .prg_rom_49 : { *(.prg_rom_49 .prg_rom_49.*) } >prg_rom_49
  .prg_rom_50 : { *(.prg_rom_50 .prg_rom_50.*) } >prg_rom_50
  .prg_rom_51 : { *(.prg_rom_51 .prg_rom_51.*) } >prg_rom_51
  .prg_rom_52 : { *(.prg_rom_52 .prg_rom_52.*) } >prg_rom_52
  .prg_rom_53 : { *(.prg_rom_53 .prg_rom_53.*) } >prg_rom_53
  .prg_rom_54 : { *(.prg_rom_54 .prg_rom_54.*) } >prg_rom_54
  .prg_rom_55 : { *(.prg_rom_55 .prg_rom_55.*) } >prg_rom_55
  .prg_rom_56 : { *(.prg_rom_56 .prg_rom_56.*) } >prg_rom_56
  .prg_rom_57 : { *(.prg_rom_57 .prg_rom_57.*) } >prg_rom_57
  .prg_rom_58 : { *(.prg_rom_58 .prg_rom_58.*) } >prg_rom_58
  .prg_rom_59 : { *(.prg_rom_59 .prg_rom_59.*) } >prg_rom_59
  .prg_rom_60 : { *(.prg_rom_60 .prg_rom_60.*) } >prg_rom_60
  .prg_rom_61 : { *(.prg_rom_61 .prg_rom_61.*) } >prg_rom_61
  .prg_rom_62 : { *(.prg_rom_62 .prg_rom_62.*) } >prg_rom_62
  .prg_rom_63 : { *(.prg_rom_63 .prg_rom_63.*) } >prg_rom_63
  .prg_rom_64 : { *(.prg_rom_64 .prg_rom_64.*) } >prg_rom_64
  .prg_rom_65 : { *(.prg_rom_65 .prg_rom_65.*) } >prg_rom_65
  .prg_rom_66 : { *(.prg_rom_66 .prg_rom_66.*) } >prg_rom_66
  .prg_rom_67 : { *(.prg_rom_67 .prg_rom_67.*) } >prg_rom_67
  .prg_rom_68 : { *(.prg_rom_68 .prg_rom_68.*) } >prg_rom_68
  .prg_rom_69 : { *(.prg_rom_69 .prg_rom_69.*) } >prg_rom_69
  .prg_rom_70 : { *(.prg_rom_70 .prg_rom_70.*) } >prg_rom_70
  .prg_rom_71 : { *(.prg_rom_71 .prg_rom_71.*) } >prg_rom_71
  .prg_rom_72 : { *(.prg_rom_72 .prg_rom_72.*) } >prg_rom_72
  .prg_rom_73 : { *(.prg_rom_73 .prg_rom_73.*) } >prg_rom_73
  .prg_rom_74 : { *(.prg_rom_74 .prg_rom_74.*) } >prg_rom_74
  .prg_rom_75 : { *(.prg_rom_75 .prg_rom_75.*) } >prg_rom_75
  .prg_rom_76 : { *(.prg_rom_76 .prg_rom_76.*) } >prg_rom_76
  .prg_rom_77 : { *(.prg_rom_77 .prg_rom_77.*) } >prg_rom_77
  .prg_rom_78 : { *(.prg_rom_78 .prg_rom_78.*) } >prg_rom_78
  .prg_rom_79 : { *(.prg_rom_79 .prg_rom_79.*) } >prg_rom_79
  .prg_rom_80 : { *(.prg_rom_80 .prg_rom_80.*) } >prg_rom_80
  .prg_rom_81 : { *(.prg_rom_81 .prg_rom_81.*) } >prg_rom_81
  .prg_rom_82 : { *(.prg_rom_82 .prg_rom_82.*) } >prg_rom_82
  .prg_rom_83 : { *(.prg_rom_83 .prg_rom_83.*) } >prg_rom_83
  .prg_rom_84 : { *(.prg_rom_84 .prg_rom_84.*) } >prg_rom_84
  .prg_rom_85 : { *(.prg_rom_85 .prg_rom_85.*) } >prg_rom_85
  .prg_rom_86 : { *(.prg_rom_86 .prg_rom_86.*) } >prg_rom_86
  .prg_rom_87 : { *(.prg_rom_87 .prg_rom_87.*) } >prg_rom_87
  .prg_rom_88 : { *(.prg_rom_88 .prg_rom_88.*) } >prg_rom_88
  .prg_rom_89 : { *(.prg_rom_89 .prg_rom_89.*) } >prg_rom_89
  .prg_rom_90 : { *(.prg_rom_90 .prg_rom_90.*) } >prg_rom_90
  .prg_rom_91 : { *(.prg_rom_91 .prg_rom_91.*) } >prg_rom_91
  .prg_rom_92 : { *(.prg_rom_92 .prg_rom_92.*) } >prg_rom_92
  .prg_rom_93 : { *(.prg_rom_93 .prg_rom_93.*) } >prg_rom_93
  .prg_rom_94 : { *(.prg_rom_94 .prg_rom_94.*) } >prg_rom_94
  .prg_rom_95 : { *(.prg_rom_95 .prg_rom_95.*) } >prg_rom_95
  .prg_rom_96 : { *(.prg_rom_96 .prg_rom_96.*) } >prg_rom_96
  .prg_rom_97 : { *(.prg_rom_97 .prg_rom_97.*) } >prg_rom_97
  .prg_rom_98 : { *(.prg_rom_98 .prg_rom_98.*) } >prg_rom_98
  .prg_rom_99 : { *(.prg_rom_99 .prg_rom_99.*) } >prg_rom_99
  .prg_rom_100 : { *(.prg_rom_100 .prg_rom_100.*) } >prg_rom_100
  .prg_rom_101 : { *(.prg_rom_101 .prg_rom_101.*) } >prg_rom_101
  .prg_rom_102 : { *(.prg_rom_102 .prg_rom_102.*) } >prg_rom_102
  .prg_rom_103 : { *(.prg_rom_103 .prg_rom_103.*) } >prg_rom_103
  .prg_rom_104 : { *(.prg_rom_104 .prg_rom_104.*) } >prg_rom_104
  .prg_rom_105 : { *(.prg_rom_105 .prg_rom_105.*) } >prg_rom_105
  .prg_rom_106 : { *(.prg_rom_106 .prg_rom_106.*) } >prg_rom_106
  .prg_rom_107 : { *(.prg_rom_107 .prg_rom_107.*) } >prg_rom_107
  .prg_rom_108 : { *(.prg_rom_108 .prg_rom_108.*) } >prg_rom_108
  .prg_rom_109 : { *(.prg_rom_109 .prg_rom_109.*) } >prg_rom_109
  .prg_rom_110 : { *(.prg_rom_110 .prg_rom_110.*) } >prg_rom_110
  .prg_rom_111 : { *(.prg_rom_111 .prg_rom_111.*) } >prg_rom_111
  .prg_rom_112 : { *(.prg_rom_112 .prg_rom_112.*) } >prg_rom_112
  .prg_rom_113 : { *(.prg_rom_113 .prg_rom_113.*) } >prg_rom_113
  .prg_rom_114 : { *(.prg_rom_114 .prg_rom_114.*) } >prg_rom_114
  .prg_rom_115 : { *(.prg_rom_115 .prg_rom_115.*) } >prg_rom_115
  .prg_rom_116 : { *(.prg_rom_116 .prg_rom_116.*) } >prg_rom_116
  .prg_rom_117 : { *(.prg_rom_117 .prg_rom_117.*) } >prg_rom_117
  .prg_rom_118 : { *(.prg_rom_118 .prg_rom_118.*) } >prg_rom_118
  .prg_rom_119 : { *(.prg_rom_119 .prg_rom_119.*) } >prg_rom_119
  .prg_rom_120 : { *(.prg_rom_120 .prg_rom_120.*) } >prg_rom_120
  .prg_rom_121 : { *(.prg_rom_121 .prg_rom_121.*) } >prg_rom_121
  .prg_rom_122 : { *(.prg_rom_122 .prg_rom_122.*) } >prg_rom_122
  .prg_rom_123 : { *(.prg_rom_123 .prg_rom_123.*) } >prg_rom_123
  .prg_rom_124 : { *(.prg_rom_124 .prg_rom_124.*) } >prg_rom_124
  .prg_rom_125 : { *(.prg_rom_125 .prg_rom_125.*) } >prg_rom_125
  .prg_rom_126 : { *(.prg_rom_126 .prg_rom_126.*) } >prg_rom_126
  .prg_rom_127 : { *(.prg_rom_127 .prg_rom_127.*) } >prg_rom_127
  .prg_rom_128 : { *(.prg_rom_128 .prg_rom_128.*) } >prg_rom_128
  .prg_rom_129 : { *(.prg_rom_129 .prg_rom_129.*) } >prg_rom_129
  .prg_rom_130 : { *(.prg_rom_130 .prg_rom_130.*) } >prg_rom_130
  .prg_rom_131 : { *(.prg_rom_131 .prg_rom_131.*) } >prg_rom_131
  .prg_rom_132 : { *(.prg_rom_132 .prg_rom_132.*) } >prg_rom_132
  .prg_rom_133 : { *(.prg_rom_133 .prg_rom_133.*) } >prg_rom_133
  .prg_rom_134 : { *(.prg_rom_134 .prg_rom_134.*) } >prg_rom_134
  .prg_rom_135 : { *(.prg_rom_135 .prg_rom_135.*) } >prg_rom_135
  .prg_rom_136 : { *(.prg_rom_136 .prg_rom_136.*) } >prg_rom_136
  .prg_rom_137 : { *(.prg_rom_137 .prg_rom_137.*) } >prg_rom_137
  .prg_rom_138 : { *(.prg_rom_138 .prg_rom_138.*) } >prg_rom_138
  .prg_rom_139 : { *(.prg_rom_139 .prg_rom_139.*) } >prg_rom_139
  .prg_rom_140 : { *(.prg_rom_140 .prg_rom_140.*) } >prg_rom_140
  .prg_rom_141 : { *(.prg_rom_141 .prg_rom_141.*) } >prg_rom_141
  .prg_rom_142 : { *(.prg_rom_142 .prg_rom_142.*) } >prg_rom_142
  .prg_rom_143 : { *(.prg_rom_143 .prg_rom_143.*) } >prg_rom_143
  .prg_rom_144 : { *(.prg_rom_144 .prg_rom_144.*) } >prg_rom_144
  .prg_rom_145 : { *(.prg_rom_145 .prg_rom_145.*) } >prg_rom_145
  .prg_rom_146 : { *(.prg_rom_146 .prg_rom_146.*) } >prg_rom_146
  .prg_rom_147 : { *(.prg_rom_147 .prg_rom_147.*) } >prg_rom_147
  .prg_rom_148 : { *(.prg_rom_148 .prg_rom_148.*) } >prg_rom_148
  .prg_rom_149 : { *(.prg_rom_149 .prg_rom_149.*) } >prg_rom_149
  .prg_rom_150 : { *(.prg_rom_150 .prg_rom_150.*) } >prg_rom_150
  .prg_rom_151 : { *(.prg_rom_151 .prg_rom_151.*) } >prg_rom_151
  .prg_rom_152 : { *(.prg_rom_152 .prg_rom_152.*) } >prg_rom_152
  .prg_rom_153 : { *(.prg_rom_153 .prg_rom_153.*) } >prg_rom_153
  .prg_rom_154 : { *(.prg_rom_154 .prg_rom_154.*) } >prg_rom_154
  .prg_rom_155 : { *(.prg_rom_155 .prg_rom_155.*) } >prg_rom_155
  .prg_rom_156 : { *(.prg_rom_156 .prg_rom_156.*) } >prg_rom_156
  .prg_rom_157 : { *(.prg_rom_157 .prg_rom_157.*) } >prg_rom_157
  .prg_rom_158 : { *(.prg_rom_158 .prg_rom_158.*) } >prg_rom_158
  .prg_rom_159 : { *(.prg_rom_159 .prg_rom_159.*) } >prg_rom_159
  .prg_rom_160 : { *(.prg_rom_160 .prg_rom_160.*) } >prg_rom_160
  .prg_rom_161 : { *(.prg_rom_161 .prg_rom_161.*) } >prg_rom_161
  .prg_rom_162 : { *(.prg_rom_162 .prg_rom_162.*) } >prg_rom_162
  .prg_rom_163 : { *(.prg_rom_163 .prg_rom_163.*) } >prg_rom_163
  .prg_rom_164 : { *(.prg_rom_164 .prg_rom_164.*) } >prg_rom_164
  .prg_rom_165 : { *(.prg_rom_165 .prg_rom_165.*) } >prg_rom_165
  .prg_rom_166 : { *(.prg_rom_166 .prg_rom_166.*) } >prg_rom_166
  .prg_rom_167 : { *(.prg_rom_167 .prg_rom_167.*) } >prg_rom_167
  .prg_rom_168 : { *(.prg_rom_168 .prg_rom_168.*) } >prg_rom_168
  .prg_rom_169 : { *(.prg_rom_169 .prg_rom_169.*) } >prg_rom_169
  .prg_rom_170 : { *(.prg_rom_170 .prg_rom_170.*) } >prg_rom_170
  .prg_rom_171 : { *(.prg_rom_171 .prg_rom_171.*) } >prg_rom_171
  .prg_rom_172 : { *(.prg_rom_172 .prg_rom_172.*) } >prg_rom_172
  .prg_rom_173 : { *(.prg_rom_173 .prg_rom_173.*) } >prg_rom_173
  .prg_rom_174 : { *(.prg_rom_174 .prg_rom_174.*) } >prg_rom_174
  .prg_rom_175 : { *(.prg_rom_175 .prg_rom_175.*) } >prg_rom_175
  .prg_rom_176 : { *(.prg_rom_176 .prg_rom_176.*) } >prg_rom_176
  .prg_rom_177 : { *(.prg_rom_177 .prg_rom_177.*) } >prg_rom_177
  .prg_rom_178 : { *(.prg_rom_178 .prg_rom_178.*) } >prg_rom_178
  .prg_rom_179 : { *(.prg_rom_179 .prg_rom_179.*) } >prg_rom_179
  .prg_rom_180 : { *(.prg_rom_180 .prg_rom_180.*) } >prg_rom_180
  .prg_rom_181 : { *(.prg_rom_181 .prg_rom_181.*) } >prg_rom_181
  .prg_rom_182 : { *(.prg_rom_182 .prg_rom_182.*) } >prg_rom_182
  .prg_rom_183 : { *(.prg_rom_183 .prg_rom_183.*) } >prg_rom_183
  .prg_rom_184 : { *(.prg_rom_184 .prg_rom_184.*) } >prg_rom_184
  .prg_rom_185 : { *(.prg_rom_185 .prg_rom_185.*) } >prg_rom_185
  .prg_rom_186 : { *(.prg_rom_186 .prg_rom_186.*) } >prg_rom_186
  .prg_rom_187 : { *(.prg_rom_187 .prg_rom_187.*) } >prg_rom_187
  .prg_rom_188 : { *(.prg_rom_188 .prg_rom_188.*) } >prg_rom_188
  .prg_rom_189 : { *(.prg_rom_189 .prg_rom_189.*) } >prg_rom_189
  .prg_rom_190 : { *(.prg_rom_190 .prg_rom_190.*) } >prg_rom_190
  .prg_rom_191 : { *(.prg_rom_191 .prg_rom_191.*) } >prg_rom_191
  .prg_rom_192 : { *(.prg_rom_192 .prg_rom_192.*) } >prg_rom_192
  .prg_rom_193 : { *(.prg_rom_193 .prg_rom_193.*) } >prg_rom_193
  .prg_rom_194 : { *(.prg_rom_194 .prg_rom_194.*) } >prg_rom_194
  .prg_rom_195 : { *(.prg_rom_195 .prg_rom_195.*) } >prg_rom_195
  .prg_rom_196 : { *(.prg_rom_196 .prg_rom_196.*) } >prg_rom_196
  .prg_rom_197 : { *(.prg_rom_197 .prg_rom_197.*) } >prg_rom_197
  .prg_rom_198 : { *(.prg_rom_198 .prg_rom_198.*) } >prg_rom_198
  .prg_rom_199 : { *(.prg_rom_199 .prg_rom_199.*) } >prg_rom_199
  .prg_rom_200 : { *(.prg_rom_200 .prg_rom_200.*) } >prg_rom_200
  .prg_rom_201 : { *(.prg_rom_201 .prg_rom_201.*) } >prg_rom_201
  .prg_rom_202 : { *(.prg_rom_202 .prg_rom_202.*) } >prg_rom_202
  .prg_rom_203 : { *(.prg_rom_203 .prg_rom_203.*) } >prg_rom_203
  .prg_rom_204 : { *(.prg_rom_204 .prg_rom_204.*) } >prg_rom_204
  .prg_rom_205 : { *(.prg_rom_205 .prg_rom_205.*) } >prg_rom_205
  .prg_rom_206 : { *(.prg_rom_206 .prg_rom_206.*) } >prg_rom_206
  .prg_rom_207 : { *(.prg_rom_207 .prg_rom_207.*) } >prg_rom_207
  .prg_rom_208 : { *(.prg_rom_208 .prg_rom_208.*) } >prg_rom_208
  .prg_rom_209 : { *(.prg_rom_209 .prg_rom_209.*) } >prg_rom_209
  .prg_rom_210 : { *(.prg_rom_210 .prg_rom_210.*) } >prg_rom_210
  .prg_rom_211 : { *(.prg_rom_211 .prg_rom_211.*) } >prg_rom_211
  .prg_rom_212 : { *(.prg_rom_212 .prg_rom_212.*) } >prg_rom_212
  .prg_rom_213 : { *(.prg_rom_213 .prg_rom_213.*) } >prg_rom_213
  .prg_rom_214 : { *(.prg_rom_214 .prg_rom_214.*) } >prg_rom_214
  .prg_rom_215 : { *(.prg_rom_215 .prg_rom_215.*) } >prg_rom_215
  .prg_rom_216 : { *(.prg_rom_216 .prg_rom_216.*) } >prg_rom_216
  .prg_rom_217 : { *(.prg_rom_217 .prg_rom_217.*) } >prg_rom_217
  .prg_rom_218 : { *(.prg_rom_218 .prg_rom_218.*) } >prg_rom_218
  .prg_rom_219 : { *(.prg_rom_219 .prg_rom_219.*) } >prg_rom_219
  .prg_rom_220 : { *(.prg_rom_220 .prg_rom_220.*) } >prg_rom_220
  .prg_rom_221 : { *(.prg_rom_221 .prg_rom_221.*) } >prg_rom_221
  .prg_rom_222 : { *(.prg_rom_222 .prg_rom_222.*) } >prg_rom_222
  .prg_rom_223 : { *(.prg_rom_223 .prg_rom_223.*) } >prg_rom_223
  .prg_rom_224 : { *(.prg_rom_224 .prg_rom_224.*) } >prg_rom_224
  .prg_rom_225 : { *(.prg_rom_225 .prg_rom_225.*) } >prg_rom_225
  .prg_rom_226 : { *(.prg_rom_226 .prg_rom_226.*) } >prg_rom_226
  .prg_rom_227 : { *(.prg_rom_227 .prg_rom_227.*) } >prg_rom_227
  .prg_rom_228 : { *(.prg_rom_228 .prg_rom_228.*) } >prg_rom_228
  .prg_rom_229 : { *(.prg_rom_229 .prg_rom_229.*) } >prg_rom_229
  .prg_rom_230 : { *(.prg_rom_230 .prg_rom_230.*) } >prg_rom_230
  .prg_rom_231 : { *(.prg_rom_231 .prg_rom_231.*) } >prg_rom_231
  .prg_rom_232 : { *(.prg_rom_232 .prg_rom_232.*) } >prg_rom_232
  .prg_rom_233 : { *(.prg_rom_233 .prg_rom_233.*) } >prg_rom_233
  .prg_rom_234 : { *(.prg_rom_234 .prg_rom_234.*) } >prg_rom_234
  .prg_rom_235 : { *(.prg_rom_235 .prg_rom_235.*) } >prg_rom_235
  .prg_rom_236 : { *(.prg_rom_236 .prg_rom_236.*) } >prg_rom_236
  .prg_rom_237 : { *(.prg_rom_237 .prg_rom_237.*) } >prg_rom_237
  .prg_rom_238 : { *(.prg_rom_238 .prg_rom_238.*) } >prg_rom_238
  .prg_rom_239 : { *(.prg_rom_239 .prg_rom_239.*) } >prg_rom_239
  .prg_rom_240 : { *(.prg_rom_240 .prg_rom_240.*) } >prg_rom_240
  .prg_rom_241 : { *(.prg_rom_241 .prg_rom_241.*) } >prg_rom_241
  .prg_rom_242 : { *(.prg_rom_242 .prg_rom_242.*) } >prg_rom_242
  .prg_rom_243 : { *(.prg_rom_243 .prg_rom_243.*) } >prg_rom_243
  .prg_rom_244 : { *(.prg_rom_244 .prg_rom_244.*) } >prg_rom_244
  .prg_rom_245 : { *(.prg_rom_245 .prg_rom_245.*) } >prg_rom_245
  .prg_rom_246 : { *(.prg_rom_246 .prg_rom_246.*) } >prg_rom_246
  .prg_rom_247 : { *(.prg_rom_247 .prg_rom_247.*) } >prg_rom_247
  .prg_rom_248 : { *(.prg_rom_248 .prg_rom_248.*) } >prg_rom_248
  .prg_rom_249 : { *(.prg_rom_249 .prg_rom_249.*) } >prg_rom_249
  .prg_rom_250 : { *(.prg_rom_250 .prg_rom_250.*) } >prg_rom_250
  .prg_rom_251 : { *(.prg_rom_251 .prg_rom_251.*) } >prg_rom_251
  .prg_rom_252 : { *(.prg_rom_252 .prg_rom_252.*) } >prg_rom_252
  .prg_rom_253 : { *(.prg_rom_253 .prg_rom_253.*) } >prg_rom_253
  .prg_rom_254 : { *(.prg_rom_254 .prg_rom_254.*) } >prg_rom_254
  .prg_rom_fixed : { *(.prg_rom_fixed .prg_rom_fixed.*) } >prg_rom_fixed
}

INCLUDE dpcm.ld

SECTIONS {
  .vectors : { KEEP(*(.vectors)) } >vectors
}
