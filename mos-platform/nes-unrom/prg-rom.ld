INCLUDE _rompoke.ld
INCLUDE _prg-rom-banked.ld

PROVIDE(__prg_rom_size = 256);

OUTPUT_FORMAT {
  INCLUDE ines-header.ld
  FULL(prg_rom_0)
  FULL(prg_rom_1)
  FULL(prg_rom_2)
  FULL(prg_rom_3)
  FULL(prg_rom_4)
  FULL(prg_rom_5)
  FULL(prg_rom_6)
  FULL(prg_rom_7)
  FULL(prg_rom_8)
  FULL(prg_rom_9)
  FULL(prg_rom_10)
  FULL(prg_rom_11)
  FULL(prg_rom_12)
  FULL(prg_rom_13)
  FULL(prg_rom_14)
  FULL(prg_rom_15)
  FULL(prg_rom_16)
  FULL(prg_rom_17)
  FULL(prg_rom_18)
  FULL(prg_rom_19)
  FULL(prg_rom_20)
  FULL(prg_rom_21)
  FULL(prg_rom_22)
  FULL(prg_rom_23)
  FULL(prg_rom_24)
  FULL(prg_rom_25)
  FULL(prg_rom_26)
  FULL(prg_rom_27)
  FULL(prg_rom_28)
  FULL(prg_rom_29)
  FULL(prg_rom_30)
  FULL(prg_rom_31)
  FULL(prg_rom_32)
  FULL(prg_rom_33)
  FULL(prg_rom_34)
  FULL(prg_rom_35)
  FULL(prg_rom_36)
  FULL(prg_rom_37)
  FULL(prg_rom_38)
  FULL(prg_rom_39)
  FULL(prg_rom_40)
  FULL(prg_rom_41)
  FULL(prg_rom_42)
  FULL(prg_rom_43)
  FULL(prg_rom_44)
  FULL(prg_rom_45)
  FULL(prg_rom_46)
  FULL(prg_rom_47)
  FULL(prg_rom_48)
  FULL(prg_rom_49)
  FULL(prg_rom_50)
  FULL(prg_rom_51)
  FULL(prg_rom_52)
  FULL(prg_rom_53)
  FULL(prg_rom_54)
  FULL(prg_rom_55)
  FULL(prg_rom_56)
  FULL(prg_rom_57)
  FULL(prg_rom_58)
  FULL(prg_rom_59)
  FULL(prg_rom_60)
  FULL(prg_rom_61)
  FULL(prg_rom_62)
  FULL(prg_rom_63)
  FULL(prg_rom_64)
  FULL(prg_rom_65)
  FULL(prg_rom_66)
  FULL(prg_rom_67)
  FULL(prg_rom_68)
  FULL(prg_rom_69)
  FULL(prg_rom_70)
  FULL(prg_rom_71)
  FULL(prg_rom_72)
  FULL(prg_rom_73)
  FULL(prg_rom_74)
  FULL(prg_rom_75)
  FULL(prg_rom_76)
  FULL(prg_rom_77)
  FULL(prg_rom_78)
  FULL(prg_rom_79)
  FULL(prg_rom_80)
  FULL(prg_rom_81)
  FULL(prg_rom_82)
  FULL(prg_rom_83)
  FULL(prg_rom_84)
  FULL(prg_rom_85)
  FULL(prg_rom_86)
  FULL(prg_rom_87)
  FULL(prg_rom_88)
  FULL(prg_rom_89)
  FULL(prg_rom_90)
  FULL(prg_rom_91)
  FULL(prg_rom_92)
  FULL(prg_rom_93)
  FULL(prg_rom_94)
  FULL(prg_rom_95)
  FULL(prg_rom_96)
  FULL(prg_rom_97)
  FULL(prg_rom_98)
  FULL(prg_rom_99)
  FULL(prg_rom_100)
  FULL(prg_rom_101)
  FULL(prg_rom_102)
  FULL(prg_rom_103)
  FULL(prg_rom_104)
  FULL(prg_rom_105)
  FULL(prg_rom_106)
  FULL(prg_rom_107)
  FULL(prg_rom_108)
  FULL(prg_rom_109)
  FULL(prg_rom_110)
  FULL(prg_rom_111)
  FULL(prg_rom_112)
  FULL(prg_rom_113)
  FULL(prg_rom_114)
  FULL(prg_rom_115)
  FULL(prg_rom_116)
  FULL(prg_rom_117)
  FULL(prg_rom_118)
  FULL(prg_rom_119)
  FULL(prg_rom_120)
  FULL(prg_rom_121)
  FULL(prg_rom_122)
  FULL(prg_rom_123)
  FULL(prg_rom_124)
  FULL(prg_rom_125)
  FULL(prg_rom_126)
  FULL(prg_rom_127)
  FULL(prg_rom_128)
  FULL(prg_rom_129)
  FULL(prg_rom_130)
  FULL(prg_rom_131)
  FULL(prg_rom_132)
  FULL(prg_rom_133)
  FULL(prg_rom_134)
  FULL(prg_rom_135)
  FULL(prg_rom_136)
  FULL(prg_rom_137)
  FULL(prg_rom_138)
  FULL(prg_rom_139)
  FULL(prg_rom_140)
  FULL(prg_rom_141)
  FULL(prg_rom_142)
  FULL(prg_rom_143)
  FULL(prg_rom_144)
  FULL(prg_rom_145)
  FULL(prg_rom_146)
  FULL(prg_rom_147)
  FULL(prg_rom_148)
  FULL(prg_rom_149)
  FULL(prg_rom_150)
  FULL(prg_rom_151)
  FULL(prg_rom_152)
  FULL(prg_rom_153)
  FULL(prg_rom_154)
  FULL(prg_rom_155)
  FULL(prg_rom_156)
  FULL(prg_rom_157)
  FULL(prg_rom_158)
  FULL(prg_rom_159)
  FULL(prg_rom_160)
  FULL(prg_rom_161)
  FULL(prg_rom_162)
  FULL(prg_rom_163)
  FULL(prg_rom_164)
  FULL(prg_rom_165)
  FULL(prg_rom_166)
  FULL(prg_rom_167)
  FULL(prg_rom_168)
  FULL(prg_rom_169)
  FULL(prg_rom_170)
  FULL(prg_rom_171)
  FULL(prg_rom_172)
  FULL(prg_rom_173)
  FULL(prg_rom_174)
  FULL(prg_rom_175)
  FULL(prg_rom_176)
  FULL(prg_rom_177)
  FULL(prg_rom_178)
  FULL(prg_rom_179)
  FULL(prg_rom_180)
  FULL(prg_rom_181)
  FULL(prg_rom_182)
  FULL(prg_rom_183)
  FULL(prg_rom_184)
  FULL(prg_rom_185)
  FULL(prg_rom_186)
  FULL(prg_rom_187)
  FULL(prg_rom_188)
  FULL(prg_rom_189)
  FULL(prg_rom_190)
  FULL(prg_rom_191)
  FULL(prg_rom_192)
  FULL(prg_rom_193)
  FULL(prg_rom_194)
  FULL(prg_rom_195)
  FULL(prg_rom_196)
  FULL(prg_rom_197)
  FULL(prg_rom_198)
  FULL(prg_rom_199)
  FULL(prg_rom_200)
  FULL(prg_rom_201)
  FULL(prg_rom_202)
  FULL(prg_rom_203)
  FULL(prg_rom_204)
  FULL(prg_rom_205)
  FULL(prg_rom_206)
  FULL(prg_rom_207)
  FULL(prg_rom_208)
  FULL(prg_rom_209)
  FULL(prg_rom_210)
  FULL(prg_rom_211)
  FULL(prg_rom_212)
  FULL(prg_rom_213)
  FULL(prg_rom_214)
  FULL(prg_rom_215)
  FULL(prg_rom_216)
  FULL(prg_rom_217)
  FULL(prg_rom_218)
  FULL(prg_rom_219)
  FULL(prg_rom_220)
  FULL(prg_rom_221)
  FULL(prg_rom_222)
  FULL(prg_rom_223)
  FULL(prg_rom_224)
  FULL(prg_rom_225)
  FULL(prg_rom_226)
  FULL(prg_rom_227)
  FULL(prg_rom_228)
  FULL(prg_rom_229)
  FULL(prg_rom_230)
  FULL(prg_rom_231)
  FULL(prg_rom_232)
  FULL(prg_rom_233)
  FULL(prg_rom_234)
  FULL(prg_rom_235)
  FULL(prg_rom_236)
  FULL(prg_rom_237)
  FULL(prg_rom_238)
  FULL(prg_rom_239)
  FULL(prg_rom_240)
  FULL(prg_rom_241)
  FULL(prg_rom_242)
  FULL(prg_rom_243)
  FULL(prg_rom_244)
  FULL(prg_rom_245)
  FULL(prg_rom_246)
  FULL(prg_rom_247)
  FULL(prg_rom_248)
  FULL(prg_rom_249)
  FULL(prg_rom_250)
  FULL(prg_rom_251)
  FULL(prg_rom_252)
  FULL(prg_rom_253)
  FULL(prg_rom_254)
  FULL(prg_rom_fixed)
  FULL(vectors)
  FULL(chr_rom)
}
