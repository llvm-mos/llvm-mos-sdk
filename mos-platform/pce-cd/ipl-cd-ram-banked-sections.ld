/* Automatically generated by generate-sections.lua. */

PROVIDE(__ram_bank104 = 0xc000);
PROVIDE(__ram_bank105 = 0xc000);
PROVIDE(__ram_bank106 = 0xc000);
PROVIDE(__ram_bank107 = 0xc000);
PROVIDE(__ram_bank108 = 0xc000);
PROVIDE(__ram_bank109 = 0xc000);
PROVIDE(__ram_bank110 = 0xc000);
PROVIDE(__ram_bank111 = 0xc000);
PROVIDE(__ram_bank112 = 0xc000);
PROVIDE(__ram_bank113 = 0xc000);
PROVIDE(__ram_bank114 = 0xc000);
PROVIDE(__ram_bank115 = 0xc000);
PROVIDE(__ram_bank116 = 0xc000);
PROVIDE(__ram_bank117 = 0xc000);
PROVIDE(__ram_bank118 = 0xc000);
PROVIDE(__ram_bank119 = 0xc000);
PROVIDE(__ram_bank120 = 0xc000);
PROVIDE(__ram_bank121 = 0xc000);
PROVIDE(__ram_bank122 = 0xc000);
PROVIDE(__ram_bank123 = 0xc000);
PROVIDE(__ram_bank124 = 0xc000);
PROVIDE(__ram_bank125 = 0xc000);
PROVIDE(__ram_bank126 = 0xc000);
PROVIDE(__ram_bank127 = 0xc000);
PROVIDE(__ram_bank128 = 0x4000);
PROVIDE(__ram_bank129 = 0x6000);
PROVIDE(__ram_bank130 = 0x8000);
PROVIDE(__ram_bank131 = 0xa000);
PROVIDE(__ram_bank132 = 0xc000);
PROVIDE(__ram_bank133 = 0xc000);
PROVIDE(__ram_bank134 = 0xc000);
PROVIDE(__ram_bank135 = 0xc000);

__ram_bank104_bank = 104;
__ram_bank105_bank = 105;
__ram_bank106_bank = 106;
__ram_bank107_bank = 107;
__ram_bank108_bank = 108;
__ram_bank109_bank = 109;
__ram_bank110_bank = 110;
__ram_bank111_bank = 111;
__ram_bank112_bank = 112;
__ram_bank113_bank = 113;
__ram_bank114_bank = 114;
__ram_bank115_bank = 115;
__ram_bank116_bank = 116;
__ram_bank117_bank = 117;
__ram_bank118_bank = 118;
__ram_bank119_bank = 119;
__ram_bank120_bank = 120;
__ram_bank121_bank = 121;
__ram_bank122_bank = 122;
__ram_bank123_bank = 123;
__ram_bank124_bank = 124;
__ram_bank125_bank = 125;
__ram_bank126_bank = 126;
__ram_bank127_bank = 127;
__ram_bank128_bank = 128;
__ram_bank129_bank = 129;
__ram_bank130_bank = 130;
__ram_bank131_bank = 131;
__ram_bank132_bank = 132;
__ram_bank133_bank = 133;
__ram_bank134_bank = 134;
__ram_bank135_bank = 135;

MEMORY {
  ram_bank104 (rwx) : ORIGIN = (0x01680000 + __ram_bank104), LENGTH = 0x2000
  ram_bank105 (rwx) : ORIGIN = (0x01690000 + __ram_bank105), LENGTH = 0x2000
  ram_bank106 (rwx) : ORIGIN = (0x016a0000 + __ram_bank106), LENGTH = 0x2000
  ram_bank107 (rwx) : ORIGIN = (0x016b0000 + __ram_bank107), LENGTH = 0x2000
  ram_bank108 (rwx) : ORIGIN = (0x016c0000 + __ram_bank108), LENGTH = 0x2000
  ram_bank109 (rwx) : ORIGIN = (0x016d0000 + __ram_bank109), LENGTH = 0x2000
  ram_bank110 (rwx) : ORIGIN = (0x016e0000 + __ram_bank110), LENGTH = 0x2000
  ram_bank111 (rwx) : ORIGIN = (0x016f0000 + __ram_bank111), LENGTH = 0x2000
  ram_bank112 (rwx) : ORIGIN = (0x01700000 + __ram_bank112), LENGTH = 0x2000
  ram_bank113 (rwx) : ORIGIN = (0x01710000 + __ram_bank113), LENGTH = 0x2000
  ram_bank114 (rwx) : ORIGIN = (0x01720000 + __ram_bank114), LENGTH = 0x2000
  ram_bank115 (rwx) : ORIGIN = (0x01730000 + __ram_bank115), LENGTH = 0x2000
  ram_bank116 (rwx) : ORIGIN = (0x01740000 + __ram_bank116), LENGTH = 0x2000
  ram_bank117 (rwx) : ORIGIN = (0x01750000 + __ram_bank117), LENGTH = 0x2000
  ram_bank118 (rwx) : ORIGIN = (0x01760000 + __ram_bank118), LENGTH = 0x2000
  ram_bank119 (rwx) : ORIGIN = (0x01770000 + __ram_bank119), LENGTH = 0x2000
  ram_bank120 (rwx) : ORIGIN = (0x01780000 + __ram_bank120), LENGTH = 0x2000
  ram_bank121 (rwx) : ORIGIN = (0x01790000 + __ram_bank121), LENGTH = 0x2000
  ram_bank122 (rwx) : ORIGIN = (0x017a0000 + __ram_bank122), LENGTH = 0x2000
  ram_bank123 (rwx) : ORIGIN = (0x017b0000 + __ram_bank123), LENGTH = 0x2000
  ram_bank124 (rwx) : ORIGIN = (0x017c0000 + __ram_bank124), LENGTH = 0x2000
  ram_bank125 (rwx) : ORIGIN = (0x017d0000 + __ram_bank125), LENGTH = 0x2000
  ram_bank126 (rwx) : ORIGIN = (0x017e0000 + __ram_bank126), LENGTH = 0x2000
  ram_bank127 (rwx) : ORIGIN = (0x017f0000 + __ram_bank127), LENGTH = 0x2000
  ram_bank128 (rwxa) : ORIGIN = (0x01800000 + __ram_bank128), LENGTH = 0x2000
  ram_bank129 (rwxa) : ORIGIN = (0x01810000 + __ram_bank129), LENGTH = 0x2000
  ram_bank130 (rwxa) : ORIGIN = (0x01820000 + __ram_bank130), LENGTH = 0x2000
  ram_bank131 (rwxa) : ORIGIN = (0x01830000 + __ram_bank131), LENGTH = 0x2000
  ram_bank132 (rwxa) : ORIGIN = (0x01840000 + __ram_bank132), LENGTH = 0x2000
  ram_bank133 (rwx) : ORIGIN = (0x01850000 + __ram_bank133), LENGTH = 0x2000
  ram_bank134 (rwx) : ORIGIN = (0x01860000 + __ram_bank134), LENGTH = 0x2000
  ram_bank135 (rwx) : ORIGIN = (0x01870000 + __ram_bank135), LENGTH = 0x2000
}

SECTIONS {
  .ram_bank104 (NOLOAD) : { *(.ram_bank104 .ram_bank104.*) } >ram_bank104
  .ram_bank105 (NOLOAD) : { *(.ram_bank105 .ram_bank105.*) } >ram_bank105
  .ram_bank106 (NOLOAD) : { *(.ram_bank106 .ram_bank106.*) } >ram_bank106
  .ram_bank107 (NOLOAD) : { *(.ram_bank107 .ram_bank107.*) } >ram_bank107
  .ram_bank108 (NOLOAD) : { *(.ram_bank108 .ram_bank108.*) } >ram_bank108
  .ram_bank109 (NOLOAD) : { *(.ram_bank109 .ram_bank109.*) } >ram_bank109
  .ram_bank110 (NOLOAD) : { *(.ram_bank110 .ram_bank110.*) } >ram_bank110
  .ram_bank111 (NOLOAD) : { *(.ram_bank111 .ram_bank111.*) } >ram_bank111
  .ram_bank112 (NOLOAD) : { *(.ram_bank112 .ram_bank112.*) } >ram_bank112
  .ram_bank113 (NOLOAD) : { *(.ram_bank113 .ram_bank113.*) } >ram_bank113
  .ram_bank114 (NOLOAD) : { *(.ram_bank114 .ram_bank114.*) } >ram_bank114
  .ram_bank115 (NOLOAD) : { *(.ram_bank115 .ram_bank115.*) } >ram_bank115
  .ram_bank116 (NOLOAD) : { *(.ram_bank116 .ram_bank116.*) } >ram_bank116
  .ram_bank117 (NOLOAD) : { *(.ram_bank117 .ram_bank117.*) } >ram_bank117
  .ram_bank118 (NOLOAD) : { *(.ram_bank118 .ram_bank118.*) } >ram_bank118
  .ram_bank119 (NOLOAD) : { *(.ram_bank119 .ram_bank119.*) } >ram_bank119
  .ram_bank120 (NOLOAD) : { *(.ram_bank120 .ram_bank120.*) } >ram_bank120
  .ram_bank121 (NOLOAD) : { *(.ram_bank121 .ram_bank121.*) } >ram_bank121
  .ram_bank122 (NOLOAD) : { *(.ram_bank122 .ram_bank122.*) } >ram_bank122
  .ram_bank123 (NOLOAD) : { *(.ram_bank123 .ram_bank123.*) } >ram_bank123
  .ram_bank124 (NOLOAD) : { *(.ram_bank124 .ram_bank124.*) } >ram_bank124
  .ram_bank125 (NOLOAD) : { *(.ram_bank125 .ram_bank125.*) } >ram_bank125
  .ram_bank126 (NOLOAD) : { *(.ram_bank126 .ram_bank126.*) } >ram_bank126
  .ram_bank127 (NOLOAD) : { *(.ram_bank127 .ram_bank127.*) } >ram_bank127
  .ram_bank128 : { *(.ram_bank128 .ram_bank128.*) } >ram_bank128
  .ram_bank129 : { *(.ram_bank129 .ram_bank129.*) } >ram_bank129
  .ram_bank130 : { *(.ram_bank130 .ram_bank130.*) } >ram_bank130
  .ram_bank131 : { *(.ram_bank131 .ram_bank131.*) } >ram_bank131
  .ram_bank132 : { *(.ram_bank132 .ram_bank132.*) } >ram_bank132
  .ram_bank133 (NOLOAD) : { *(.ram_bank133 .ram_bank133.*) } >ram_bank133
  .ram_bank134 (NOLOAD) : { *(.ram_bank134 .ram_bank134.*) } >ram_bank134
  .ram_bank135 (NOLOAD) : { *(.ram_bank135 .ram_bank135.*) } >ram_bank135
}
