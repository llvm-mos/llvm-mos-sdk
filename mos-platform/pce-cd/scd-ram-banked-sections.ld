/* Automatically generated by generate-sections.lua. */

PROVIDE(__ram_bank104 = 16384);
PROVIDE(__ram_bank105 = 24576);
PROVIDE(__ram_bank106 = 32768);
PROVIDE(__ram_bank107 = 40960);
PROVIDE(__ram_bank108 = 49152);
PROVIDE(__ram_bank109 = 0xc000);
PROVIDE(__ram_bank110 = 0xc000);
PROVIDE(__ram_bank111 = 0xc000);
PROVIDE(__ram_bank112 = 0xc000);
PROVIDE(__ram_bank113 = 0xc000);
PROVIDE(__ram_bank114 = 0xc000);
PROVIDE(__ram_bank115 = 0xc000);
PROVIDE(__ram_bank116 = 0xc000);
PROVIDE(__ram_bank117 = 0xc000);
PROVIDE(__ram_bank118 = 0xc000);
PROVIDE(__ram_bank119 = 0xc000);
PROVIDE(__ram_bank120 = 0xc000);
PROVIDE(__ram_bank121 = 0xc000);
PROVIDE(__ram_bank122 = 0xc000);
PROVIDE(__ram_bank123 = 0xc000);
PROVIDE(__ram_bank124 = 0xc000);
PROVIDE(__ram_bank125 = 0xc000);
PROVIDE(__ram_bank126 = 0xc000);
PROVIDE(__ram_bank127 = 0xc000);
PROVIDE(__ram_bank128 = 0xc000);
PROVIDE(__ram_bank129 = 0xc000);
PROVIDE(__ram_bank130 = 0xc000);
PROVIDE(__ram_bank131 = 0xc000);
PROVIDE(__ram_bank132 = 0xc000);
PROVIDE(__ram_bank133 = 0xc000);
PROVIDE(__ram_bank134 = 0xc000);
PROVIDE(__ram_bank135 = 0xc000);

__ram_bank104_bank = 104;
__ram_bank105_bank = 105;
__ram_bank106_bank = 106;
__ram_bank107_bank = 107;
__ram_bank108_bank = 108;
__ram_bank109_bank = 109;
__ram_bank110_bank = 110;
__ram_bank111_bank = 111;
__ram_bank112_bank = 112;
__ram_bank113_bank = 113;
__ram_bank114_bank = 114;
__ram_bank115_bank = 115;
__ram_bank116_bank = 116;
__ram_bank117_bank = 117;
__ram_bank118_bank = 118;
__ram_bank119_bank = 119;
__ram_bank120_bank = 120;
__ram_bank121_bank = 121;
__ram_bank122_bank = 122;
__ram_bank123_bank = 123;
__ram_bank124_bank = 124;
__ram_bank125_bank = 125;
__ram_bank126_bank = 126;
__ram_bank127_bank = 127;
__ram_bank128_bank = 128;
__ram_bank129_bank = 129;
__ram_bank130_bank = 130;
__ram_bank131_bank = 131;
__ram_bank132_bank = 132;
__ram_bank133_bank = 133;
__ram_bank134_bank = 134;
__ram_bank135_bank = 135;

MEMORY {
  ram_bank104 (rwxa) : ORIGIN = (23592960 + __ram_bank104), LENGTH = 0x2000
  ram_bank105 (rwxa) : ORIGIN = (23658496 + __ram_bank105), LENGTH = 0x2000
  ram_bank106 (rwxa) : ORIGIN = (23724032 + __ram_bank106), LENGTH = 0x2000
  ram_bank107 (rwxa) : ORIGIN = (23789568 + __ram_bank107), LENGTH = 0x2000
  ram_bank108 (rwxa) : ORIGIN = (23855104 + __ram_bank108), LENGTH = 0x2000
  ram_bank109 (rwxa) : ORIGIN = (23920640 + __ram_bank109), LENGTH = 0x2000
  ram_bank110 (rwxa) : ORIGIN = (23986176 + __ram_bank110), LENGTH = 0x2000
  ram_bank111 (rwxa) : ORIGIN = (24051712 + __ram_bank111), LENGTH = 0x2000
  ram_bank112 (rwxa) : ORIGIN = (24117248 + __ram_bank112), LENGTH = 0x2000
  ram_bank113 (rwxa) : ORIGIN = (24182784 + __ram_bank113), LENGTH = 0x2000
  ram_bank114 (rwxa) : ORIGIN = (24248320 + __ram_bank114), LENGTH = 0x2000
  ram_bank115 (rwxa) : ORIGIN = (24313856 + __ram_bank115), LENGTH = 0x2000
  ram_bank116 (rwxa) : ORIGIN = (24379392 + __ram_bank116), LENGTH = 0x2000
  ram_bank117 (rwxa) : ORIGIN = (24444928 + __ram_bank117), LENGTH = 0x2000
  ram_bank118 (rwxa) : ORIGIN = (24510464 + __ram_bank118), LENGTH = 0x2000
  ram_bank119 (rwxa) : ORIGIN = (24576000 + __ram_bank119), LENGTH = 0x2000
  ram_bank120 (rwxa) : ORIGIN = (24641536 + __ram_bank120), LENGTH = 0x2000
  ram_bank121 (rwxa) : ORIGIN = (24707072 + __ram_bank121), LENGTH = 0x2000
  ram_bank122 (rwxa) : ORIGIN = (24772608 + __ram_bank122), LENGTH = 0x2000
  ram_bank123 (rwxa) : ORIGIN = (24838144 + __ram_bank123), LENGTH = 0x2000
  ram_bank124 (rwxa) : ORIGIN = (24903680 + __ram_bank124), LENGTH = 0x2000
  ram_bank125 (rwxa) : ORIGIN = (24969216 + __ram_bank125), LENGTH = 0x2000
  ram_bank126 (rwxa) : ORIGIN = (25034752 + __ram_bank126), LENGTH = 0x2000
  ram_bank127 (rwxa) : ORIGIN = (25100288 + __ram_bank127), LENGTH = 0x2000
  ram_bank128 (rwxa) : ORIGIN = (25165824 + __ram_bank128), LENGTH = 0x2000
  ram_bank129 (rwxa) : ORIGIN = (25231360 + __ram_bank129), LENGTH = 0x2000
  ram_bank130 (rwxa) : ORIGIN = (25296896 + __ram_bank130), LENGTH = 0x2000
  ram_bank131 (rwxa) : ORIGIN = (25362432 + __ram_bank131), LENGTH = 0x2000
  ram_bank132 (rwxa) : ORIGIN = (25427968 + __ram_bank132), LENGTH = 0x2000
  ram_bank133 (rwxa) : ORIGIN = (25493504 + __ram_bank133), LENGTH = 0x2000
  ram_bank134 (rwxa) : ORIGIN = (25559040 + __ram_bank134), LENGTH = 0x2000
  ram_bank135 (rwxa) : ORIGIN = (25624576 + __ram_bank135), LENGTH = 0x2000
}

SECTIONS {
  .ram_bank104 : { *(.ram_bank104 .ram_bank104.*) } >ram_bank104
  .ram_bank105 : { *(.ram_bank105 .ram_bank105.*) } >ram_bank105
  .ram_bank106 : { *(.ram_bank106 .ram_bank106.*) } >ram_bank106
  .ram_bank107 : { *(.ram_bank107 .ram_bank107.*) } >ram_bank107
  .ram_bank108 : { *(.ram_bank108 .ram_bank108.*) } >ram_bank108
  .ram_bank109 : { *(.ram_bank109 .ram_bank109.*) } >ram_bank109
  .ram_bank110 : { *(.ram_bank110 .ram_bank110.*) } >ram_bank110
  .ram_bank111 : { *(.ram_bank111 .ram_bank111.*) } >ram_bank111
  .ram_bank112 : { *(.ram_bank112 .ram_bank112.*) } >ram_bank112
  .ram_bank113 : { *(.ram_bank113 .ram_bank113.*) } >ram_bank113
  .ram_bank114 : { *(.ram_bank114 .ram_bank114.*) } >ram_bank114
  .ram_bank115 : { *(.ram_bank115 .ram_bank115.*) } >ram_bank115
  .ram_bank116 : { *(.ram_bank116 .ram_bank116.*) } >ram_bank116
  .ram_bank117 : { *(.ram_bank117 .ram_bank117.*) } >ram_bank117
  .ram_bank118 : { *(.ram_bank118 .ram_bank118.*) } >ram_bank118
  .ram_bank119 : { *(.ram_bank119 .ram_bank119.*) } >ram_bank119
  .ram_bank120 : { *(.ram_bank120 .ram_bank120.*) } >ram_bank120
  .ram_bank121 : { *(.ram_bank121 .ram_bank121.*) } >ram_bank121
  .ram_bank122 : { *(.ram_bank122 .ram_bank122.*) } >ram_bank122
  .ram_bank123 : { *(.ram_bank123 .ram_bank123.*) } >ram_bank123
  .ram_bank124 : { *(.ram_bank124 .ram_bank124.*) } >ram_bank124
  .ram_bank125 : { *(.ram_bank125 .ram_bank125.*) } >ram_bank125
  .ram_bank126 : { *(.ram_bank126 .ram_bank126.*) } >ram_bank126
  .ram_bank127 : { *(.ram_bank127 .ram_bank127.*) } >ram_bank127
  .ram_bank128 : { *(.ram_bank128 .ram_bank128.*) } >ram_bank128
  .ram_bank129 : { *(.ram_bank129 .ram_bank129.*) } >ram_bank129
  .ram_bank130 : { *(.ram_bank130 .ram_bank130.*) } >ram_bank130
  .ram_bank131 : { *(.ram_bank131 .ram_bank131.*) } >ram_bank131
  .ram_bank132 : { *(.ram_bank132 .ram_bank132.*) } >ram_bank132
  .ram_bank133 : { *(.ram_bank133 .ram_bank133.*) } >ram_bank133
  .ram_bank134 : { *(.ram_bank134 .ram_bank134.*) } >ram_bank134
  .ram_bank135 : { *(.ram_bank135 .ram_bank135.*) } >ram_bank135
}
