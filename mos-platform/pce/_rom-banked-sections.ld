/* Automatically generated by generate-rom-banked-sections.lua. */

PROVIDE(__rom_bank0 = 0xe000);
PROVIDE(__rom_bank0_size = 0x2000);
PROVIDE(__rom_bank1 = 0xc000);
PROVIDE(__rom_bank1_size = 0);
PROVIDE(__rom_bank2 = 0xc000);
PROVIDE(__rom_bank2_size = 0);
PROVIDE(__rom_bank3 = 0xc000);
PROVIDE(__rom_bank3_size = 0);
PROVIDE(__rom_bank4 = 0xc000);
PROVIDE(__rom_bank4_size = 0);
PROVIDE(__rom_bank5 = 0xc000);
PROVIDE(__rom_bank5_size = 0);
PROVIDE(__rom_bank6 = 0xc000);
PROVIDE(__rom_bank6_size = 0);
PROVIDE(__rom_bank7 = 0xc000);
PROVIDE(__rom_bank7_size = 0);
PROVIDE(__rom_bank8 = 0xc000);
PROVIDE(__rom_bank8_size = 0);
PROVIDE(__rom_bank9 = 0xc000);
PROVIDE(__rom_bank9_size = 0);
PROVIDE(__rom_bank10 = 0xc000);
PROVIDE(__rom_bank10_size = 0);
PROVIDE(__rom_bank11 = 0xc000);
PROVIDE(__rom_bank11_size = 0);
PROVIDE(__rom_bank12 = 0xc000);
PROVIDE(__rom_bank12_size = 0);
PROVIDE(__rom_bank13 = 0xc000);
PROVIDE(__rom_bank13_size = 0);
PROVIDE(__rom_bank14 = 0xc000);
PROVIDE(__rom_bank14_size = 0);
PROVIDE(__rom_bank15 = 0xc000);
PROVIDE(__rom_bank15_size = 0);
PROVIDE(__rom_bank16 = 0xc000);
PROVIDE(__rom_bank16_size = 0);
PROVIDE(__rom_bank17 = 0xc000);
PROVIDE(__rom_bank17_size = 0);
PROVIDE(__rom_bank18 = 0xc000);
PROVIDE(__rom_bank18_size = 0);
PROVIDE(__rom_bank19 = 0xc000);
PROVIDE(__rom_bank19_size = 0);
PROVIDE(__rom_bank20 = 0xc000);
PROVIDE(__rom_bank20_size = 0);
PROVIDE(__rom_bank21 = 0xc000);
PROVIDE(__rom_bank21_size = 0);
PROVIDE(__rom_bank22 = 0xc000);
PROVIDE(__rom_bank22_size = 0);
PROVIDE(__rom_bank23 = 0xc000);
PROVIDE(__rom_bank23_size = 0);
PROVIDE(__rom_bank24 = 0xc000);
PROVIDE(__rom_bank24_size = 0);
PROVIDE(__rom_bank25 = 0xc000);
PROVIDE(__rom_bank25_size = 0);
PROVIDE(__rom_bank26 = 0xc000);
PROVIDE(__rom_bank26_size = 0);
PROVIDE(__rom_bank27 = 0xc000);
PROVIDE(__rom_bank27_size = 0);
PROVIDE(__rom_bank28 = 0xc000);
PROVIDE(__rom_bank28_size = 0);
PROVIDE(__rom_bank29 = 0xc000);
PROVIDE(__rom_bank29_size = 0);
PROVIDE(__rom_bank30 = 0xc000);
PROVIDE(__rom_bank30_size = 0);
PROVIDE(__rom_bank31 = 0xc000);
PROVIDE(__rom_bank31_size = 0);
PROVIDE(__rom_bank32 = 0xc000);
PROVIDE(__rom_bank32_size = 0);
PROVIDE(__rom_bank33 = 0xc000);
PROVIDE(__rom_bank33_size = 0);
PROVIDE(__rom_bank34 = 0xc000);
PROVIDE(__rom_bank34_size = 0);
PROVIDE(__rom_bank35 = 0xc000);
PROVIDE(__rom_bank35_size = 0);
PROVIDE(__rom_bank36 = 0xc000);
PROVIDE(__rom_bank36_size = 0);
PROVIDE(__rom_bank37 = 0xc000);
PROVIDE(__rom_bank37_size = 0);
PROVIDE(__rom_bank38 = 0xc000);
PROVIDE(__rom_bank38_size = 0);
PROVIDE(__rom_bank39 = 0xc000);
PROVIDE(__rom_bank39_size = 0);
PROVIDE(__rom_bank40 = 0xc000);
PROVIDE(__rom_bank40_size = 0);
PROVIDE(__rom_bank41 = 0xc000);
PROVIDE(__rom_bank41_size = 0);
PROVIDE(__rom_bank42 = 0xc000);
PROVIDE(__rom_bank42_size = 0);
PROVIDE(__rom_bank43 = 0xc000);
PROVIDE(__rom_bank43_size = 0);
PROVIDE(__rom_bank44 = 0xc000);
PROVIDE(__rom_bank44_size = 0);
PROVIDE(__rom_bank45 = 0xc000);
PROVIDE(__rom_bank45_size = 0);
PROVIDE(__rom_bank46 = 0xc000);
PROVIDE(__rom_bank46_size = 0);
PROVIDE(__rom_bank47 = 0xc000);
PROVIDE(__rom_bank47_size = 0);
PROVIDE(__rom_bank48 = 0xc000);
PROVIDE(__rom_bank48_size = 0);
PROVIDE(__rom_bank49 = 0xc000);
PROVIDE(__rom_bank49_size = 0);
PROVIDE(__rom_bank50 = 0xc000);
PROVIDE(__rom_bank50_size = 0);
PROVIDE(__rom_bank51 = 0xc000);
PROVIDE(__rom_bank51_size = 0);
PROVIDE(__rom_bank52 = 0xc000);
PROVIDE(__rom_bank52_size = 0);
PROVIDE(__rom_bank53 = 0xc000);
PROVIDE(__rom_bank53_size = 0);
PROVIDE(__rom_bank54 = 0xc000);
PROVIDE(__rom_bank54_size = 0);
PROVIDE(__rom_bank55 = 0xc000);
PROVIDE(__rom_bank55_size = 0);
PROVIDE(__rom_bank56 = 0xc000);
PROVIDE(__rom_bank56_size = 0);
PROVIDE(__rom_bank57 = 0xc000);
PROVIDE(__rom_bank57_size = 0);
PROVIDE(__rom_bank58 = 0xc000);
PROVIDE(__rom_bank58_size = 0);
PROVIDE(__rom_bank59 = 0xc000);
PROVIDE(__rom_bank59_size = 0);
PROVIDE(__rom_bank60 = 0xc000);
PROVIDE(__rom_bank60_size = 0);
PROVIDE(__rom_bank61 = 0xc000);
PROVIDE(__rom_bank61_size = 0);
PROVIDE(__rom_bank62 = 0xc000);
PROVIDE(__rom_bank62_size = 0);
PROVIDE(__rom_bank63 = 0xc000);
PROVIDE(__rom_bank63_size = 0);
PROVIDE(__rom_bank64 = 0xc000);
PROVIDE(__rom_bank64_size = 0);
PROVIDE(__rom_bank65 = 0xc000);
PROVIDE(__rom_bank65_size = 0);
PROVIDE(__rom_bank66 = 0xc000);
PROVIDE(__rom_bank66_size = 0);
PROVIDE(__rom_bank67 = 0xc000);
PROVIDE(__rom_bank67_size = 0);
PROVIDE(__rom_bank68 = 0xc000);
PROVIDE(__rom_bank68_size = 0);
PROVIDE(__rom_bank69 = 0xc000);
PROVIDE(__rom_bank69_size = 0);
PROVIDE(__rom_bank70 = 0xc000);
PROVIDE(__rom_bank70_size = 0);
PROVIDE(__rom_bank71 = 0xc000);
PROVIDE(__rom_bank71_size = 0);
PROVIDE(__rom_bank72 = 0xc000);
PROVIDE(__rom_bank72_size = 0);
PROVIDE(__rom_bank73 = 0xc000);
PROVIDE(__rom_bank73_size = 0);
PROVIDE(__rom_bank74 = 0xc000);
PROVIDE(__rom_bank74_size = 0);
PROVIDE(__rom_bank75 = 0xc000);
PROVIDE(__rom_bank75_size = 0);
PROVIDE(__rom_bank76 = 0xc000);
PROVIDE(__rom_bank76_size = 0);
PROVIDE(__rom_bank77 = 0xc000);
PROVIDE(__rom_bank77_size = 0);
PROVIDE(__rom_bank78 = 0xc000);
PROVIDE(__rom_bank78_size = 0);
PROVIDE(__rom_bank79 = 0xc000);
PROVIDE(__rom_bank79_size = 0);
PROVIDE(__rom_bank80 = 0xc000);
PROVIDE(__rom_bank80_size = 0);
PROVIDE(__rom_bank81 = 0xc000);
PROVIDE(__rom_bank81_size = 0);
PROVIDE(__rom_bank82 = 0xc000);
PROVIDE(__rom_bank82_size = 0);
PROVIDE(__rom_bank83 = 0xc000);
PROVIDE(__rom_bank83_size = 0);
PROVIDE(__rom_bank84 = 0xc000);
PROVIDE(__rom_bank84_size = 0);
PROVIDE(__rom_bank85 = 0xc000);
PROVIDE(__rom_bank85_size = 0);
PROVIDE(__rom_bank86 = 0xc000);
PROVIDE(__rom_bank86_size = 0);
PROVIDE(__rom_bank87 = 0xc000);
PROVIDE(__rom_bank87_size = 0);
PROVIDE(__rom_bank88 = 0xc000);
PROVIDE(__rom_bank88_size = 0);
PROVIDE(__rom_bank89 = 0xc000);
PROVIDE(__rom_bank89_size = 0);
PROVIDE(__rom_bank90 = 0xc000);
PROVIDE(__rom_bank90_size = 0);
PROVIDE(__rom_bank91 = 0xc000);
PROVIDE(__rom_bank91_size = 0);
PROVIDE(__rom_bank92 = 0xc000);
PROVIDE(__rom_bank92_size = 0);
PROVIDE(__rom_bank93 = 0xc000);
PROVIDE(__rom_bank93_size = 0);
PROVIDE(__rom_bank94 = 0xc000);
PROVIDE(__rom_bank94_size = 0);
PROVIDE(__rom_bank95 = 0xc000);
PROVIDE(__rom_bank95_size = 0);
PROVIDE(__rom_bank96 = 0xc000);
PROVIDE(__rom_bank96_size = 0);
PROVIDE(__rom_bank97 = 0xc000);
PROVIDE(__rom_bank97_size = 0);
PROVIDE(__rom_bank98 = 0xc000);
PROVIDE(__rom_bank98_size = 0);
PROVIDE(__rom_bank99 = 0xc000);
PROVIDE(__rom_bank99_size = 0);
PROVIDE(__rom_bank100 = 0xc000);
PROVIDE(__rom_bank100_size = 0);
PROVIDE(__rom_bank101 = 0xc000);
PROVIDE(__rom_bank101_size = 0);
PROVIDE(__rom_bank102 = 0xc000);
PROVIDE(__rom_bank102_size = 0);
PROVIDE(__rom_bank103 = 0xc000);
PROVIDE(__rom_bank103_size = 0);
PROVIDE(__rom_bank104 = 0xc000);
PROVIDE(__rom_bank104_size = 0);
PROVIDE(__rom_bank105 = 0xc000);
PROVIDE(__rom_bank105_size = 0);
PROVIDE(__rom_bank106 = 0xc000);
PROVIDE(__rom_bank106_size = 0);
PROVIDE(__rom_bank107 = 0xc000);
PROVIDE(__rom_bank107_size = 0);
PROVIDE(__rom_bank108 = 0xc000);
PROVIDE(__rom_bank108_size = 0);
PROVIDE(__rom_bank109 = 0xc000);
PROVIDE(__rom_bank109_size = 0);
PROVIDE(__rom_bank110 = 0xc000);
PROVIDE(__rom_bank110_size = 0);
PROVIDE(__rom_bank111 = 0xc000);
PROVIDE(__rom_bank111_size = 0);
PROVIDE(__rom_bank112 = 0xc000);
PROVIDE(__rom_bank112_size = 0);
PROVIDE(__rom_bank113 = 0xc000);
PROVIDE(__rom_bank113_size = 0);
PROVIDE(__rom_bank114 = 0xc000);
PROVIDE(__rom_bank114_size = 0);
PROVIDE(__rom_bank115 = 0xc000);
PROVIDE(__rom_bank115_size = 0);
PROVIDE(__rom_bank116 = 0xc000);
PROVIDE(__rom_bank116_size = 0);
PROVIDE(__rom_bank117 = 0xc000);
PROVIDE(__rom_bank117_size = 0);
PROVIDE(__rom_bank118 = 0xc000);
PROVIDE(__rom_bank118_size = 0);
PROVIDE(__rom_bank119 = 0xc000);
PROVIDE(__rom_bank119_size = 0);
PROVIDE(__rom_bank120 = 0xc000);
PROVIDE(__rom_bank120_size = 0);
PROVIDE(__rom_bank121 = 0xc000);
PROVIDE(__rom_bank121_size = 0);
PROVIDE(__rom_bank122 = 0xc000);
PROVIDE(__rom_bank122_size = 0);
PROVIDE(__rom_bank123 = 0xc000);
PROVIDE(__rom_bank123_size = 0);
PROVIDE(__rom_bank124 = 0xc000);
PROVIDE(__rom_bank124_size = 0);
PROVIDE(__rom_bank125 = 0xc000);
PROVIDE(__rom_bank125_size = 0);
PROVIDE(__rom_bank126 = 0xc000);
PROVIDE(__rom_bank126_size = 0);
PROVIDE(__rom_bank127 = 0xc000);
PROVIDE(__rom_bank127_size = 0);

__rom_size = MAX((__rom_bank127_size > 0 ? 0x100000 : (__rom_bank126_size > 0 ? 0xfe000 : (__rom_bank125_size > 0 ? 0xfc000 : (__rom_bank124_size > 0 ? 0xfa000 : (__rom_bank123_size > 0 ? 0xf8000 : (__rom_bank122_size > 0 ? 0xf6000 : (__rom_bank121_size > 0 ? 0xf4000 : (__rom_bank120_size > 0 ? 0xf2000 : (__rom_bank119_size > 0 ? 0xf0000 : (__rom_bank118_size > 0 ? 0xee000 : (__rom_bank117_size > 0 ? 0xec000 : (__rom_bank116_size > 0 ? 0xea000 : (__rom_bank115_size > 0 ? 0xe8000 : (__rom_bank114_size > 0 ? 0xe6000 : (__rom_bank113_size > 0 ? 0xe4000 : (__rom_bank112_size > 0 ? 0xe2000 : (__rom_bank111_size > 0 ? 0xe0000 : (__rom_bank110_size > 0 ? 0xde000 : (__rom_bank109_size > 0 ? 0xdc000 : (__rom_bank108_size > 0 ? 0xda000 : (__rom_bank107_size > 0 ? 0xd8000 : (__rom_bank106_size > 0 ? 0xd6000 : (__rom_bank105_size > 0 ? 0xd4000 : (__rom_bank104_size > 0 ? 0xd2000 : (__rom_bank103_size > 0 ? 0xd0000 : (__rom_bank102_size > 0 ? 0xce000 : (__rom_bank101_size > 0 ? 0xcc000 : (__rom_bank100_size > 0 ? 0xca000 : (__rom_bank99_size > 0 ? 0xc8000 : (__rom_bank98_size > 0 ? 0xc6000 : (__rom_bank97_size > 0 ? 0xc4000 : (__rom_bank96_size > 0 ? 0xc2000 : (__rom_bank95_size > 0 ? 0xc0000 : (__rom_bank94_size > 0 ? 0xbe000 : (__rom_bank93_size > 0 ? 0xbc000 : (__rom_bank92_size > 0 ? 0xba000 : (__rom_bank91_size > 0 ? 0xb8000 : (__rom_bank90_size > 0 ? 0xb6000 : (__rom_bank89_size > 0 ? 0xb4000 : (__rom_bank88_size > 0 ? 0xb2000 : (__rom_bank87_size > 0 ? 0xb0000 : (__rom_bank86_size > 0 ? 0xae000 : (__rom_bank85_size > 0 ? 0xac000 : (__rom_bank84_size > 0 ? 0xaa000 : (__rom_bank83_size > 0 ? 0xa8000 : (__rom_bank82_size > 0 ? 0xa6000 : (__rom_bank81_size > 0 ? 0xa4000 : (__rom_bank80_size > 0 ? 0xa2000 : (__rom_bank79_size > 0 ? 0xa0000 : (__rom_bank78_size > 0 ? 0x9e000 : (__rom_bank77_size > 0 ? 0x9c000 : (__rom_bank76_size > 0 ? 0x9a000 : (__rom_bank75_size > 0 ? 0x98000 : (__rom_bank74_size > 0 ? 0x96000 : (__rom_bank73_size > 0 ? 0x94000 : (__rom_bank72_size > 0 ? 0x92000 : (__rom_bank71_size > 0 ? 0x90000 : (__rom_bank70_size > 0 ? 0x8e000 : (__rom_bank69_size > 0 ? 0x8c000 : (__rom_bank68_size > 0 ? 0x8a000 : (__rom_bank67_size > 0 ? 0x88000 : (__rom_bank66_size > 0 ? 0x86000 : (__rom_bank65_size > 0 ? 0x84000 : (__rom_bank64_size > 0 ? 0x82000 : (__rom_bank63_size > 0 ? 0x80000 : (__rom_bank62_size > 0 ? 0x7e000 : (__rom_bank61_size > 0 ? 0x7c000 : (__rom_bank60_size > 0 ? 0x7a000 : (__rom_bank59_size > 0 ? 0x78000 : (__rom_bank58_size > 0 ? 0x76000 : (__rom_bank57_size > 0 ? 0x74000 : (__rom_bank56_size > 0 ? 0x72000 : (__rom_bank55_size > 0 ? 0x70000 : (__rom_bank54_size > 0 ? 0x6e000 : (__rom_bank53_size > 0 ? 0x6c000 : (__rom_bank52_size > 0 ? 0x6a000 : (__rom_bank51_size > 0 ? 0x68000 : (__rom_bank50_size > 0 ? 0x66000 : (__rom_bank49_size > 0 ? 0x64000 : (__rom_bank48_size > 0 ? 0x62000 : (__rom_bank47_size > 0 ? 0x60000 : (__rom_bank46_size > 0 ? 0x5e000 : (__rom_bank45_size > 0 ? 0x5c000 : (__rom_bank44_size > 0 ? 0x5a000 : (__rom_bank43_size > 0 ? 0x58000 : (__rom_bank42_size > 0 ? 0x56000 : (__rom_bank41_size > 0 ? 0x54000 : (__rom_bank40_size > 0 ? 0x52000 : (__rom_bank39_size > 0 ? 0x50000 : (__rom_bank38_size > 0 ? 0x4e000 : (__rom_bank37_size > 0 ? 0x4c000 : (__rom_bank36_size > 0 ? 0x4a000 : (__rom_bank35_size > 0 ? 0x48000 : (__rom_bank34_size > 0 ? 0x46000 : (__rom_bank33_size > 0 ? 0x44000 : (__rom_bank32_size > 0 ? 0x42000 : (__rom_bank31_size > 0 ? 0x40000 : (__rom_bank30_size > 0 ? 0x3e000 : (__rom_bank29_size > 0 ? 0x3c000 : (__rom_bank28_size > 0 ? 0x3a000 : (__rom_bank27_size > 0 ? 0x38000 : (__rom_bank26_size > 0 ? 0x36000 : (__rom_bank25_size > 0 ? 0x34000 : (__rom_bank24_size > 0 ? 0x32000 : (__rom_bank23_size > 0 ? 0x30000 : (__rom_bank22_size > 0 ? 0x2e000 : (__rom_bank21_size > 0 ? 0x2c000 : (__rom_bank20_size > 0 ? 0x2a000 : (__rom_bank19_size > 0 ? 0x28000 : (__rom_bank18_size > 0 ? 0x26000 : (__rom_bank17_size > 0 ? 0x24000 : (__rom_bank16_size > 0 ? 0x22000 : (__rom_bank15_size > 0 ? 0x20000 : (__rom_bank14_size > 0 ? 0x1e000 : (__rom_bank13_size > 0 ? 0x1c000 : (__rom_bank12_size > 0 ? 0x1a000 : (__rom_bank11_size > 0 ? 0x18000 : (__rom_bank10_size > 0 ? 0x16000 : (__rom_bank9_size > 0 ? 0x14000 : (__rom_bank8_size > 0 ? 0x12000 : (__rom_bank7_size > 0 ? 0x10000 : (__rom_bank6_size > 0 ? 0xe000 : (__rom_bank5_size > 0 ? 0xc000 : (__rom_bank4_size > 0 ? 0xa000 : (__rom_bank3_size > 0 ? 0x8000 : (__rom_bank2_size > 0 ? 0x6000 : (__rom_bank1_size > 0 ? 0x4000 : 0))))))))))))))))))))))))))))))))))))))))))))))))))))))))))))))))))))))))))))))))))))))))))))))))))))))))))))))))))))))))))))))), __rom_bank0_size);

__rom_vbank0a = 0xe000;
__rom_vbank0a_size = 0x2000;
__rom_vbank0a_offset = 0;
__rom_vbank0a_bank = 0;
__rom_vbank0a_lma = __rom_vbank0a;
__rom_vbank0b = 0x10000 - __rom_bank0_size;
__rom_vbank0b_size = __rom_bank0_size - 0x2000;
__rom_vbank0b_offset = __rom_bank0_size > 0x2000 ? 0x2000 : 0;
__rom_vbank0b_bank = __rom_bank0_size > 0x2000 ? 1 : -1;
__rom_vbank0b_lma = __rom_vbank0b;

__rom_bank0_bank = 0;
__rom_bank1_bank = 1;
__rom_bank2_bank = 2;
__rom_bank3_bank = 3;
__rom_bank4_bank = 4;
__rom_bank5_bank = 5;
__rom_bank6_bank = 6;
__rom_bank7_bank = 7;
__rom_bank8_bank = 8;
__rom_bank9_bank = 9;
__rom_bank10_bank = 10;
__rom_bank11_bank = 11;
__rom_bank12_bank = 12;
__rom_bank13_bank = 13;
__rom_bank14_bank = 14;
__rom_bank15_bank = 15;
__rom_bank16_bank = 16;
__rom_bank17_bank = 17;
__rom_bank18_bank = 18;
__rom_bank19_bank = 19;
__rom_bank20_bank = 20;
__rom_bank21_bank = 21;
__rom_bank22_bank = 22;
__rom_bank23_bank = 23;
__rom_bank24_bank = 24;
__rom_bank25_bank = 25;
__rom_bank26_bank = 26;
__rom_bank27_bank = 27;
__rom_bank28_bank = 28;
__rom_bank29_bank = 29;
__rom_bank30_bank = 30;
__rom_bank31_bank = 31;
__rom_bank32_bank = 32;
__rom_bank33_bank = 33;
__rom_bank34_bank = 34;
__rom_bank35_bank = 35;
__rom_bank36_bank = 36;
__rom_bank37_bank = 37;
__rom_bank38_bank = 38;
__rom_bank39_bank = 39;
__rom_bank40_bank = 40;
__rom_bank41_bank = 41;
__rom_bank42_bank = 42;
__rom_bank43_bank = 43;
__rom_bank44_bank = 44;
__rom_bank45_bank = 45;
__rom_bank46_bank = 46;
__rom_bank47_bank = 47;
__rom_bank48_bank = 48;
__rom_bank49_bank = 49;
__rom_bank50_bank = 50;
__rom_bank51_bank = 51;
__rom_bank52_bank = 52;
__rom_bank53_bank = 53;
__rom_bank54_bank = 54;
__rom_bank55_bank = 55;
__rom_bank56_bank = 56;
__rom_bank57_bank = 57;
__rom_bank58_bank = 58;
__rom_bank59_bank = 59;
__rom_bank60_bank = 60;
__rom_bank61_bank = 61;
__rom_bank62_bank = 62;
__rom_bank63_bank = 63;
__rom_bank64_bank = 64;
__rom_bank65_bank = 65;
__rom_bank66_bank = 66;
__rom_bank67_bank = 67;
__rom_bank68_bank = 68;
__rom_bank69_bank = 69;
__rom_bank70_bank = 70;
__rom_bank71_bank = 71;
__rom_bank72_bank = 72;
__rom_bank73_bank = 73;
__rom_bank74_bank = 74;
__rom_bank75_bank = 75;
__rom_bank76_bank = 76;
__rom_bank77_bank = 77;
__rom_bank78_bank = 78;
__rom_bank79_bank = 79;
__rom_bank80_bank = 80;
__rom_bank81_bank = 81;
__rom_bank82_bank = 82;
__rom_bank83_bank = 83;
__rom_bank84_bank = 84;
__rom_bank85_bank = 85;
__rom_bank86_bank = 86;
__rom_bank87_bank = 87;
__rom_bank88_bank = 88;
__rom_bank89_bank = 89;
__rom_bank90_bank = 90;
__rom_bank91_bank = 91;
__rom_bank92_bank = 92;
__rom_bank93_bank = 93;
__rom_bank94_bank = 94;
__rom_bank95_bank = 95;
__rom_bank96_bank = 96;
__rom_bank97_bank = 97;
__rom_bank98_bank = 98;
__rom_bank99_bank = 99;
__rom_bank100_bank = 100;
__rom_bank101_bank = 101;
__rom_bank102_bank = 102;
__rom_bank103_bank = 103;
__rom_bank104_bank = 104;
__rom_bank105_bank = 105;
__rom_bank106_bank = 106;
__rom_bank107_bank = 107;
__rom_bank108_bank = 108;
__rom_bank109_bank = 109;
__rom_bank110_bank = 110;
__rom_bank111_bank = 111;
__rom_bank112_bank = 112;
__rom_bank113_bank = 113;
__rom_bank114_bank = 114;
__rom_bank115_bank = 115;
__rom_bank116_bank = 116;
__rom_bank117_bank = 117;
__rom_bank118_bank = 118;
__rom_bank119_bank = 119;
__rom_bank120_bank = 120;
__rom_bank121_bank = 121;
__rom_bank122_bank = 122;
__rom_bank123_bank = 123;
__rom_bank124_bank = 124;
__rom_bank125_bank = 125;
__rom_bank126_bank = 126;
__rom_bank127_bank = 127;

MEMORY {
  rom_bank0 : ORIGIN = __rom_bank0, LENGTH = __rom_bank0_size
  rom_bank1 : ORIGIN = (0x010000 + __rom_bank1), LENGTH = (((__rom_size >= 0x4000) && (__rom_bank0_size < 0x4000)) ? 0x2000 : 0)
  rom_bank2 : ORIGIN = (0x020000 + __rom_bank2), LENGTH = (((__rom_size >= 0x6000) && (__rom_bank0_size < 0x6000)) ? 0x2000 : 0)
  rom_bank3 : ORIGIN = (0x030000 + __rom_bank3), LENGTH = (((__rom_size >= 0x8000) && (__rom_bank0_size < 0x8000)) ? 0x2000 : 0)
  rom_bank4 : ORIGIN = (0x040000 + __rom_bank4), LENGTH = (((__rom_size >= 0xa000) && (__rom_bank0_size < 0xa000)) ? 0x2000 : 0)
  rom_bank5 : ORIGIN = (0x050000 + __rom_bank5), LENGTH = (((__rom_size >= 0xc000) && (__rom_bank0_size < 0xc000)) ? 0x2000 : 0)
  rom_bank6 : ORIGIN = (0x060000 + __rom_bank6), LENGTH = (((__rom_size >= 0xe000) && (__rom_bank0_size < 0xe000)) ? 0x2000 : 0)
  rom_bank7 : ORIGIN = (0x070000 + __rom_bank7), LENGTH = (((__rom_size >= 0x10000) && (__rom_bank0_size < 0x10000)) ? 0x2000 : 0)
  rom_bank8 : ORIGIN = (0x080000 + __rom_bank8), LENGTH = (__rom_size >= 0x12000 ? 0x2000 : 0)
  rom_bank9 : ORIGIN = (0x090000 + __rom_bank9), LENGTH = (__rom_size >= 0x14000 ? 0x2000 : 0)
  rom_bank10 : ORIGIN = (0x0a0000 + __rom_bank10), LENGTH = (__rom_size >= 0x16000 ? 0x2000 : 0)
  rom_bank11 : ORIGIN = (0x0b0000 + __rom_bank11), LENGTH = (__rom_size >= 0x18000 ? 0x2000 : 0)
  rom_bank12 : ORIGIN = (0x0c0000 + __rom_bank12), LENGTH = (__rom_size >= 0x1a000 ? 0x2000 : 0)
  rom_bank13 : ORIGIN = (0x0d0000 + __rom_bank13), LENGTH = (__rom_size >= 0x1c000 ? 0x2000 : 0)
  rom_bank14 : ORIGIN = (0x0e0000 + __rom_bank14), LENGTH = (__rom_size >= 0x1e000 ? 0x2000 : 0)
  rom_bank15 : ORIGIN = (0x0f0000 + __rom_bank15), LENGTH = (__rom_size >= 0x20000 ? 0x2000 : 0)
  rom_bank16 : ORIGIN = (0x100000 + __rom_bank16), LENGTH = (__rom_size >= 0x22000 ? 0x2000 : 0)
  rom_bank17 : ORIGIN = (0x110000 + __rom_bank17), LENGTH = (__rom_size >= 0x24000 ? 0x2000 : 0)
  rom_bank18 : ORIGIN = (0x120000 + __rom_bank18), LENGTH = (__rom_size >= 0x26000 ? 0x2000 : 0)
  rom_bank19 : ORIGIN = (0x130000 + __rom_bank19), LENGTH = (__rom_size >= 0x28000 ? 0x2000 : 0)
  rom_bank20 : ORIGIN = (0x140000 + __rom_bank20), LENGTH = (__rom_size >= 0x2a000 ? 0x2000 : 0)
  rom_bank21 : ORIGIN = (0x150000 + __rom_bank21), LENGTH = (__rom_size >= 0x2c000 ? 0x2000 : 0)
  rom_bank22 : ORIGIN = (0x160000 + __rom_bank22), LENGTH = (__rom_size >= 0x2e000 ? 0x2000 : 0)
  rom_bank23 : ORIGIN = (0x170000 + __rom_bank23), LENGTH = (__rom_size >= 0x30000 ? 0x2000 : 0)
  rom_bank24 : ORIGIN = (0x180000 + __rom_bank24), LENGTH = (__rom_size >= 0x32000 ? 0x2000 : 0)
  rom_bank25 : ORIGIN = (0x190000 + __rom_bank25), LENGTH = (__rom_size >= 0x34000 ? 0x2000 : 0)
  rom_bank26 : ORIGIN = (0x1a0000 + __rom_bank26), LENGTH = (__rom_size >= 0x36000 ? 0x2000 : 0)
  rom_bank27 : ORIGIN = (0x1b0000 + __rom_bank27), LENGTH = (__rom_size >= 0x38000 ? 0x2000 : 0)
  rom_bank28 : ORIGIN = (0x1c0000 + __rom_bank28), LENGTH = (__rom_size >= 0x3a000 ? 0x2000 : 0)
  rom_bank29 : ORIGIN = (0x1d0000 + __rom_bank29), LENGTH = (__rom_size >= 0x3c000 ? 0x2000 : 0)
  rom_bank30 : ORIGIN = (0x1e0000 + __rom_bank30), LENGTH = (__rom_size >= 0x3e000 ? 0x2000 : 0)
  rom_bank31 : ORIGIN = (0x1f0000 + __rom_bank31), LENGTH = (__rom_size >= 0x40000 ? 0x2000 : 0)
  rom_bank32 : ORIGIN = (0x200000 + __rom_bank32), LENGTH = (__rom_size >= 0x42000 ? 0x2000 : 0)
  rom_bank33 : ORIGIN = (0x210000 + __rom_bank33), LENGTH = (__rom_size >= 0x44000 ? 0x2000 : 0)
  rom_bank34 : ORIGIN = (0x220000 + __rom_bank34), LENGTH = (__rom_size >= 0x46000 ? 0x2000 : 0)
  rom_bank35 : ORIGIN = (0x230000 + __rom_bank35), LENGTH = (__rom_size >= 0x48000 ? 0x2000 : 0)
  rom_bank36 : ORIGIN = (0x240000 + __rom_bank36), LENGTH = (__rom_size >= 0x4a000 ? 0x2000 : 0)
  rom_bank37 : ORIGIN = (0x250000 + __rom_bank37), LENGTH = (__rom_size >= 0x4c000 ? 0x2000 : 0)
  rom_bank38 : ORIGIN = (0x260000 + __rom_bank38), LENGTH = (__rom_size >= 0x4e000 ? 0x2000 : 0)
  rom_bank39 : ORIGIN = (0x270000 + __rom_bank39), LENGTH = (__rom_size >= 0x50000 ? 0x2000 : 0)
  rom_bank40 : ORIGIN = (0x280000 + __rom_bank40), LENGTH = (__rom_size >= 0x52000 ? 0x2000 : 0)
  rom_bank41 : ORIGIN = (0x290000 + __rom_bank41), LENGTH = (__rom_size >= 0x54000 ? 0x2000 : 0)
  rom_bank42 : ORIGIN = (0x2a0000 + __rom_bank42), LENGTH = (__rom_size >= 0x56000 ? 0x2000 : 0)
  rom_bank43 : ORIGIN = (0x2b0000 + __rom_bank43), LENGTH = (__rom_size >= 0x58000 ? 0x2000 : 0)
  rom_bank44 : ORIGIN = (0x2c0000 + __rom_bank44), LENGTH = (__rom_size >= 0x5a000 ? 0x2000 : 0)
  rom_bank45 : ORIGIN = (0x2d0000 + __rom_bank45), LENGTH = (__rom_size >= 0x5c000 ? 0x2000 : 0)
  rom_bank46 : ORIGIN = (0x2e0000 + __rom_bank46), LENGTH = (__rom_size >= 0x5e000 ? 0x2000 : 0)
  rom_bank47 : ORIGIN = (0x2f0000 + __rom_bank47), LENGTH = (__rom_size >= 0x60000 ? 0x2000 : 0)
  rom_bank48 : ORIGIN = (0x300000 + __rom_bank48), LENGTH = (__rom_size >= 0x62000 ? 0x2000 : 0)
  rom_bank49 : ORIGIN = (0x310000 + __rom_bank49), LENGTH = (__rom_size >= 0x64000 ? 0x2000 : 0)
  rom_bank50 : ORIGIN = (0x320000 + __rom_bank50), LENGTH = (__rom_size >= 0x66000 ? 0x2000 : 0)
  rom_bank51 : ORIGIN = (0x330000 + __rom_bank51), LENGTH = (__rom_size >= 0x68000 ? 0x2000 : 0)
  rom_bank52 : ORIGIN = (0x340000 + __rom_bank52), LENGTH = (__rom_size >= 0x6a000 ? 0x2000 : 0)
  rom_bank53 : ORIGIN = (0x350000 + __rom_bank53), LENGTH = (__rom_size >= 0x6c000 ? 0x2000 : 0)
  rom_bank54 : ORIGIN = (0x360000 + __rom_bank54), LENGTH = (__rom_size >= 0x6e000 ? 0x2000 : 0)
  rom_bank55 : ORIGIN = (0x370000 + __rom_bank55), LENGTH = (__rom_size >= 0x70000 ? 0x2000 : 0)
  rom_bank56 : ORIGIN = (0x380000 + __rom_bank56), LENGTH = (__rom_size >= 0x72000 ? 0x2000 : 0)
  rom_bank57 : ORIGIN = (0x390000 + __rom_bank57), LENGTH = (__rom_size >= 0x74000 ? 0x2000 : 0)
  rom_bank58 : ORIGIN = (0x3a0000 + __rom_bank58), LENGTH = (__rom_size >= 0x76000 ? 0x2000 : 0)
  rom_bank59 : ORIGIN = (0x3b0000 + __rom_bank59), LENGTH = (__rom_size >= 0x78000 ? 0x2000 : 0)
  rom_bank60 : ORIGIN = (0x3c0000 + __rom_bank60), LENGTH = (__rom_size >= 0x7a000 ? 0x2000 : 0)
  rom_bank61 : ORIGIN = (0x3d0000 + __rom_bank61), LENGTH = (__rom_size >= 0x7c000 ? 0x2000 : 0)
  rom_bank62 : ORIGIN = (0x3e0000 + __rom_bank62), LENGTH = (__rom_size >= 0x7e000 ? 0x2000 : 0)
  rom_bank63 : ORIGIN = (0x3f0000 + __rom_bank63), LENGTH = (__rom_size >= 0x80000 ? 0x2000 : 0)
  rom_bank64 : ORIGIN = (0x400000 + __rom_bank64), LENGTH = (__rom_size >= 0x82000 ? 0x2000 : 0)
  rom_bank65 : ORIGIN = (0x410000 + __rom_bank65), LENGTH = (__rom_size >= 0x84000 ? 0x2000 : 0)
  rom_bank66 : ORIGIN = (0x420000 + __rom_bank66), LENGTH = (__rom_size >= 0x86000 ? 0x2000 : 0)
  rom_bank67 : ORIGIN = (0x430000 + __rom_bank67), LENGTH = (__rom_size >= 0x88000 ? 0x2000 : 0)
  rom_bank68 : ORIGIN = (0x440000 + __rom_bank68), LENGTH = (__rom_size >= 0x8a000 ? 0x2000 : 0)
  rom_bank69 : ORIGIN = (0x450000 + __rom_bank69), LENGTH = (__rom_size >= 0x8c000 ? 0x2000 : 0)
  rom_bank70 : ORIGIN = (0x460000 + __rom_bank70), LENGTH = (__rom_size >= 0x8e000 ? 0x2000 : 0)
  rom_bank71 : ORIGIN = (0x470000 + __rom_bank71), LENGTH = (__rom_size >= 0x90000 ? 0x2000 : 0)
  rom_bank72 : ORIGIN = (0x480000 + __rom_bank72), LENGTH = (__rom_size >= 0x92000 ? 0x2000 : 0)
  rom_bank73 : ORIGIN = (0x490000 + __rom_bank73), LENGTH = (__rom_size >= 0x94000 ? 0x2000 : 0)
  rom_bank74 : ORIGIN = (0x4a0000 + __rom_bank74), LENGTH = (__rom_size >= 0x96000 ? 0x2000 : 0)
  rom_bank75 : ORIGIN = (0x4b0000 + __rom_bank75), LENGTH = (__rom_size >= 0x98000 ? 0x2000 : 0)
  rom_bank76 : ORIGIN = (0x4c0000 + __rom_bank76), LENGTH = (__rom_size >= 0x9a000 ? 0x2000 : 0)
  rom_bank77 : ORIGIN = (0x4d0000 + __rom_bank77), LENGTH = (__rom_size >= 0x9c000 ? 0x2000 : 0)
  rom_bank78 : ORIGIN = (0x4e0000 + __rom_bank78), LENGTH = (__rom_size >= 0x9e000 ? 0x2000 : 0)
  rom_bank79 : ORIGIN = (0x4f0000 + __rom_bank79), LENGTH = (__rom_size >= 0xa0000 ? 0x2000 : 0)
  rom_bank80 : ORIGIN = (0x500000 + __rom_bank80), LENGTH = (__rom_size >= 0xa2000 ? 0x2000 : 0)
  rom_bank81 : ORIGIN = (0x510000 + __rom_bank81), LENGTH = (__rom_size >= 0xa4000 ? 0x2000 : 0)
  rom_bank82 : ORIGIN = (0x520000 + __rom_bank82), LENGTH = (__rom_size >= 0xa6000 ? 0x2000 : 0)
  rom_bank83 : ORIGIN = (0x530000 + __rom_bank83), LENGTH = (__rom_size >= 0xa8000 ? 0x2000 : 0)
  rom_bank84 : ORIGIN = (0x540000 + __rom_bank84), LENGTH = (__rom_size >= 0xaa000 ? 0x2000 : 0)
  rom_bank85 : ORIGIN = (0x550000 + __rom_bank85), LENGTH = (__rom_size >= 0xac000 ? 0x2000 : 0)
  rom_bank86 : ORIGIN = (0x560000 + __rom_bank86), LENGTH = (__rom_size >= 0xae000 ? 0x2000 : 0)
  rom_bank87 : ORIGIN = (0x570000 + __rom_bank87), LENGTH = (__rom_size >= 0xb0000 ? 0x2000 : 0)
  rom_bank88 : ORIGIN = (0x580000 + __rom_bank88), LENGTH = (__rom_size >= 0xb2000 ? 0x2000 : 0)
  rom_bank89 : ORIGIN = (0x590000 + __rom_bank89), LENGTH = (__rom_size >= 0xb4000 ? 0x2000 : 0)
  rom_bank90 : ORIGIN = (0x5a0000 + __rom_bank90), LENGTH = (__rom_size >= 0xb6000 ? 0x2000 : 0)
  rom_bank91 : ORIGIN = (0x5b0000 + __rom_bank91), LENGTH = (__rom_size >= 0xb8000 ? 0x2000 : 0)
  rom_bank92 : ORIGIN = (0x5c0000 + __rom_bank92), LENGTH = (__rom_size >= 0xba000 ? 0x2000 : 0)
  rom_bank93 : ORIGIN = (0x5d0000 + __rom_bank93), LENGTH = (__rom_size >= 0xbc000 ? 0x2000 : 0)
  rom_bank94 : ORIGIN = (0x5e0000 + __rom_bank94), LENGTH = (__rom_size >= 0xbe000 ? 0x2000 : 0)
  rom_bank95 : ORIGIN = (0x5f0000 + __rom_bank95), LENGTH = (__rom_size >= 0xc0000 ? 0x2000 : 0)
  rom_bank96 : ORIGIN = (0x600000 + __rom_bank96), LENGTH = (__rom_size >= 0xc2000 ? 0x2000 : 0)
  rom_bank97 : ORIGIN = (0x610000 + __rom_bank97), LENGTH = (__rom_size >= 0xc4000 ? 0x2000 : 0)
  rom_bank98 : ORIGIN = (0x620000 + __rom_bank98), LENGTH = (__rom_size >= 0xc6000 ? 0x2000 : 0)
  rom_bank99 : ORIGIN = (0x630000 + __rom_bank99), LENGTH = (__rom_size >= 0xc8000 ? 0x2000 : 0)
  rom_bank100 : ORIGIN = (0x640000 + __rom_bank100), LENGTH = (__rom_size >= 0xca000 ? 0x2000 : 0)
  rom_bank101 : ORIGIN = (0x650000 + __rom_bank101), LENGTH = (__rom_size >= 0xcc000 ? 0x2000 : 0)
  rom_bank102 : ORIGIN = (0x660000 + __rom_bank102), LENGTH = (__rom_size >= 0xce000 ? 0x2000 : 0)
  rom_bank103 : ORIGIN = (0x670000 + __rom_bank103), LENGTH = (__rom_size >= 0xd0000 ? 0x2000 : 0)
  rom_bank104 : ORIGIN = (0x680000 + __rom_bank104), LENGTH = (__rom_size >= 0xd2000 ? 0x2000 : 0)
  rom_bank105 : ORIGIN = (0x690000 + __rom_bank105), LENGTH = (__rom_size >= 0xd4000 ? 0x2000 : 0)
  rom_bank106 : ORIGIN = (0x6a0000 + __rom_bank106), LENGTH = (__rom_size >= 0xd6000 ? 0x2000 : 0)
  rom_bank107 : ORIGIN = (0x6b0000 + __rom_bank107), LENGTH = (__rom_size >= 0xd8000 ? 0x2000 : 0)
  rom_bank108 : ORIGIN = (0x6c0000 + __rom_bank108), LENGTH = (__rom_size >= 0xda000 ? 0x2000 : 0)
  rom_bank109 : ORIGIN = (0x6d0000 + __rom_bank109), LENGTH = (__rom_size >= 0xdc000 ? 0x2000 : 0)
  rom_bank110 : ORIGIN = (0x6e0000 + __rom_bank110), LENGTH = (__rom_size >= 0xde000 ? 0x2000 : 0)
  rom_bank111 : ORIGIN = (0x6f0000 + __rom_bank111), LENGTH = (__rom_size >= 0xe0000 ? 0x2000 : 0)
  rom_bank112 : ORIGIN = (0x700000 + __rom_bank112), LENGTH = (__rom_size >= 0xe2000 ? 0x2000 : 0)
  rom_bank113 : ORIGIN = (0x710000 + __rom_bank113), LENGTH = (__rom_size >= 0xe4000 ? 0x2000 : 0)
  rom_bank114 : ORIGIN = (0x720000 + __rom_bank114), LENGTH = (__rom_size >= 0xe6000 ? 0x2000 : 0)
  rom_bank115 : ORIGIN = (0x730000 + __rom_bank115), LENGTH = (__rom_size >= 0xe8000 ? 0x2000 : 0)
  rom_bank116 : ORIGIN = (0x740000 + __rom_bank116), LENGTH = (__rom_size >= 0xea000 ? 0x2000 : 0)
  rom_bank117 : ORIGIN = (0x750000 + __rom_bank117), LENGTH = (__rom_size >= 0xec000 ? 0x2000 : 0)
  rom_bank118 : ORIGIN = (0x760000 + __rom_bank118), LENGTH = (__rom_size >= 0xee000 ? 0x2000 : 0)
  rom_bank119 : ORIGIN = (0x770000 + __rom_bank119), LENGTH = (__rom_size >= 0xf0000 ? 0x2000 : 0)
  rom_bank120 : ORIGIN = (0x780000 + __rom_bank120), LENGTH = (__rom_size >= 0xf2000 ? 0x2000 : 0)
  rom_bank121 : ORIGIN = (0x790000 + __rom_bank121), LENGTH = (__rom_size >= 0xf4000 ? 0x2000 : 0)
  rom_bank122 : ORIGIN = (0x7a0000 + __rom_bank122), LENGTH = (__rom_size >= 0xf6000 ? 0x2000 : 0)
  rom_bank123 : ORIGIN = (0x7b0000 + __rom_bank123), LENGTH = (__rom_size >= 0xf8000 ? 0x2000 : 0)
  rom_bank124 : ORIGIN = (0x7c0000 + __rom_bank124), LENGTH = (__rom_size >= 0xfa000 ? 0x2000 : 0)
  rom_bank125 : ORIGIN = (0x7d0000 + __rom_bank125), LENGTH = (__rom_size >= 0xfc000 ? 0x2000 : 0)
  rom_bank126 : ORIGIN = (0x7e0000 + __rom_bank126), LENGTH = (__rom_size >= 0xfe000 ? 0x2000 : 0)
  rom_bank127 : ORIGIN = (0x7f0000 + __rom_bank127), LENGTH = (__rom_size >= 0x100000 ? 0x2000 : 0)
}

SECTIONS {
  .rom_bank0 : { *(.rom_bank0 .rom_bank0.*) } >rom_bank0
  .rom_bank1 : { *(.rom_bank1 .rom_bank1.*) } >rom_bank1
  .rom_bank2 : { *(.rom_bank2 .rom_bank2.*) } >rom_bank2
  .rom_bank3 : { *(.rom_bank3 .rom_bank3.*) } >rom_bank3
  .rom_bank4 : { *(.rom_bank4 .rom_bank4.*) } >rom_bank4
  .rom_bank5 : { *(.rom_bank5 .rom_bank5.*) } >rom_bank5
  .rom_bank6 : { *(.rom_bank6 .rom_bank6.*) } >rom_bank6
  .rom_bank7 : { *(.rom_bank7 .rom_bank7.*) } >rom_bank7
  .rom_bank8 : { *(.rom_bank8 .rom_bank8.*) } >rom_bank8
  .rom_bank9 : { *(.rom_bank9 .rom_bank9.*) } >rom_bank9
  .rom_bank10 : { *(.rom_bank10 .rom_bank10.*) } >rom_bank10
  .rom_bank11 : { *(.rom_bank11 .rom_bank11.*) } >rom_bank11
  .rom_bank12 : { *(.rom_bank12 .rom_bank12.*) } >rom_bank12
  .rom_bank13 : { *(.rom_bank13 .rom_bank13.*) } >rom_bank13
  .rom_bank14 : { *(.rom_bank14 .rom_bank14.*) } >rom_bank14
  .rom_bank15 : { *(.rom_bank15 .rom_bank15.*) } >rom_bank15
  .rom_bank16 : { *(.rom_bank16 .rom_bank16.*) } >rom_bank16
  .rom_bank17 : { *(.rom_bank17 .rom_bank17.*) } >rom_bank17
  .rom_bank18 : { *(.rom_bank18 .rom_bank18.*) } >rom_bank18
  .rom_bank19 : { *(.rom_bank19 .rom_bank19.*) } >rom_bank19
  .rom_bank20 : { *(.rom_bank20 .rom_bank20.*) } >rom_bank20
  .rom_bank21 : { *(.rom_bank21 .rom_bank21.*) } >rom_bank21
  .rom_bank22 : { *(.rom_bank22 .rom_bank22.*) } >rom_bank22
  .rom_bank23 : { *(.rom_bank23 .rom_bank23.*) } >rom_bank23
  .rom_bank24 : { *(.rom_bank24 .rom_bank24.*) } >rom_bank24
  .rom_bank25 : { *(.rom_bank25 .rom_bank25.*) } >rom_bank25
  .rom_bank26 : { *(.rom_bank26 .rom_bank26.*) } >rom_bank26
  .rom_bank27 : { *(.rom_bank27 .rom_bank27.*) } >rom_bank27
  .rom_bank28 : { *(.rom_bank28 .rom_bank28.*) } >rom_bank28
  .rom_bank29 : { *(.rom_bank29 .rom_bank29.*) } >rom_bank29
  .rom_bank30 : { *(.rom_bank30 .rom_bank30.*) } >rom_bank30
  .rom_bank31 : { *(.rom_bank31 .rom_bank31.*) } >rom_bank31
  .rom_bank32 : { *(.rom_bank32 .rom_bank32.*) } >rom_bank32
  .rom_bank33 : { *(.rom_bank33 .rom_bank33.*) } >rom_bank33
  .rom_bank34 : { *(.rom_bank34 .rom_bank34.*) } >rom_bank34
  .rom_bank35 : { *(.rom_bank35 .rom_bank35.*) } >rom_bank35
  .rom_bank36 : { *(.rom_bank36 .rom_bank36.*) } >rom_bank36
  .rom_bank37 : { *(.rom_bank37 .rom_bank37.*) } >rom_bank37
  .rom_bank38 : { *(.rom_bank38 .rom_bank38.*) } >rom_bank38
  .rom_bank39 : { *(.rom_bank39 .rom_bank39.*) } >rom_bank39
  .rom_bank40 : { *(.rom_bank40 .rom_bank40.*) } >rom_bank40
  .rom_bank41 : { *(.rom_bank41 .rom_bank41.*) } >rom_bank41
  .rom_bank42 : { *(.rom_bank42 .rom_bank42.*) } >rom_bank42
  .rom_bank43 : { *(.rom_bank43 .rom_bank43.*) } >rom_bank43
  .rom_bank44 : { *(.rom_bank44 .rom_bank44.*) } >rom_bank44
  .rom_bank45 : { *(.rom_bank45 .rom_bank45.*) } >rom_bank45
  .rom_bank46 : { *(.rom_bank46 .rom_bank46.*) } >rom_bank46
  .rom_bank47 : { *(.rom_bank47 .rom_bank47.*) } >rom_bank47
  .rom_bank48 : { *(.rom_bank48 .rom_bank48.*) } >rom_bank48
  .rom_bank49 : { *(.rom_bank49 .rom_bank49.*) } >rom_bank49
  .rom_bank50 : { *(.rom_bank50 .rom_bank50.*) } >rom_bank50
  .rom_bank51 : { *(.rom_bank51 .rom_bank51.*) } >rom_bank51
  .rom_bank52 : { *(.rom_bank52 .rom_bank52.*) } >rom_bank52
  .rom_bank53 : { *(.rom_bank53 .rom_bank53.*) } >rom_bank53
  .rom_bank54 : { *(.rom_bank54 .rom_bank54.*) } >rom_bank54
  .rom_bank55 : { *(.rom_bank55 .rom_bank55.*) } >rom_bank55
  .rom_bank56 : { *(.rom_bank56 .rom_bank56.*) } >rom_bank56
  .rom_bank57 : { *(.rom_bank57 .rom_bank57.*) } >rom_bank57
  .rom_bank58 : { *(.rom_bank58 .rom_bank58.*) } >rom_bank58
  .rom_bank59 : { *(.rom_bank59 .rom_bank59.*) } >rom_bank59
  .rom_bank60 : { *(.rom_bank60 .rom_bank60.*) } >rom_bank60
  .rom_bank61 : { *(.rom_bank61 .rom_bank61.*) } >rom_bank61
  .rom_bank62 : { *(.rom_bank62 .rom_bank62.*) } >rom_bank62
  .rom_bank63 : { *(.rom_bank63 .rom_bank63.*) } >rom_bank63
  .rom_bank64 : { *(.rom_bank64 .rom_bank64.*) } >rom_bank64
  .rom_bank65 : { *(.rom_bank65 .rom_bank65.*) } >rom_bank65
  .rom_bank66 : { *(.rom_bank66 .rom_bank66.*) } >rom_bank66
  .rom_bank67 : { *(.rom_bank67 .rom_bank67.*) } >rom_bank67
  .rom_bank68 : { *(.rom_bank68 .rom_bank68.*) } >rom_bank68
  .rom_bank69 : { *(.rom_bank69 .rom_bank69.*) } >rom_bank69
  .rom_bank70 : { *(.rom_bank70 .rom_bank70.*) } >rom_bank70
  .rom_bank71 : { *(.rom_bank71 .rom_bank71.*) } >rom_bank71
  .rom_bank72 : { *(.rom_bank72 .rom_bank72.*) } >rom_bank72
  .rom_bank73 : { *(.rom_bank73 .rom_bank73.*) } >rom_bank73
  .rom_bank74 : { *(.rom_bank74 .rom_bank74.*) } >rom_bank74
  .rom_bank75 : { *(.rom_bank75 .rom_bank75.*) } >rom_bank75
  .rom_bank76 : { *(.rom_bank76 .rom_bank76.*) } >rom_bank76
  .rom_bank77 : { *(.rom_bank77 .rom_bank77.*) } >rom_bank77
  .rom_bank78 : { *(.rom_bank78 .rom_bank78.*) } >rom_bank78
  .rom_bank79 : { *(.rom_bank79 .rom_bank79.*) } >rom_bank79
  .rom_bank80 : { *(.rom_bank80 .rom_bank80.*) } >rom_bank80
  .rom_bank81 : { *(.rom_bank81 .rom_bank81.*) } >rom_bank81
  .rom_bank82 : { *(.rom_bank82 .rom_bank82.*) } >rom_bank82
  .rom_bank83 : { *(.rom_bank83 .rom_bank83.*) } >rom_bank83
  .rom_bank84 : { *(.rom_bank84 .rom_bank84.*) } >rom_bank84
  .rom_bank85 : { *(.rom_bank85 .rom_bank85.*) } >rom_bank85
  .rom_bank86 : { *(.rom_bank86 .rom_bank86.*) } >rom_bank86
  .rom_bank87 : { *(.rom_bank87 .rom_bank87.*) } >rom_bank87
  .rom_bank88 : { *(.rom_bank88 .rom_bank88.*) } >rom_bank88
  .rom_bank89 : { *(.rom_bank89 .rom_bank89.*) } >rom_bank89
  .rom_bank90 : { *(.rom_bank90 .rom_bank90.*) } >rom_bank90
  .rom_bank91 : { *(.rom_bank91 .rom_bank91.*) } >rom_bank91
  .rom_bank92 : { *(.rom_bank92 .rom_bank92.*) } >rom_bank92
  .rom_bank93 : { *(.rom_bank93 .rom_bank93.*) } >rom_bank93
  .rom_bank94 : { *(.rom_bank94 .rom_bank94.*) } >rom_bank94
  .rom_bank95 : { *(.rom_bank95 .rom_bank95.*) } >rom_bank95
  .rom_bank96 : { *(.rom_bank96 .rom_bank96.*) } >rom_bank96
  .rom_bank97 : { *(.rom_bank97 .rom_bank97.*) } >rom_bank97
  .rom_bank98 : { *(.rom_bank98 .rom_bank98.*) } >rom_bank98
  .rom_bank99 : { *(.rom_bank99 .rom_bank99.*) } >rom_bank99
  .rom_bank100 : { *(.rom_bank100 .rom_bank100.*) } >rom_bank100
  .rom_bank101 : { *(.rom_bank101 .rom_bank101.*) } >rom_bank101
  .rom_bank102 : { *(.rom_bank102 .rom_bank102.*) } >rom_bank102
  .rom_bank103 : { *(.rom_bank103 .rom_bank103.*) } >rom_bank103
  .rom_bank104 : { *(.rom_bank104 .rom_bank104.*) } >rom_bank104
  .rom_bank105 : { *(.rom_bank105 .rom_bank105.*) } >rom_bank105
  .rom_bank106 : { *(.rom_bank106 .rom_bank106.*) } >rom_bank106
  .rom_bank107 : { *(.rom_bank107 .rom_bank107.*) } >rom_bank107
  .rom_bank108 : { *(.rom_bank108 .rom_bank108.*) } >rom_bank108
  .rom_bank109 : { *(.rom_bank109 .rom_bank109.*) } >rom_bank109
  .rom_bank110 : { *(.rom_bank110 .rom_bank110.*) } >rom_bank110
  .rom_bank111 : { *(.rom_bank111 .rom_bank111.*) } >rom_bank111
  .rom_bank112 : { *(.rom_bank112 .rom_bank112.*) } >rom_bank112
  .rom_bank113 : { *(.rom_bank113 .rom_bank113.*) } >rom_bank113
  .rom_bank114 : { *(.rom_bank114 .rom_bank114.*) } >rom_bank114
  .rom_bank115 : { *(.rom_bank115 .rom_bank115.*) } >rom_bank115
  .rom_bank116 : { *(.rom_bank116 .rom_bank116.*) } >rom_bank116
  .rom_bank117 : { *(.rom_bank117 .rom_bank117.*) } >rom_bank117
  .rom_bank118 : { *(.rom_bank118 .rom_bank118.*) } >rom_bank118
  .rom_bank119 : { *(.rom_bank119 .rom_bank119.*) } >rom_bank119
  .rom_bank120 : { *(.rom_bank120 .rom_bank120.*) } >rom_bank120
  .rom_bank121 : { *(.rom_bank121 .rom_bank121.*) } >rom_bank121
  .rom_bank122 : { *(.rom_bank122 .rom_bank122.*) } >rom_bank122
  .rom_bank123 : { *(.rom_bank123 .rom_bank123.*) } >rom_bank123
  .rom_bank124 : { *(.rom_bank124 .rom_bank124.*) } >rom_bank124
  .rom_bank125 : { *(.rom_bank125 .rom_bank125.*) } >rom_bank125
  .rom_bank126 : { *(.rom_bank126 .rom_bank126.*) } >rom_bank126
  .rom_bank127 : { *(.rom_bank127 .rom_bank127.*) } >rom_bank127
}

OUTPUT_FORMAT {
  FULL(rom_bank0, __rom_bank0_size - 0x2000, 0x2000)
  FULL(rom_bank0, 0, __rom_bank0_size - 0x2000)
  FULL(rom_bank1)
  FULL(rom_bank2)
  FULL(rom_bank3)
  FULL(rom_bank4)
  FULL(rom_bank5)
  FULL(rom_bank6)
  FULL(rom_bank7)
  FULL(rom_bank8)
  FULL(rom_bank9)
  FULL(rom_bank10)
  FULL(rom_bank11)
  FULL(rom_bank12)
  FULL(rom_bank13)
  FULL(rom_bank14)
  FULL(rom_bank15)
  FULL(rom_bank16)
  FULL(rom_bank17)
  FULL(rom_bank18)
  FULL(rom_bank19)
  FULL(rom_bank20)
  FULL(rom_bank21)
  FULL(rom_bank22)
  FULL(rom_bank23)
  FULL(rom_bank24)
  FULL(rom_bank25)
  FULL(rom_bank26)
  FULL(rom_bank27)
  FULL(rom_bank28)
  FULL(rom_bank29)
  FULL(rom_bank30)
  FULL(rom_bank31)
  FULL(rom_bank32)
  FULL(rom_bank33)
  FULL(rom_bank34)
  FULL(rom_bank35)
  FULL(rom_bank36)
  FULL(rom_bank37)
  FULL(rom_bank38)
  FULL(rom_bank39)
  FULL(rom_bank40)
  FULL(rom_bank41)
  FULL(rom_bank42)
  FULL(rom_bank43)
  FULL(rom_bank44)
  FULL(rom_bank45)
  FULL(rom_bank46)
  FULL(rom_bank47)
  FULL(rom_bank48)
  FULL(rom_bank49)
  FULL(rom_bank50)
  FULL(rom_bank51)
  FULL(rom_bank52)
  FULL(rom_bank53)
  FULL(rom_bank54)
  FULL(rom_bank55)
  FULL(rom_bank56)
  FULL(rom_bank57)
  FULL(rom_bank58)
  FULL(rom_bank59)
  FULL(rom_bank60)
  FULL(rom_bank61)
  FULL(rom_bank62)
  FULL(rom_bank63)
  FULL(rom_bank64)
  FULL(rom_bank65)
  FULL(rom_bank66)
  FULL(rom_bank67)
  FULL(rom_bank68)
  FULL(rom_bank69)
  FULL(rom_bank70)
  FULL(rom_bank71)
  FULL(rom_bank72)
  FULL(rom_bank73)
  FULL(rom_bank74)
  FULL(rom_bank75)
  FULL(rom_bank76)
  FULL(rom_bank77)
  FULL(rom_bank78)
  FULL(rom_bank79)
  FULL(rom_bank80)
  FULL(rom_bank81)
  FULL(rom_bank82)
  FULL(rom_bank83)
  FULL(rom_bank84)
  FULL(rom_bank85)
  FULL(rom_bank86)
  FULL(rom_bank87)
  FULL(rom_bank88)
  FULL(rom_bank89)
  FULL(rom_bank90)
  FULL(rom_bank91)
  FULL(rom_bank92)
  FULL(rom_bank93)
  FULL(rom_bank94)
  FULL(rom_bank95)
  FULL(rom_bank96)
  FULL(rom_bank97)
  FULL(rom_bank98)
  FULL(rom_bank99)
  FULL(rom_bank100)
  FULL(rom_bank101)
  FULL(rom_bank102)
  FULL(rom_bank103)
  FULL(rom_bank104)
  FULL(rom_bank105)
  FULL(rom_bank106)
  FULL(rom_bank107)
  FULL(rom_bank108)
  FULL(rom_bank109)
  FULL(rom_bank110)
  FULL(rom_bank111)
  FULL(rom_bank112)
  FULL(rom_bank113)
  FULL(rom_bank114)
  FULL(rom_bank115)
  FULL(rom_bank116)
  FULL(rom_bank117)
  FULL(rom_bank118)
  FULL(rom_bank119)
  FULL(rom_bank120)
  FULL(rom_bank121)
  FULL(rom_bank122)
  FULL(rom_bank123)
  FULL(rom_bank124)
  FULL(rom_bank125)
  FULL(rom_bank126)
  FULL(rom_bank127)
}
