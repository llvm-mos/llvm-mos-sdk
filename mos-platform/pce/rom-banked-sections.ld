/* Automatically generated by generate-rom-banked-sections.lua. */

PROVIDE(__rom_bank0 = 0xe000);
PROVIDE(__rom_bank0_size = 0x2000);
PROVIDE(__rom_bank1 = 0xc000);
PROVIDE(__rom_bank1_size = 0);
PROVIDE(__rom_bank2 = 0xc000);
PROVIDE(__rom_bank2_size = 0);
PROVIDE(__rom_bank3 = 0xc000);
PROVIDE(__rom_bank3_size = 0);
PROVIDE(__rom_bank4 = 0xc000);
PROVIDE(__rom_bank4_size = 0);
PROVIDE(__rom_bank5 = 0xc000);
PROVIDE(__rom_bank5_size = 0);
PROVIDE(__rom_bank6 = 0xc000);
PROVIDE(__rom_bank6_size = 0);
PROVIDE(__rom_bank7 = 0xc000);
PROVIDE(__rom_bank7_size = 0);
PROVIDE(__rom_bank8 = 0xc000);
PROVIDE(__rom_bank8_size = 0);
PROVIDE(__rom_bank9 = 0xc000);
PROVIDE(__rom_bank9_size = 0);
PROVIDE(__rom_bank10 = 0xc000);
PROVIDE(__rom_bank10_size = 0);
PROVIDE(__rom_bank11 = 0xc000);
PROVIDE(__rom_bank11_size = 0);
PROVIDE(__rom_bank12 = 0xc000);
PROVIDE(__rom_bank12_size = 0);
PROVIDE(__rom_bank13 = 0xc000);
PROVIDE(__rom_bank13_size = 0);
PROVIDE(__rom_bank14 = 0xc000);
PROVIDE(__rom_bank14_size = 0);
PROVIDE(__rom_bank15 = 0xc000);
PROVIDE(__rom_bank15_size = 0);
PROVIDE(__rom_bank16 = 0xc000);
PROVIDE(__rom_bank16_size = 0);
PROVIDE(__rom_bank17 = 0xc000);
PROVIDE(__rom_bank17_size = 0);
PROVIDE(__rom_bank18 = 0xc000);
PROVIDE(__rom_bank18_size = 0);
PROVIDE(__rom_bank19 = 0xc000);
PROVIDE(__rom_bank19_size = 0);
PROVIDE(__rom_bank20 = 0xc000);
PROVIDE(__rom_bank20_size = 0);
PROVIDE(__rom_bank21 = 0xc000);
PROVIDE(__rom_bank21_size = 0);
PROVIDE(__rom_bank22 = 0xc000);
PROVIDE(__rom_bank22_size = 0);
PROVIDE(__rom_bank23 = 0xc000);
PROVIDE(__rom_bank23_size = 0);
PROVIDE(__rom_bank24 = 0xc000);
PROVIDE(__rom_bank24_size = 0);
PROVIDE(__rom_bank25 = 0xc000);
PROVIDE(__rom_bank25_size = 0);
PROVIDE(__rom_bank26 = 0xc000);
PROVIDE(__rom_bank26_size = 0);
PROVIDE(__rom_bank27 = 0xc000);
PROVIDE(__rom_bank27_size = 0);
PROVIDE(__rom_bank28 = 0xc000);
PROVIDE(__rom_bank28_size = 0);
PROVIDE(__rom_bank29 = 0xc000);
PROVIDE(__rom_bank29_size = 0);
PROVIDE(__rom_bank30 = 0xc000);
PROVIDE(__rom_bank30_size = 0);
PROVIDE(__rom_bank31 = 0xc000);
PROVIDE(__rom_bank31_size = 0);
PROVIDE(__rom_bank32 = 0xc000);
PROVIDE(__rom_bank32_size = 0);
PROVIDE(__rom_bank33 = 0xc000);
PROVIDE(__rom_bank33_size = 0);
PROVIDE(__rom_bank34 = 0xc000);
PROVIDE(__rom_bank34_size = 0);
PROVIDE(__rom_bank35 = 0xc000);
PROVIDE(__rom_bank35_size = 0);
PROVIDE(__rom_bank36 = 0xc000);
PROVIDE(__rom_bank36_size = 0);
PROVIDE(__rom_bank37 = 0xc000);
PROVIDE(__rom_bank37_size = 0);
PROVIDE(__rom_bank38 = 0xc000);
PROVIDE(__rom_bank38_size = 0);
PROVIDE(__rom_bank39 = 0xc000);
PROVIDE(__rom_bank39_size = 0);
PROVIDE(__rom_bank40 = 0xc000);
PROVIDE(__rom_bank40_size = 0);
PROVIDE(__rom_bank41 = 0xc000);
PROVIDE(__rom_bank41_size = 0);
PROVIDE(__rom_bank42 = 0xc000);
PROVIDE(__rom_bank42_size = 0);
PROVIDE(__rom_bank43 = 0xc000);
PROVIDE(__rom_bank43_size = 0);
PROVIDE(__rom_bank44 = 0xc000);
PROVIDE(__rom_bank44_size = 0);
PROVIDE(__rom_bank45 = 0xc000);
PROVIDE(__rom_bank45_size = 0);
PROVIDE(__rom_bank46 = 0xc000);
PROVIDE(__rom_bank46_size = 0);
PROVIDE(__rom_bank47 = 0xc000);
PROVIDE(__rom_bank47_size = 0);
PROVIDE(__rom_bank48 = 0xc000);
PROVIDE(__rom_bank48_size = 0);
PROVIDE(__rom_bank49 = 0xc000);
PROVIDE(__rom_bank49_size = 0);
PROVIDE(__rom_bank50 = 0xc000);
PROVIDE(__rom_bank50_size = 0);
PROVIDE(__rom_bank51 = 0xc000);
PROVIDE(__rom_bank51_size = 0);
PROVIDE(__rom_bank52 = 0xc000);
PROVIDE(__rom_bank52_size = 0);
PROVIDE(__rom_bank53 = 0xc000);
PROVIDE(__rom_bank53_size = 0);
PROVIDE(__rom_bank54 = 0xc000);
PROVIDE(__rom_bank54_size = 0);
PROVIDE(__rom_bank55 = 0xc000);
PROVIDE(__rom_bank55_size = 0);
PROVIDE(__rom_bank56 = 0xc000);
PROVIDE(__rom_bank56_size = 0);
PROVIDE(__rom_bank57 = 0xc000);
PROVIDE(__rom_bank57_size = 0);
PROVIDE(__rom_bank58 = 0xc000);
PROVIDE(__rom_bank58_size = 0);
PROVIDE(__rom_bank59 = 0xc000);
PROVIDE(__rom_bank59_size = 0);
PROVIDE(__rom_bank60 = 0xc000);
PROVIDE(__rom_bank60_size = 0);
PROVIDE(__rom_bank61 = 0xc000);
PROVIDE(__rom_bank61_size = 0);
PROVIDE(__rom_bank62 = 0xc000);
PROVIDE(__rom_bank62_size = 0);
PROVIDE(__rom_bank63 = 0xc000);
PROVIDE(__rom_bank63_size = 0);
PROVIDE(__rom_bank64 = 0xc000);
PROVIDE(__rom_bank64_size = 0);
PROVIDE(__rom_bank65 = 0xc000);
PROVIDE(__rom_bank65_size = 0);
PROVIDE(__rom_bank66 = 0xc000);
PROVIDE(__rom_bank66_size = 0);
PROVIDE(__rom_bank67 = 0xc000);
PROVIDE(__rom_bank67_size = 0);
PROVIDE(__rom_bank68 = 0xc000);
PROVIDE(__rom_bank68_size = 0);
PROVIDE(__rom_bank69 = 0xc000);
PROVIDE(__rom_bank69_size = 0);
PROVIDE(__rom_bank70 = 0xc000);
PROVIDE(__rom_bank70_size = 0);
PROVIDE(__rom_bank71 = 0xc000);
PROVIDE(__rom_bank71_size = 0);
PROVIDE(__rom_bank72 = 0xc000);
PROVIDE(__rom_bank72_size = 0);
PROVIDE(__rom_bank73 = 0xc000);
PROVIDE(__rom_bank73_size = 0);
PROVIDE(__rom_bank74 = 0xc000);
PROVIDE(__rom_bank74_size = 0);
PROVIDE(__rom_bank75 = 0xc000);
PROVIDE(__rom_bank75_size = 0);
PROVIDE(__rom_bank76 = 0xc000);
PROVIDE(__rom_bank76_size = 0);
PROVIDE(__rom_bank77 = 0xc000);
PROVIDE(__rom_bank77_size = 0);
PROVIDE(__rom_bank78 = 0xc000);
PROVIDE(__rom_bank78_size = 0);
PROVIDE(__rom_bank79 = 0xc000);
PROVIDE(__rom_bank79_size = 0);
PROVIDE(__rom_bank80 = 0xc000);
PROVIDE(__rom_bank80_size = 0);
PROVIDE(__rom_bank81 = 0xc000);
PROVIDE(__rom_bank81_size = 0);
PROVIDE(__rom_bank82 = 0xc000);
PROVIDE(__rom_bank82_size = 0);
PROVIDE(__rom_bank83 = 0xc000);
PROVIDE(__rom_bank83_size = 0);
PROVIDE(__rom_bank84 = 0xc000);
PROVIDE(__rom_bank84_size = 0);
PROVIDE(__rom_bank85 = 0xc000);
PROVIDE(__rom_bank85_size = 0);
PROVIDE(__rom_bank86 = 0xc000);
PROVIDE(__rom_bank86_size = 0);
PROVIDE(__rom_bank87 = 0xc000);
PROVIDE(__rom_bank87_size = 0);
PROVIDE(__rom_bank88 = 0xc000);
PROVIDE(__rom_bank88_size = 0);
PROVIDE(__rom_bank89 = 0xc000);
PROVIDE(__rom_bank89_size = 0);
PROVIDE(__rom_bank90 = 0xc000);
PROVIDE(__rom_bank90_size = 0);
PROVIDE(__rom_bank91 = 0xc000);
PROVIDE(__rom_bank91_size = 0);
PROVIDE(__rom_bank92 = 0xc000);
PROVIDE(__rom_bank92_size = 0);
PROVIDE(__rom_bank93 = 0xc000);
PROVIDE(__rom_bank93_size = 0);
PROVIDE(__rom_bank94 = 0xc000);
PROVIDE(__rom_bank94_size = 0);
PROVIDE(__rom_bank95 = 0xc000);
PROVIDE(__rom_bank95_size = 0);
PROVIDE(__rom_bank96 = 0xc000);
PROVIDE(__rom_bank96_size = 0);
PROVIDE(__rom_bank97 = 0xc000);
PROVIDE(__rom_bank97_size = 0);
PROVIDE(__rom_bank98 = 0xc000);
PROVIDE(__rom_bank98_size = 0);
PROVIDE(__rom_bank99 = 0xc000);
PROVIDE(__rom_bank99_size = 0);
PROVIDE(__rom_bank100 = 0xc000);
PROVIDE(__rom_bank100_size = 0);
PROVIDE(__rom_bank101 = 0xc000);
PROVIDE(__rom_bank101_size = 0);
PROVIDE(__rom_bank102 = 0xc000);
PROVIDE(__rom_bank102_size = 0);
PROVIDE(__rom_bank103 = 0xc000);
PROVIDE(__rom_bank103_size = 0);
PROVIDE(__rom_bank104 = 0xc000);
PROVIDE(__rom_bank104_size = 0);
PROVIDE(__rom_bank105 = 0xc000);
PROVIDE(__rom_bank105_size = 0);
PROVIDE(__rom_bank106 = 0xc000);
PROVIDE(__rom_bank106_size = 0);
PROVIDE(__rom_bank107 = 0xc000);
PROVIDE(__rom_bank107_size = 0);
PROVIDE(__rom_bank108 = 0xc000);
PROVIDE(__rom_bank108_size = 0);
PROVIDE(__rom_bank109 = 0xc000);
PROVIDE(__rom_bank109_size = 0);
PROVIDE(__rom_bank110 = 0xc000);
PROVIDE(__rom_bank110_size = 0);
PROVIDE(__rom_bank111 = 0xc000);
PROVIDE(__rom_bank111_size = 0);
PROVIDE(__rom_bank112 = 0xc000);
PROVIDE(__rom_bank112_size = 0);
PROVIDE(__rom_bank113 = 0xc000);
PROVIDE(__rom_bank113_size = 0);
PROVIDE(__rom_bank114 = 0xc000);
PROVIDE(__rom_bank114_size = 0);
PROVIDE(__rom_bank115 = 0xc000);
PROVIDE(__rom_bank115_size = 0);
PROVIDE(__rom_bank116 = 0xc000);
PROVIDE(__rom_bank116_size = 0);
PROVIDE(__rom_bank117 = 0xc000);
PROVIDE(__rom_bank117_size = 0);
PROVIDE(__rom_bank118 = 0xc000);
PROVIDE(__rom_bank118_size = 0);
PROVIDE(__rom_bank119 = 0xc000);
PROVIDE(__rom_bank119_size = 0);
PROVIDE(__rom_bank120 = 0xc000);
PROVIDE(__rom_bank120_size = 0);
PROVIDE(__rom_bank121 = 0xc000);
PROVIDE(__rom_bank121_size = 0);
PROVIDE(__rom_bank122 = 0xc000);
PROVIDE(__rom_bank122_size = 0);
PROVIDE(__rom_bank123 = 0xc000);
PROVIDE(__rom_bank123_size = 0);
PROVIDE(__rom_bank124 = 0xc000);
PROVIDE(__rom_bank124_size = 0);
PROVIDE(__rom_bank125 = 0xc000);
PROVIDE(__rom_bank125_size = 0);
PROVIDE(__rom_bank126 = 0xc000);
PROVIDE(__rom_bank126_size = 0);
PROVIDE(__rom_bank127 = 0xc000);
PROVIDE(__rom_bank127_size = 0);

__rom_size = MAX((__rom_bank127_size > 0 ? 1048576 : (__rom_bank126_size > 0 ? 1040384 : (__rom_bank125_size > 0 ? 1032192 : (__rom_bank124_size > 0 ? 1024000 : (__rom_bank123_size > 0 ? 1015808 : (__rom_bank122_size > 0 ? 1007616 : (__rom_bank121_size > 0 ? 999424 : (__rom_bank120_size > 0 ? 991232 : (__rom_bank119_size > 0 ? 983040 : (__rom_bank118_size > 0 ? 974848 : (__rom_bank117_size > 0 ? 966656 : (__rom_bank116_size > 0 ? 958464 : (__rom_bank115_size > 0 ? 950272 : (__rom_bank114_size > 0 ? 942080 : (__rom_bank113_size > 0 ? 933888 : (__rom_bank112_size > 0 ? 925696 : (__rom_bank111_size > 0 ? 917504 : (__rom_bank110_size > 0 ? 909312 : (__rom_bank109_size > 0 ? 901120 : (__rom_bank108_size > 0 ? 892928 : (__rom_bank107_size > 0 ? 884736 : (__rom_bank106_size > 0 ? 876544 : (__rom_bank105_size > 0 ? 868352 : (__rom_bank104_size > 0 ? 860160 : (__rom_bank103_size > 0 ? 851968 : (__rom_bank102_size > 0 ? 843776 : (__rom_bank101_size > 0 ? 835584 : (__rom_bank100_size > 0 ? 827392 : (__rom_bank99_size > 0 ? 819200 : (__rom_bank98_size > 0 ? 811008 : (__rom_bank97_size > 0 ? 802816 : (__rom_bank96_size > 0 ? 794624 : (__rom_bank95_size > 0 ? 786432 : (__rom_bank94_size > 0 ? 778240 : (__rom_bank93_size > 0 ? 770048 : (__rom_bank92_size > 0 ? 761856 : (__rom_bank91_size > 0 ? 753664 : (__rom_bank90_size > 0 ? 745472 : (__rom_bank89_size > 0 ? 737280 : (__rom_bank88_size > 0 ? 729088 : (__rom_bank87_size > 0 ? 720896 : (__rom_bank86_size > 0 ? 712704 : (__rom_bank85_size > 0 ? 704512 : (__rom_bank84_size > 0 ? 696320 : (__rom_bank83_size > 0 ? 688128 : (__rom_bank82_size > 0 ? 679936 : (__rom_bank81_size > 0 ? 671744 : (__rom_bank80_size > 0 ? 663552 : (__rom_bank79_size > 0 ? 655360 : (__rom_bank78_size > 0 ? 647168 : (__rom_bank77_size > 0 ? 638976 : (__rom_bank76_size > 0 ? 630784 : (__rom_bank75_size > 0 ? 622592 : (__rom_bank74_size > 0 ? 614400 : (__rom_bank73_size > 0 ? 606208 : (__rom_bank72_size > 0 ? 598016 : (__rom_bank71_size > 0 ? 589824 : (__rom_bank70_size > 0 ? 581632 : (__rom_bank69_size > 0 ? 573440 : (__rom_bank68_size > 0 ? 565248 : (__rom_bank67_size > 0 ? 557056 : (__rom_bank66_size > 0 ? 548864 : (__rom_bank65_size > 0 ? 540672 : (__rom_bank64_size > 0 ? 532480 : (__rom_bank63_size > 0 ? 524288 : (__rom_bank62_size > 0 ? 516096 : (__rom_bank61_size > 0 ? 507904 : (__rom_bank60_size > 0 ? 499712 : (__rom_bank59_size > 0 ? 491520 : (__rom_bank58_size > 0 ? 483328 : (__rom_bank57_size > 0 ? 475136 : (__rom_bank56_size > 0 ? 466944 : (__rom_bank55_size > 0 ? 458752 : (__rom_bank54_size > 0 ? 450560 : (__rom_bank53_size > 0 ? 442368 : (__rom_bank52_size > 0 ? 434176 : (__rom_bank51_size > 0 ? 425984 : (__rom_bank50_size > 0 ? 417792 : (__rom_bank49_size > 0 ? 409600 : (__rom_bank48_size > 0 ? 401408 : (__rom_bank47_size > 0 ? 393216 : (__rom_bank46_size > 0 ? 385024 : (__rom_bank45_size > 0 ? 376832 : (__rom_bank44_size > 0 ? 368640 : (__rom_bank43_size > 0 ? 360448 : (__rom_bank42_size > 0 ? 352256 : (__rom_bank41_size > 0 ? 344064 : (__rom_bank40_size > 0 ? 335872 : (__rom_bank39_size > 0 ? 327680 : (__rom_bank38_size > 0 ? 319488 : (__rom_bank37_size > 0 ? 311296 : (__rom_bank36_size > 0 ? 303104 : (__rom_bank35_size > 0 ? 294912 : (__rom_bank34_size > 0 ? 286720 : (__rom_bank33_size > 0 ? 278528 : (__rom_bank32_size > 0 ? 270336 : (__rom_bank31_size > 0 ? 262144 : (__rom_bank30_size > 0 ? 253952 : (__rom_bank29_size > 0 ? 245760 : (__rom_bank28_size > 0 ? 237568 : (__rom_bank27_size > 0 ? 229376 : (__rom_bank26_size > 0 ? 221184 : (__rom_bank25_size > 0 ? 212992 : (__rom_bank24_size > 0 ? 204800 : (__rom_bank23_size > 0 ? 196608 : (__rom_bank22_size > 0 ? 188416 : (__rom_bank21_size > 0 ? 180224 : (__rom_bank20_size > 0 ? 172032 : (__rom_bank19_size > 0 ? 163840 : (__rom_bank18_size > 0 ? 155648 : (__rom_bank17_size > 0 ? 147456 : (__rom_bank16_size > 0 ? 139264 : (__rom_bank15_size > 0 ? 131072 : (__rom_bank14_size > 0 ? 122880 : (__rom_bank13_size > 0 ? 114688 : (__rom_bank12_size > 0 ? 106496 : (__rom_bank11_size > 0 ? 98304 : (__rom_bank10_size > 0 ? 90112 : (__rom_bank9_size > 0 ? 81920 : (__rom_bank8_size > 0 ? 73728 : (__rom_bank7_size > 0 ? 65536 : (__rom_bank6_size > 0 ? 57344 : (__rom_bank5_size > 0 ? 49152 : (__rom_bank4_size > 0 ? 40960 : (__rom_bank3_size > 0 ? 32768 : (__rom_bank2_size > 0 ? 24576 : (__rom_bank1_size > 0 ? 16384 : 0))))))))))))))))))))))))))))))))))))))))))))))))))))))))))))))))))))))))))))))))))))))))))))))))))))))))))))))))))))))))))))))), __rom_bank0_size);

__rom_vbank0a = 0xe000;
__rom_vbank0a_size = 0x2000;
__rom_vbank0a_offset = 0;
__rom_vbank0a_bank = 0;
__rom_vbank0a_lma = __rom_vbank0a;
__rom_vbank0b = 0x10000 - __rom_bank0_size;
__rom_vbank0b_size = __rom_bank0_size - 0x2000;
__rom_vbank0b_offset = 0x2000;
__rom_vbank0b_bank = __rom_bank0_size > 0x2000 ? 1 : -1;
__rom_vbank0b_lma = __rom_vbank0b;

__rom_bank0_bank = 0;
__rom_bank1_bank = 1;
__rom_bank2_bank = 2;
__rom_bank3_bank = 3;
__rom_bank4_bank = 4;
__rom_bank5_bank = 5;
__rom_bank6_bank = 6;
__rom_bank7_bank = 7;
__rom_bank8_bank = 8;
__rom_bank9_bank = 9;
__rom_bank10_bank = 10;
__rom_bank11_bank = 11;
__rom_bank12_bank = 12;
__rom_bank13_bank = 13;
__rom_bank14_bank = 14;
__rom_bank15_bank = 15;
__rom_bank16_bank = 16;
__rom_bank17_bank = 17;
__rom_bank18_bank = 18;
__rom_bank19_bank = 19;
__rom_bank20_bank = 20;
__rom_bank21_bank = 21;
__rom_bank22_bank = 22;
__rom_bank23_bank = 23;
__rom_bank24_bank = 24;
__rom_bank25_bank = 25;
__rom_bank26_bank = 26;
__rom_bank27_bank = 27;
__rom_bank28_bank = 28;
__rom_bank29_bank = 29;
__rom_bank30_bank = 30;
__rom_bank31_bank = 31;
__rom_bank32_bank = 32;
__rom_bank33_bank = 33;
__rom_bank34_bank = 34;
__rom_bank35_bank = 35;
__rom_bank36_bank = 36;
__rom_bank37_bank = 37;
__rom_bank38_bank = 38;
__rom_bank39_bank = 39;
__rom_bank40_bank = 40;
__rom_bank41_bank = 41;
__rom_bank42_bank = 42;
__rom_bank43_bank = 43;
__rom_bank44_bank = 44;
__rom_bank45_bank = 45;
__rom_bank46_bank = 46;
__rom_bank47_bank = 47;
__rom_bank48_bank = 48;
__rom_bank49_bank = 49;
__rom_bank50_bank = 50;
__rom_bank51_bank = 51;
__rom_bank52_bank = 52;
__rom_bank53_bank = 53;
__rom_bank54_bank = 54;
__rom_bank55_bank = 55;
__rom_bank56_bank = 56;
__rom_bank57_bank = 57;
__rom_bank58_bank = 58;
__rom_bank59_bank = 59;
__rom_bank60_bank = 60;
__rom_bank61_bank = 61;
__rom_bank62_bank = 62;
__rom_bank63_bank = 63;
__rom_bank64_bank = 64;
__rom_bank65_bank = 65;
__rom_bank66_bank = 66;
__rom_bank67_bank = 67;
__rom_bank68_bank = 68;
__rom_bank69_bank = 69;
__rom_bank70_bank = 70;
__rom_bank71_bank = 71;
__rom_bank72_bank = 72;
__rom_bank73_bank = 73;
__rom_bank74_bank = 74;
__rom_bank75_bank = 75;
__rom_bank76_bank = 76;
__rom_bank77_bank = 77;
__rom_bank78_bank = 78;
__rom_bank79_bank = 79;
__rom_bank80_bank = 80;
__rom_bank81_bank = 81;
__rom_bank82_bank = 82;
__rom_bank83_bank = 83;
__rom_bank84_bank = 84;
__rom_bank85_bank = 85;
__rom_bank86_bank = 86;
__rom_bank87_bank = 87;
__rom_bank88_bank = 88;
__rom_bank89_bank = 89;
__rom_bank90_bank = 90;
__rom_bank91_bank = 91;
__rom_bank92_bank = 92;
__rom_bank93_bank = 93;
__rom_bank94_bank = 94;
__rom_bank95_bank = 95;
__rom_bank96_bank = 96;
__rom_bank97_bank = 97;
__rom_bank98_bank = 98;
__rom_bank99_bank = 99;
__rom_bank100_bank = 100;
__rom_bank101_bank = 101;
__rom_bank102_bank = 102;
__rom_bank103_bank = 103;
__rom_bank104_bank = 104;
__rom_bank105_bank = 105;
__rom_bank106_bank = 106;
__rom_bank107_bank = 107;
__rom_bank108_bank = 108;
__rom_bank109_bank = 109;
__rom_bank110_bank = 110;
__rom_bank111_bank = 111;
__rom_bank112_bank = 112;
__rom_bank113_bank = 113;
__rom_bank114_bank = 114;
__rom_bank115_bank = 115;
__rom_bank116_bank = 116;
__rom_bank117_bank = 117;
__rom_bank118_bank = 118;
__rom_bank119_bank = 119;
__rom_bank120_bank = 120;
__rom_bank121_bank = 121;
__rom_bank122_bank = 122;
__rom_bank123_bank = 123;
__rom_bank124_bank = 124;
__rom_bank125_bank = 125;
__rom_bank126_bank = 126;
__rom_bank127_bank = 127;

MEMORY {
  rom_bank0 : ORIGIN = __rom_bank0, LENGTH = __rom_bank0_size
  rom_bank1 : ORIGIN = (65536 + __rom_bank1), LENGTH = (((__rom_size >= 16384) && (__rom_bank0_size < 16384)) ? 0x2000 : 0)
  rom_bank2 : ORIGIN = (131072 + __rom_bank2), LENGTH = (((__rom_size >= 24576) && (__rom_bank0_size < 24576)) ? 0x2000 : 0)
  rom_bank3 : ORIGIN = (196608 + __rom_bank3), LENGTH = (((__rom_size >= 32768) && (__rom_bank0_size < 32768)) ? 0x2000 : 0)
  rom_bank4 : ORIGIN = (262144 + __rom_bank4), LENGTH = (((__rom_size >= 40960) && (__rom_bank0_size < 40960)) ? 0x2000 : 0)
  rom_bank5 : ORIGIN = (327680 + __rom_bank5), LENGTH = (((__rom_size >= 49152) && (__rom_bank0_size < 49152)) ? 0x2000 : 0)
  rom_bank6 : ORIGIN = (393216 + __rom_bank6), LENGTH = (((__rom_size >= 57344) && (__rom_bank0_size < 57344)) ? 0x2000 : 0)
  rom_bank7 : ORIGIN = (458752 + __rom_bank7), LENGTH = (((__rom_size >= 65536) && (__rom_bank0_size < 65536)) ? 0x2000 : 0)
  rom_bank8 : ORIGIN = (524288 + __rom_bank8), LENGTH = (__rom_size >= 73728 ? 0x2000 : 0)
  rom_bank9 : ORIGIN = (589824 + __rom_bank9), LENGTH = (__rom_size >= 81920 ? 0x2000 : 0)
  rom_bank10 : ORIGIN = (655360 + __rom_bank10), LENGTH = (__rom_size >= 90112 ? 0x2000 : 0)
  rom_bank11 : ORIGIN = (720896 + __rom_bank11), LENGTH = (__rom_size >= 98304 ? 0x2000 : 0)
  rom_bank12 : ORIGIN = (786432 + __rom_bank12), LENGTH = (__rom_size >= 106496 ? 0x2000 : 0)
  rom_bank13 : ORIGIN = (851968 + __rom_bank13), LENGTH = (__rom_size >= 114688 ? 0x2000 : 0)
  rom_bank14 : ORIGIN = (917504 + __rom_bank14), LENGTH = (__rom_size >= 122880 ? 0x2000 : 0)
  rom_bank15 : ORIGIN = (983040 + __rom_bank15), LENGTH = (__rom_size >= 131072 ? 0x2000 : 0)
  rom_bank16 : ORIGIN = (1048576 + __rom_bank16), LENGTH = (__rom_size >= 139264 ? 0x2000 : 0)
  rom_bank17 : ORIGIN = (1114112 + __rom_bank17), LENGTH = (__rom_size >= 147456 ? 0x2000 : 0)
  rom_bank18 : ORIGIN = (1179648 + __rom_bank18), LENGTH = (__rom_size >= 155648 ? 0x2000 : 0)
  rom_bank19 : ORIGIN = (1245184 + __rom_bank19), LENGTH = (__rom_size >= 163840 ? 0x2000 : 0)
  rom_bank20 : ORIGIN = (1310720 + __rom_bank20), LENGTH = (__rom_size >= 172032 ? 0x2000 : 0)
  rom_bank21 : ORIGIN = (1376256 + __rom_bank21), LENGTH = (__rom_size >= 180224 ? 0x2000 : 0)
  rom_bank22 : ORIGIN = (1441792 + __rom_bank22), LENGTH = (__rom_size >= 188416 ? 0x2000 : 0)
  rom_bank23 : ORIGIN = (1507328 + __rom_bank23), LENGTH = (__rom_size >= 196608 ? 0x2000 : 0)
  rom_bank24 : ORIGIN = (1572864 + __rom_bank24), LENGTH = (__rom_size >= 204800 ? 0x2000 : 0)
  rom_bank25 : ORIGIN = (1638400 + __rom_bank25), LENGTH = (__rom_size >= 212992 ? 0x2000 : 0)
  rom_bank26 : ORIGIN = (1703936 + __rom_bank26), LENGTH = (__rom_size >= 221184 ? 0x2000 : 0)
  rom_bank27 : ORIGIN = (1769472 + __rom_bank27), LENGTH = (__rom_size >= 229376 ? 0x2000 : 0)
  rom_bank28 : ORIGIN = (1835008 + __rom_bank28), LENGTH = (__rom_size >= 237568 ? 0x2000 : 0)
  rom_bank29 : ORIGIN = (1900544 + __rom_bank29), LENGTH = (__rom_size >= 245760 ? 0x2000 : 0)
  rom_bank30 : ORIGIN = (1966080 + __rom_bank30), LENGTH = (__rom_size >= 253952 ? 0x2000 : 0)
  rom_bank31 : ORIGIN = (2031616 + __rom_bank31), LENGTH = (__rom_size >= 262144 ? 0x2000 : 0)
  rom_bank32 : ORIGIN = (2097152 + __rom_bank32), LENGTH = (__rom_size >= 270336 ? 0x2000 : 0)
  rom_bank33 : ORIGIN = (2162688 + __rom_bank33), LENGTH = (__rom_size >= 278528 ? 0x2000 : 0)
  rom_bank34 : ORIGIN = (2228224 + __rom_bank34), LENGTH = (__rom_size >= 286720 ? 0x2000 : 0)
  rom_bank35 : ORIGIN = (2293760 + __rom_bank35), LENGTH = (__rom_size >= 294912 ? 0x2000 : 0)
  rom_bank36 : ORIGIN = (2359296 + __rom_bank36), LENGTH = (__rom_size >= 303104 ? 0x2000 : 0)
  rom_bank37 : ORIGIN = (2424832 + __rom_bank37), LENGTH = (__rom_size >= 311296 ? 0x2000 : 0)
  rom_bank38 : ORIGIN = (2490368 + __rom_bank38), LENGTH = (__rom_size >= 319488 ? 0x2000 : 0)
  rom_bank39 : ORIGIN = (2555904 + __rom_bank39), LENGTH = (__rom_size >= 327680 ? 0x2000 : 0)
  rom_bank40 : ORIGIN = (2621440 + __rom_bank40), LENGTH = (__rom_size >= 335872 ? 0x2000 : 0)
  rom_bank41 : ORIGIN = (2686976 + __rom_bank41), LENGTH = (__rom_size >= 344064 ? 0x2000 : 0)
  rom_bank42 : ORIGIN = (2752512 + __rom_bank42), LENGTH = (__rom_size >= 352256 ? 0x2000 : 0)
  rom_bank43 : ORIGIN = (2818048 + __rom_bank43), LENGTH = (__rom_size >= 360448 ? 0x2000 : 0)
  rom_bank44 : ORIGIN = (2883584 + __rom_bank44), LENGTH = (__rom_size >= 368640 ? 0x2000 : 0)
  rom_bank45 : ORIGIN = (2949120 + __rom_bank45), LENGTH = (__rom_size >= 376832 ? 0x2000 : 0)
  rom_bank46 : ORIGIN = (3014656 + __rom_bank46), LENGTH = (__rom_size >= 385024 ? 0x2000 : 0)
  rom_bank47 : ORIGIN = (3080192 + __rom_bank47), LENGTH = (__rom_size >= 393216 ? 0x2000 : 0)
  rom_bank48 : ORIGIN = (3145728 + __rom_bank48), LENGTH = (__rom_size >= 401408 ? 0x2000 : 0)
  rom_bank49 : ORIGIN = (3211264 + __rom_bank49), LENGTH = (__rom_size >= 409600 ? 0x2000 : 0)
  rom_bank50 : ORIGIN = (3276800 + __rom_bank50), LENGTH = (__rom_size >= 417792 ? 0x2000 : 0)
  rom_bank51 : ORIGIN = (3342336 + __rom_bank51), LENGTH = (__rom_size >= 425984 ? 0x2000 : 0)
  rom_bank52 : ORIGIN = (3407872 + __rom_bank52), LENGTH = (__rom_size >= 434176 ? 0x2000 : 0)
  rom_bank53 : ORIGIN = (3473408 + __rom_bank53), LENGTH = (__rom_size >= 442368 ? 0x2000 : 0)
  rom_bank54 : ORIGIN = (3538944 + __rom_bank54), LENGTH = (__rom_size >= 450560 ? 0x2000 : 0)
  rom_bank55 : ORIGIN = (3604480 + __rom_bank55), LENGTH = (__rom_size >= 458752 ? 0x2000 : 0)
  rom_bank56 : ORIGIN = (3670016 + __rom_bank56), LENGTH = (__rom_size >= 466944 ? 0x2000 : 0)
  rom_bank57 : ORIGIN = (3735552 + __rom_bank57), LENGTH = (__rom_size >= 475136 ? 0x2000 : 0)
  rom_bank58 : ORIGIN = (3801088 + __rom_bank58), LENGTH = (__rom_size >= 483328 ? 0x2000 : 0)
  rom_bank59 : ORIGIN = (3866624 + __rom_bank59), LENGTH = (__rom_size >= 491520 ? 0x2000 : 0)
  rom_bank60 : ORIGIN = (3932160 + __rom_bank60), LENGTH = (__rom_size >= 499712 ? 0x2000 : 0)
  rom_bank61 : ORIGIN = (3997696 + __rom_bank61), LENGTH = (__rom_size >= 507904 ? 0x2000 : 0)
  rom_bank62 : ORIGIN = (4063232 + __rom_bank62), LENGTH = (__rom_size >= 516096 ? 0x2000 : 0)
  rom_bank63 : ORIGIN = (4128768 + __rom_bank63), LENGTH = (__rom_size >= 524288 ? 0x2000 : 0)
  rom_bank64 : ORIGIN = (4194304 + __rom_bank64), LENGTH = (__rom_size >= 532480 ? 0x2000 : 0)
  rom_bank65 : ORIGIN = (4259840 + __rom_bank65), LENGTH = (__rom_size >= 540672 ? 0x2000 : 0)
  rom_bank66 : ORIGIN = (4325376 + __rom_bank66), LENGTH = (__rom_size >= 548864 ? 0x2000 : 0)
  rom_bank67 : ORIGIN = (4390912 + __rom_bank67), LENGTH = (__rom_size >= 557056 ? 0x2000 : 0)
  rom_bank68 : ORIGIN = (4456448 + __rom_bank68), LENGTH = (__rom_size >= 565248 ? 0x2000 : 0)
  rom_bank69 : ORIGIN = (4521984 + __rom_bank69), LENGTH = (__rom_size >= 573440 ? 0x2000 : 0)
  rom_bank70 : ORIGIN = (4587520 + __rom_bank70), LENGTH = (__rom_size >= 581632 ? 0x2000 : 0)
  rom_bank71 : ORIGIN = (4653056 + __rom_bank71), LENGTH = (__rom_size >= 589824 ? 0x2000 : 0)
  rom_bank72 : ORIGIN = (4718592 + __rom_bank72), LENGTH = (__rom_size >= 598016 ? 0x2000 : 0)
  rom_bank73 : ORIGIN = (4784128 + __rom_bank73), LENGTH = (__rom_size >= 606208 ? 0x2000 : 0)
  rom_bank74 : ORIGIN = (4849664 + __rom_bank74), LENGTH = (__rom_size >= 614400 ? 0x2000 : 0)
  rom_bank75 : ORIGIN = (4915200 + __rom_bank75), LENGTH = (__rom_size >= 622592 ? 0x2000 : 0)
  rom_bank76 : ORIGIN = (4980736 + __rom_bank76), LENGTH = (__rom_size >= 630784 ? 0x2000 : 0)
  rom_bank77 : ORIGIN = (5046272 + __rom_bank77), LENGTH = (__rom_size >= 638976 ? 0x2000 : 0)
  rom_bank78 : ORIGIN = (5111808 + __rom_bank78), LENGTH = (__rom_size >= 647168 ? 0x2000 : 0)
  rom_bank79 : ORIGIN = (5177344 + __rom_bank79), LENGTH = (__rom_size >= 655360 ? 0x2000 : 0)
  rom_bank80 : ORIGIN = (5242880 + __rom_bank80), LENGTH = (__rom_size >= 663552 ? 0x2000 : 0)
  rom_bank81 : ORIGIN = (5308416 + __rom_bank81), LENGTH = (__rom_size >= 671744 ? 0x2000 : 0)
  rom_bank82 : ORIGIN = (5373952 + __rom_bank82), LENGTH = (__rom_size >= 679936 ? 0x2000 : 0)
  rom_bank83 : ORIGIN = (5439488 + __rom_bank83), LENGTH = (__rom_size >= 688128 ? 0x2000 : 0)
  rom_bank84 : ORIGIN = (5505024 + __rom_bank84), LENGTH = (__rom_size >= 696320 ? 0x2000 : 0)
  rom_bank85 : ORIGIN = (5570560 + __rom_bank85), LENGTH = (__rom_size >= 704512 ? 0x2000 : 0)
  rom_bank86 : ORIGIN = (5636096 + __rom_bank86), LENGTH = (__rom_size >= 712704 ? 0x2000 : 0)
  rom_bank87 : ORIGIN = (5701632 + __rom_bank87), LENGTH = (__rom_size >= 720896 ? 0x2000 : 0)
  rom_bank88 : ORIGIN = (5767168 + __rom_bank88), LENGTH = (__rom_size >= 729088 ? 0x2000 : 0)
  rom_bank89 : ORIGIN = (5832704 + __rom_bank89), LENGTH = (__rom_size >= 737280 ? 0x2000 : 0)
  rom_bank90 : ORIGIN = (5898240 + __rom_bank90), LENGTH = (__rom_size >= 745472 ? 0x2000 : 0)
  rom_bank91 : ORIGIN = (5963776 + __rom_bank91), LENGTH = (__rom_size >= 753664 ? 0x2000 : 0)
  rom_bank92 : ORIGIN = (6029312 + __rom_bank92), LENGTH = (__rom_size >= 761856 ? 0x2000 : 0)
  rom_bank93 : ORIGIN = (6094848 + __rom_bank93), LENGTH = (__rom_size >= 770048 ? 0x2000 : 0)
  rom_bank94 : ORIGIN = (6160384 + __rom_bank94), LENGTH = (__rom_size >= 778240 ? 0x2000 : 0)
  rom_bank95 : ORIGIN = (6225920 + __rom_bank95), LENGTH = (__rom_size >= 786432 ? 0x2000 : 0)
  rom_bank96 : ORIGIN = (6291456 + __rom_bank96), LENGTH = (__rom_size >= 794624 ? 0x2000 : 0)
  rom_bank97 : ORIGIN = (6356992 + __rom_bank97), LENGTH = (__rom_size >= 802816 ? 0x2000 : 0)
  rom_bank98 : ORIGIN = (6422528 + __rom_bank98), LENGTH = (__rom_size >= 811008 ? 0x2000 : 0)
  rom_bank99 : ORIGIN = (6488064 + __rom_bank99), LENGTH = (__rom_size >= 819200 ? 0x2000 : 0)
  rom_bank100 : ORIGIN = (6553600 + __rom_bank100), LENGTH = (__rom_size >= 827392 ? 0x2000 : 0)
  rom_bank101 : ORIGIN = (6619136 + __rom_bank101), LENGTH = (__rom_size >= 835584 ? 0x2000 : 0)
  rom_bank102 : ORIGIN = (6684672 + __rom_bank102), LENGTH = (__rom_size >= 843776 ? 0x2000 : 0)
  rom_bank103 : ORIGIN = (6750208 + __rom_bank103), LENGTH = (__rom_size >= 851968 ? 0x2000 : 0)
  rom_bank104 : ORIGIN = (6815744 + __rom_bank104), LENGTH = (__rom_size >= 860160 ? 0x2000 : 0)
  rom_bank105 : ORIGIN = (6881280 + __rom_bank105), LENGTH = (__rom_size >= 868352 ? 0x2000 : 0)
  rom_bank106 : ORIGIN = (6946816 + __rom_bank106), LENGTH = (__rom_size >= 876544 ? 0x2000 : 0)
  rom_bank107 : ORIGIN = (7012352 + __rom_bank107), LENGTH = (__rom_size >= 884736 ? 0x2000 : 0)
  rom_bank108 : ORIGIN = (7077888 + __rom_bank108), LENGTH = (__rom_size >= 892928 ? 0x2000 : 0)
  rom_bank109 : ORIGIN = (7143424 + __rom_bank109), LENGTH = (__rom_size >= 901120 ? 0x2000 : 0)
  rom_bank110 : ORIGIN = (7208960 + __rom_bank110), LENGTH = (__rom_size >= 909312 ? 0x2000 : 0)
  rom_bank111 : ORIGIN = (7274496 + __rom_bank111), LENGTH = (__rom_size >= 917504 ? 0x2000 : 0)
  rom_bank112 : ORIGIN = (7340032 + __rom_bank112), LENGTH = (__rom_size >= 925696 ? 0x2000 : 0)
  rom_bank113 : ORIGIN = (7405568 + __rom_bank113), LENGTH = (__rom_size >= 933888 ? 0x2000 : 0)
  rom_bank114 : ORIGIN = (7471104 + __rom_bank114), LENGTH = (__rom_size >= 942080 ? 0x2000 : 0)
  rom_bank115 : ORIGIN = (7536640 + __rom_bank115), LENGTH = (__rom_size >= 950272 ? 0x2000 : 0)
  rom_bank116 : ORIGIN = (7602176 + __rom_bank116), LENGTH = (__rom_size >= 958464 ? 0x2000 : 0)
  rom_bank117 : ORIGIN = (7667712 + __rom_bank117), LENGTH = (__rom_size >= 966656 ? 0x2000 : 0)
  rom_bank118 : ORIGIN = (7733248 + __rom_bank118), LENGTH = (__rom_size >= 974848 ? 0x2000 : 0)
  rom_bank119 : ORIGIN = (7798784 + __rom_bank119), LENGTH = (__rom_size >= 983040 ? 0x2000 : 0)
  rom_bank120 : ORIGIN = (7864320 + __rom_bank120), LENGTH = (__rom_size >= 991232 ? 0x2000 : 0)
  rom_bank121 : ORIGIN = (7929856 + __rom_bank121), LENGTH = (__rom_size >= 999424 ? 0x2000 : 0)
  rom_bank122 : ORIGIN = (7995392 + __rom_bank122), LENGTH = (__rom_size >= 1007616 ? 0x2000 : 0)
  rom_bank123 : ORIGIN = (8060928 + __rom_bank123), LENGTH = (__rom_size >= 1015808 ? 0x2000 : 0)
  rom_bank124 : ORIGIN = (8126464 + __rom_bank124), LENGTH = (__rom_size >= 1024000 ? 0x2000 : 0)
  rom_bank125 : ORIGIN = (8192000 + __rom_bank125), LENGTH = (__rom_size >= 1032192 ? 0x2000 : 0)
  rom_bank126 : ORIGIN = (8257536 + __rom_bank126), LENGTH = (__rom_size >= 1040384 ? 0x2000 : 0)
  rom_bank127 : ORIGIN = (8323072 + __rom_bank127), LENGTH = (__rom_size >= 1048576 ? 0x2000 : 0)
}

SECTIONS {
  .rom_bank0 : { *(.rom_bank0 .rom_bank0.*) } >rom_bank0
  .rom_bank1 : { *(.rom_bank1 .rom_bank1.*) } >rom_bank1
  .rom_bank2 : { *(.rom_bank2 .rom_bank2.*) } >rom_bank2
  .rom_bank3 : { *(.rom_bank3 .rom_bank3.*) } >rom_bank3
  .rom_bank4 : { *(.rom_bank4 .rom_bank4.*) } >rom_bank4
  .rom_bank5 : { *(.rom_bank5 .rom_bank5.*) } >rom_bank5
  .rom_bank6 : { *(.rom_bank6 .rom_bank6.*) } >rom_bank6
  .rom_bank7 : { *(.rom_bank7 .rom_bank7.*) } >rom_bank7
  .rom_bank8 : { *(.rom_bank8 .rom_bank8.*) } >rom_bank8
  .rom_bank9 : { *(.rom_bank9 .rom_bank9.*) } >rom_bank9
  .rom_bank10 : { *(.rom_bank10 .rom_bank10.*) } >rom_bank10
  .rom_bank11 : { *(.rom_bank11 .rom_bank11.*) } >rom_bank11
  .rom_bank12 : { *(.rom_bank12 .rom_bank12.*) } >rom_bank12
  .rom_bank13 : { *(.rom_bank13 .rom_bank13.*) } >rom_bank13
  .rom_bank14 : { *(.rom_bank14 .rom_bank14.*) } >rom_bank14
  .rom_bank15 : { *(.rom_bank15 .rom_bank15.*) } >rom_bank15
  .rom_bank16 : { *(.rom_bank16 .rom_bank16.*) } >rom_bank16
  .rom_bank17 : { *(.rom_bank17 .rom_bank17.*) } >rom_bank17
  .rom_bank18 : { *(.rom_bank18 .rom_bank18.*) } >rom_bank18
  .rom_bank19 : { *(.rom_bank19 .rom_bank19.*) } >rom_bank19
  .rom_bank20 : { *(.rom_bank20 .rom_bank20.*) } >rom_bank20
  .rom_bank21 : { *(.rom_bank21 .rom_bank21.*) } >rom_bank21
  .rom_bank22 : { *(.rom_bank22 .rom_bank22.*) } >rom_bank22
  .rom_bank23 : { *(.rom_bank23 .rom_bank23.*) } >rom_bank23
  .rom_bank24 : { *(.rom_bank24 .rom_bank24.*) } >rom_bank24
  .rom_bank25 : { *(.rom_bank25 .rom_bank25.*) } >rom_bank25
  .rom_bank26 : { *(.rom_bank26 .rom_bank26.*) } >rom_bank26
  .rom_bank27 : { *(.rom_bank27 .rom_bank27.*) } >rom_bank27
  .rom_bank28 : { *(.rom_bank28 .rom_bank28.*) } >rom_bank28
  .rom_bank29 : { *(.rom_bank29 .rom_bank29.*) } >rom_bank29
  .rom_bank30 : { *(.rom_bank30 .rom_bank30.*) } >rom_bank30
  .rom_bank31 : { *(.rom_bank31 .rom_bank31.*) } >rom_bank31
  .rom_bank32 : { *(.rom_bank32 .rom_bank32.*) } >rom_bank32
  .rom_bank33 : { *(.rom_bank33 .rom_bank33.*) } >rom_bank33
  .rom_bank34 : { *(.rom_bank34 .rom_bank34.*) } >rom_bank34
  .rom_bank35 : { *(.rom_bank35 .rom_bank35.*) } >rom_bank35
  .rom_bank36 : { *(.rom_bank36 .rom_bank36.*) } >rom_bank36
  .rom_bank37 : { *(.rom_bank37 .rom_bank37.*) } >rom_bank37
  .rom_bank38 : { *(.rom_bank38 .rom_bank38.*) } >rom_bank38
  .rom_bank39 : { *(.rom_bank39 .rom_bank39.*) } >rom_bank39
  .rom_bank40 : { *(.rom_bank40 .rom_bank40.*) } >rom_bank40
  .rom_bank41 : { *(.rom_bank41 .rom_bank41.*) } >rom_bank41
  .rom_bank42 : { *(.rom_bank42 .rom_bank42.*) } >rom_bank42
  .rom_bank43 : { *(.rom_bank43 .rom_bank43.*) } >rom_bank43
  .rom_bank44 : { *(.rom_bank44 .rom_bank44.*) } >rom_bank44
  .rom_bank45 : { *(.rom_bank45 .rom_bank45.*) } >rom_bank45
  .rom_bank46 : { *(.rom_bank46 .rom_bank46.*) } >rom_bank46
  .rom_bank47 : { *(.rom_bank47 .rom_bank47.*) } >rom_bank47
  .rom_bank48 : { *(.rom_bank48 .rom_bank48.*) } >rom_bank48
  .rom_bank49 : { *(.rom_bank49 .rom_bank49.*) } >rom_bank49
  .rom_bank50 : { *(.rom_bank50 .rom_bank50.*) } >rom_bank50
  .rom_bank51 : { *(.rom_bank51 .rom_bank51.*) } >rom_bank51
  .rom_bank52 : { *(.rom_bank52 .rom_bank52.*) } >rom_bank52
  .rom_bank53 : { *(.rom_bank53 .rom_bank53.*) } >rom_bank53
  .rom_bank54 : { *(.rom_bank54 .rom_bank54.*) } >rom_bank54
  .rom_bank55 : { *(.rom_bank55 .rom_bank55.*) } >rom_bank55
  .rom_bank56 : { *(.rom_bank56 .rom_bank56.*) } >rom_bank56
  .rom_bank57 : { *(.rom_bank57 .rom_bank57.*) } >rom_bank57
  .rom_bank58 : { *(.rom_bank58 .rom_bank58.*) } >rom_bank58
  .rom_bank59 : { *(.rom_bank59 .rom_bank59.*) } >rom_bank59
  .rom_bank60 : { *(.rom_bank60 .rom_bank60.*) } >rom_bank60
  .rom_bank61 : { *(.rom_bank61 .rom_bank61.*) } >rom_bank61
  .rom_bank62 : { *(.rom_bank62 .rom_bank62.*) } >rom_bank62
  .rom_bank63 : { *(.rom_bank63 .rom_bank63.*) } >rom_bank63
  .rom_bank64 : { *(.rom_bank64 .rom_bank64.*) } >rom_bank64
  .rom_bank65 : { *(.rom_bank65 .rom_bank65.*) } >rom_bank65
  .rom_bank66 : { *(.rom_bank66 .rom_bank66.*) } >rom_bank66
  .rom_bank67 : { *(.rom_bank67 .rom_bank67.*) } >rom_bank67
  .rom_bank68 : { *(.rom_bank68 .rom_bank68.*) } >rom_bank68
  .rom_bank69 : { *(.rom_bank69 .rom_bank69.*) } >rom_bank69
  .rom_bank70 : { *(.rom_bank70 .rom_bank70.*) } >rom_bank70
  .rom_bank71 : { *(.rom_bank71 .rom_bank71.*) } >rom_bank71
  .rom_bank72 : { *(.rom_bank72 .rom_bank72.*) } >rom_bank72
  .rom_bank73 : { *(.rom_bank73 .rom_bank73.*) } >rom_bank73
  .rom_bank74 : { *(.rom_bank74 .rom_bank74.*) } >rom_bank74
  .rom_bank75 : { *(.rom_bank75 .rom_bank75.*) } >rom_bank75
  .rom_bank76 : { *(.rom_bank76 .rom_bank76.*) } >rom_bank76
  .rom_bank77 : { *(.rom_bank77 .rom_bank77.*) } >rom_bank77
  .rom_bank78 : { *(.rom_bank78 .rom_bank78.*) } >rom_bank78
  .rom_bank79 : { *(.rom_bank79 .rom_bank79.*) } >rom_bank79
  .rom_bank80 : { *(.rom_bank80 .rom_bank80.*) } >rom_bank80
  .rom_bank81 : { *(.rom_bank81 .rom_bank81.*) } >rom_bank81
  .rom_bank82 : { *(.rom_bank82 .rom_bank82.*) } >rom_bank82
  .rom_bank83 : { *(.rom_bank83 .rom_bank83.*) } >rom_bank83
  .rom_bank84 : { *(.rom_bank84 .rom_bank84.*) } >rom_bank84
  .rom_bank85 : { *(.rom_bank85 .rom_bank85.*) } >rom_bank85
  .rom_bank86 : { *(.rom_bank86 .rom_bank86.*) } >rom_bank86
  .rom_bank87 : { *(.rom_bank87 .rom_bank87.*) } >rom_bank87
  .rom_bank88 : { *(.rom_bank88 .rom_bank88.*) } >rom_bank88
  .rom_bank89 : { *(.rom_bank89 .rom_bank89.*) } >rom_bank89
  .rom_bank90 : { *(.rom_bank90 .rom_bank90.*) } >rom_bank90
  .rom_bank91 : { *(.rom_bank91 .rom_bank91.*) } >rom_bank91
  .rom_bank92 : { *(.rom_bank92 .rom_bank92.*) } >rom_bank92
  .rom_bank93 : { *(.rom_bank93 .rom_bank93.*) } >rom_bank93
  .rom_bank94 : { *(.rom_bank94 .rom_bank94.*) } >rom_bank94
  .rom_bank95 : { *(.rom_bank95 .rom_bank95.*) } >rom_bank95
  .rom_bank96 : { *(.rom_bank96 .rom_bank96.*) } >rom_bank96
  .rom_bank97 : { *(.rom_bank97 .rom_bank97.*) } >rom_bank97
  .rom_bank98 : { *(.rom_bank98 .rom_bank98.*) } >rom_bank98
  .rom_bank99 : { *(.rom_bank99 .rom_bank99.*) } >rom_bank99
  .rom_bank100 : { *(.rom_bank100 .rom_bank100.*) } >rom_bank100
  .rom_bank101 : { *(.rom_bank101 .rom_bank101.*) } >rom_bank101
  .rom_bank102 : { *(.rom_bank102 .rom_bank102.*) } >rom_bank102
  .rom_bank103 : { *(.rom_bank103 .rom_bank103.*) } >rom_bank103
  .rom_bank104 : { *(.rom_bank104 .rom_bank104.*) } >rom_bank104
  .rom_bank105 : { *(.rom_bank105 .rom_bank105.*) } >rom_bank105
  .rom_bank106 : { *(.rom_bank106 .rom_bank106.*) } >rom_bank106
  .rom_bank107 : { *(.rom_bank107 .rom_bank107.*) } >rom_bank107
  .rom_bank108 : { *(.rom_bank108 .rom_bank108.*) } >rom_bank108
  .rom_bank109 : { *(.rom_bank109 .rom_bank109.*) } >rom_bank109
  .rom_bank110 : { *(.rom_bank110 .rom_bank110.*) } >rom_bank110
  .rom_bank111 : { *(.rom_bank111 .rom_bank111.*) } >rom_bank111
  .rom_bank112 : { *(.rom_bank112 .rom_bank112.*) } >rom_bank112
  .rom_bank113 : { *(.rom_bank113 .rom_bank113.*) } >rom_bank113
  .rom_bank114 : { *(.rom_bank114 .rom_bank114.*) } >rom_bank114
  .rom_bank115 : { *(.rom_bank115 .rom_bank115.*) } >rom_bank115
  .rom_bank116 : { *(.rom_bank116 .rom_bank116.*) } >rom_bank116
  .rom_bank117 : { *(.rom_bank117 .rom_bank117.*) } >rom_bank117
  .rom_bank118 : { *(.rom_bank118 .rom_bank118.*) } >rom_bank118
  .rom_bank119 : { *(.rom_bank119 .rom_bank119.*) } >rom_bank119
  .rom_bank120 : { *(.rom_bank120 .rom_bank120.*) } >rom_bank120
  .rom_bank121 : { *(.rom_bank121 .rom_bank121.*) } >rom_bank121
  .rom_bank122 : { *(.rom_bank122 .rom_bank122.*) } >rom_bank122
  .rom_bank123 : { *(.rom_bank123 .rom_bank123.*) } >rom_bank123
  .rom_bank124 : { *(.rom_bank124 .rom_bank124.*) } >rom_bank124
  .rom_bank125 : { *(.rom_bank125 .rom_bank125.*) } >rom_bank125
  .rom_bank126 : { *(.rom_bank126 .rom_bank126.*) } >rom_bank126
  .rom_bank127 : { *(.rom_bank127 .rom_bank127.*) } >rom_bank127
}

OUTPUT_FORMAT {
  FULL(rom_bank0, __rom_bank0_size - 0x2000, 0x2000)
  FULL(rom_bank0, 0, __rom_bank0_size - 0x2000)
  FULL(rom_bank1)
  FULL(rom_bank2)
  FULL(rom_bank3)
  FULL(rom_bank4)
  FULL(rom_bank5)
  FULL(rom_bank6)
  FULL(rom_bank7)
  FULL(rom_bank8)
  FULL(rom_bank9)
  FULL(rom_bank10)
  FULL(rom_bank11)
  FULL(rom_bank12)
  FULL(rom_bank13)
  FULL(rom_bank14)
  FULL(rom_bank15)
  FULL(rom_bank16)
  FULL(rom_bank17)
  FULL(rom_bank18)
  FULL(rom_bank19)
  FULL(rom_bank20)
  FULL(rom_bank21)
  FULL(rom_bank22)
  FULL(rom_bank23)
  FULL(rom_bank24)
  FULL(rom_bank25)
  FULL(rom_bank26)
  FULL(rom_bank27)
  FULL(rom_bank28)
  FULL(rom_bank29)
  FULL(rom_bank30)
  FULL(rom_bank31)
  FULL(rom_bank32)
  FULL(rom_bank33)
  FULL(rom_bank34)
  FULL(rom_bank35)
  FULL(rom_bank36)
  FULL(rom_bank37)
  FULL(rom_bank38)
  FULL(rom_bank39)
  FULL(rom_bank40)
  FULL(rom_bank41)
  FULL(rom_bank42)
  FULL(rom_bank43)
  FULL(rom_bank44)
  FULL(rom_bank45)
  FULL(rom_bank46)
  FULL(rom_bank47)
  FULL(rom_bank48)
  FULL(rom_bank49)
  FULL(rom_bank50)
  FULL(rom_bank51)
  FULL(rom_bank52)
  FULL(rom_bank53)
  FULL(rom_bank54)
  FULL(rom_bank55)
  FULL(rom_bank56)
  FULL(rom_bank57)
  FULL(rom_bank58)
  FULL(rom_bank59)
  FULL(rom_bank60)
  FULL(rom_bank61)
  FULL(rom_bank62)
  FULL(rom_bank63)
  FULL(rom_bank64)
  FULL(rom_bank65)
  FULL(rom_bank66)
  FULL(rom_bank67)
  FULL(rom_bank68)
  FULL(rom_bank69)
  FULL(rom_bank70)
  FULL(rom_bank71)
  FULL(rom_bank72)
  FULL(rom_bank73)
  FULL(rom_bank74)
  FULL(rom_bank75)
  FULL(rom_bank76)
  FULL(rom_bank77)
  FULL(rom_bank78)
  FULL(rom_bank79)
  FULL(rom_bank80)
  FULL(rom_bank81)
  FULL(rom_bank82)
  FULL(rom_bank83)
  FULL(rom_bank84)
  FULL(rom_bank85)
  FULL(rom_bank86)
  FULL(rom_bank87)
  FULL(rom_bank88)
  FULL(rom_bank89)
  FULL(rom_bank90)
  FULL(rom_bank91)
  FULL(rom_bank92)
  FULL(rom_bank93)
  FULL(rom_bank94)
  FULL(rom_bank95)
  FULL(rom_bank96)
  FULL(rom_bank97)
  FULL(rom_bank98)
  FULL(rom_bank99)
  FULL(rom_bank100)
  FULL(rom_bank101)
  FULL(rom_bank102)
  FULL(rom_bank103)
  FULL(rom_bank104)
  FULL(rom_bank105)
  FULL(rom_bank106)
  FULL(rom_bank107)
  FULL(rom_bank108)
  FULL(rom_bank109)
  FULL(rom_bank110)
  FULL(rom_bank111)
  FULL(rom_bank112)
  FULL(rom_bank113)
  FULL(rom_bank114)
  FULL(rom_bank115)
  FULL(rom_bank116)
  FULL(rom_bank117)
  FULL(rom_bank118)
  FULL(rom_bank119)
  FULL(rom_bank120)
  FULL(rom_bank121)
  FULL(rom_bank122)
  FULL(rom_bank123)
  FULL(rom_bank124)
  FULL(rom_bank125)
  FULL(rom_bank126)
  FULL(rom_bank127)
}
